AUTOSAR XML (schema 4-3-0)
package /Dem
  module config Dem
    DemConfigSet
      DemDTCClass_0 (DemDTCClass): DemObdDTC=9, DemUdsDTC=7
      Permanent_DTC (DemEventParameter):
        DemDTCClassRef = DemDTCClass_0
        DemExtendedDataClassRef = ED_DTC_0x000001_Properties
        DemFreezeFrameClassRef = DiagnosticFreezeFrameClass_0
        DemFreezeFrameRecNumClassRef = DiagnosticFrezeFrameRecNumClass_0
        DemEventClass: DemEventDestination=DEM_DTC_ORIGIN_PRIMARY_MEMORY, DemOperationCycleRef=DEM_OPCYC_OBD_DCY
          DemIndicatorAttribute_0 (DemIndicatorAttribute):
            DemIndicatorFailureCycleSource = DEM_FAILURE_CYCLE_INDICATOR
            DemIndicatorFailureCycleRef = DEM_OPCYC_OBD_DCY
            DemIndicatorHealingCycleRef = DEM_OPCYC_OBD_DCY
            DemIndicatorRef = DEM_INDICATOR_0
      PID_1 (DemPidClass): index=0, DemPidIdentifier=1
        DemPidDataElement_0 (DemPidDataElement): index=0, DemPidDataElementClassRef=DemExternalCSDataElementClass_ExtDataRec_0x01
      PID_2 (DemPidClass): index=1, DemPidIdentifier=2
        4 x DemPidDataElement, all with DemPidDataElementClassRef=DemExternalCSDataElementClass_ExtDataRec_0x01:
          DemPidDataElement_{0..3}: index={0..3}
    DemGeneral: DemMaxNumberEventEntryPermanent=4, DemOBDSupport=1, DemMILIndicatorRef=DEM_INDICATOR_0
      CLIENT_OBD (DemClient): DemClientId=2
      DemGeneralOBD: DemOBDCentralizedPID31Handling=1
      DEM_INDICATOR_0 (DemIndicator)
      DEM_NVM_BLOCK_ID_PERMANENT (DemNvRamBlockId)
      DEM_OPCYC_IGNITION (DemOperationCycle): DemOperationCycleType=DEM_OPCYC_IGNITION
      DEM_OPCYC_OBD_DCY (DemOperationCycle): DemOperationCycleType=DEM_OPCYC_OBD_DCY
