AUTOSAR XML (schema 4-0-3)
package /AUTOSAR_SecOC/SwcBswMappings
  swc bsw mapping SwcBswMapping_0: bsw-behavior=InternalBehavior_0, swc-behavior=SecOCInternalBehavior
    runnable-mappings:
      bsw-entity=SecOC_MainFunctionRx, swc-runnable=RE_MainFunctionRx
      bsw-entity=SecOC_MainFunctionTx, swc-runnable=RE_MainFunctionTx
package /AUTOSAR_SecOC/BswModuleDescriptions
  bsw module description SecOC: module-id=607, provided-entrys=[SecOC_Init, SecOC_DeInit, SecOC_MainFunctionRx, SecOC_MainFunctionTx]
    bsw internal behavior InternalBehavior_0
      exclusive area SCHM_SECOC_EXCLUSIVE_AREA_0
      exclusive area SCHM_SECOC_EXCLUSIVE_AREA_1
      bsw called entity SecOC_Init: implemented-entry=SecOC_Init
      bsw called entity SecOC_DeInit: implemented-entry=SecOC_DeInit
      bsw schedulable entity SecOC_MainFunctionRx: can-enter-exclusive-area=SCHM_SECOC_EXCLUSIVE_AREA_0, implemented-entry=SecOC_MainFunctionRx
      bsw schedulable entity SecOC_MainFunctionTx: can-enter-exclusive-area=SCHM_SECOC_EXCLUSIVE_AREA_1, implemented-entry=SecOC_MainFunctionTx
      bsw timing event TimingEvent_MainFunctionRx: starts-on-event=SecOC_MainFunctionRx, period=0.01
      bsw timing event TimingEvent_MainFunctionTx: starts-on-event=SecOC_MainFunctionTx, period=0.01
package /AUTOSAR_SecOC/BswModuleEntrys
  4 x bsw module entry, all with is-reentrant=false, is-synchronous=true, execution-context=TASK, sw-service-impl-policy=STANDARD:
    SecOC_Init: service-id=1, call-type=REGULAR
    SecOC_DeInit: service-id=1, call-type=REGULAR
    SecOC_MainFunctionRx: service-id=6, call-type=SCHEDULED
    SecOC_MainFunctionTx: service-id=3, call-type=SCHEDULED
package /EB_SecOC/Implementations
  bsw implementation BswImplementation_0: programming-language=C, sw-version=2.8.1, swc-bsw-mapping=SwcBswMapping_0, vendor-id=1, ar-release-version=4.3.0, behavior=InternalBehavior_0, vendor-specific-module-def=SecOC
    code-descriptors:
      code Files
        artifact-descriptors:
          short-label=Autosar::include::SecOC.h, category=SWHDR
          short-label=Autosar::include::SecOC_Rx.h, category=SWHDR
          short-label=Autosar::include::SecOC_Rx_Int.h, category=SWHDR
          short-label=Autosar::include::SecOC_Tx.h, category=SWHDR
          short-label=Autosar::include::SecOC_Tx_Int.h, category=SWHDR
          short-label=Autosar::include::SecOC_Version.h, category=SWHDR
          short-label=Autosar::src::SecOC.c, category=SWSRC
          short-label=Autosar::src::SecOC_Rx.c, category=SWSRC
          short-label=Autosar::src::SecOC_Tx.c, category=SWSRC
          short-label=make::SecOC_defs.mak, category=SWMAKE
          short-label=make::SecOC_rules.mak, category=SWMAKE
    resource consumption ResourceConsumption
      9 x memory section:
        CODE: sw-addrmethod=CODE
        VAR_CLEARED_BOOLEAN: alignment=BOOLEAN, sw-addrmethod=VAR_CLEARED
        VAR_CLEARED_UNSPECIFIED: alignment=UNSPECIFIED, sw-addrmethod=VAR_CLEARED
        VAR_INIT_UNSPECIFIED: alignment=UNSPECIFIED, sw-addrmethod=VAR
        VAR_INIT_8: alignment=8, sw-addrmethod=VAR
        VAR_CLEARED_8: alignment=8, sw-addrmethod=VAR_CLEARED
        CONST_32: alignment=32, sw-addrmethod=CONST
        CONST_UNSPECIFIED: alignment=UNSPECIFIED, sw-addrmethod=CONST
        CONFIG_DATA_UNSPECIFIED: alignment=UNSPECIFIED, sw-addrmethod=CONFIG_DATA
