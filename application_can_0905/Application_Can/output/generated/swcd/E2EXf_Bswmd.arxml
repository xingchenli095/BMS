AUTOSAR XML (schema 4-0-3)
package /AUTOSAR_E2EXf/BswModuleDescriptions
  bsw module description E2EXf: module-id=176
    provided-entrys:
      E2EXf_9D7FDE5D5F414438C76F1B9E84FCBFC8
      E2EXf_Inv_520AB6FCDD97019CD777879A4674C0ED_DF484B1EBB580D89DBA52DABCC7DEFEC_F01A0E3D96E0654D01BEA3CFC0D9035A
    bsw internal behavior InternalBehavior_0
      bsw called entity E2EXf_E2EXf_Inv_520AB6FCDD97019CD777879A4674C0ED_DF484B1EBB580D89DBA52DABCC7DEFEC_F01A0E3D96E0654D01BEA3CFC0D9035A: implemented-entry=E2EXf_Inv_520AB6FCDD97019CD777879A4674C0ED_DF484B1EBB580D89DBA52DABCC7DEFEC_F01A0E3D96E0654D01BEA3CFC0D9035A
package /AUTOSAR_E2EXf/BswModuleEntrys
  bsw module entry E2EXf_9D7FDE5D5F414438C76F1B9E84FCBFC8: service-id=3, is-reentrant=false, is-synchronous=true, call-type=REGULAR, execution-context=TASK, sw-service-impl-policy=STANDARD
    sw service arg Buffer: direction=OUT, implementation-data-type=VoidPtr
    sw service arg BufferLength: direction=OUT, implementation-data-type=VoidPtr
    sw service arg DataElement: direction=IN, implementation-data-type=ConstVoidPtr
  bsw module entry E2EXf_Inv_520AB6FCDD97019CD777879A4674C0ED_DF484B1EBB580D89DBA52DABCC7DEFEC_F01A0E3D96E0654D01BEA3CFC0D9035A: service-id=4, is-reentrant=false, is-synchronous=true, call-type=REGULAR, execution-context=TASK, sw-service-impl-policy=STANDARD
    sw service arg Buffer: direction=IN, implementation-data-type=ConstVoidPtr
    sw service arg BufferLength: direction=IN, implementation-data-type=uint16
    sw service arg DataElement: direction=OUT, implementation-data-type=VoidPtr
package /EB_E2EXf/Implementations
  bsw implementation BswImplementation_0: programming-language=C, sw-version=1.0.37, vendor-id=1, ar-release-version=4.2.1, behavior=InternalBehavior_0, vendor-specific-module-def=Xfrm
    code-descriptors:
      code Files
        artifact-descriptors:
          short-label=Autosar::include::E2EXf.h, category=SWHDR
          short-label=Autosar::include::E2EXf_Version.h, category=SWHDR
          short-label=Autosar::src::E2EXf.c, category=SWSRC
          short-label=make::E2EXf_defs.mak, category=SWMAKE
          short-label=make::E2EXf_rules.mak, category=SWMAKE
    resource consumption ResourceConsumption
      8 x memory section:
        CODE: sw-addrmethod=CODE
        VAR_FAST_INIT_UNSPECIFIED: alignment=UNSPECIFIED, sw-addrmethod=VAR_FAST
        CONFIG_DATA_UNSPECIFIED: alignment=UNSPECIFIED, sw-addrmethod=CONFIG_DATA
        VAR_INIT_8: alignment=8, sw-addrmethod=VAR_INIT
        VAR_CLEARED_UNSPECIFIED: alignment=UNSPECIFIED, sw-addrmethod=VAR_CLEARED
        CONST_32: alignment=32, sw-addrmethod=CONST
        DEFAULTPARTITION_VAR_INIT_ASIL_D_8: alignment=8, options=safetyAsilD, prefix=E2EXF, sw-addrmethod=VAR_INIT_ASIL_D, symbol=VAR_INIT_ASIL_D_8
        DEFAULTPARTITION_VAR_CLEARED_ASIL_D_UNSPECIFIED: alignment=UNSPECIFIED, options=safetyAsilD, prefix=E2EXF, sw-addrmethod=VAR_CLEARED_ASIL_D, symbol=VAR_CLEARED_ASIL_D_UNSPECIFIED
      section name prefix E2EXF
