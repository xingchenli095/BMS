AUTOSAR XML (schema 4-0-3)
package /AUTOSAR_WdgIf/BswModuleDescriptions
  bsw module description WdgIf: module-id=43, provided-entrys=[WdgIf_SetMode, WdgIf_SetTriggerCondition]
    bsw internal behavior InternalBehavior_0
      bsw called entity WdgIf_SetMode: implemented-entry=WdgIf_SetMode
      bsw called entity WdgIf_SetTriggerCondition: implemented-entry=WdgIf_SetTriggerCondition
package /AUTOSAR_WdgIf/BswModuleEntrys
  bsw module entry WdgIf_SetMode: service-id=1, is-reentrant=false, is-synchronous=true, call-type=REGULAR, execution-context=TASK, sw-service-impl-policy=STANDARD
    return type ret: direction=OUT, implementation-data-type=Std_ReturnType
    sw service arg DeviceIndex: direction=IN, implementation-data-type=uint8
    sw service arg WdgMode: direction=IN, implementation-data-type=WdgIf_ModeType
  bsw module entry WdgIf_SetTriggerCondition: service-id=2, is-reentrant=false, is-synchronous=true, call-type=REGULAR, execution-context=TASK, sw-service-impl-policy=STANDARD
    sw service arg DeviceIndex: direction=IN, implementation-data-type=uint8
    sw service arg Timeout: direction=IN, implementation-data-type=uint16
package /AUTOSAR_WdgIf/ImplementationDataTypes
  impl type WdgIf_ModeType: compu {0=WDGIF_OFF_MODE, 1=WDGIF_SLOW_MODE, 2=WDGIF_FAST_MODE}, implementation-data-type=uint32, type-emitter=BSW
package /EB_WdgIf/Implementations
  bsw implementation BswImplementation_0: programming-language=C, sw-version=6.1.29, vendor-id=1, ar-release-version=4.0.3, behavior=InternalBehavior_0, vendor-specific-module-def=WdgIf
    code-descriptors:
      code Files
        artifact-descriptors:
          short-label=Autosar::include::WdgIf.h, category=SWHDR
          short-label=Autosar::include::WdgIf_Types.h, category=SWHDR
          short-label=Autosar::include::WdgIf_Version.h, category=SWHDR
          short-label=Autosar::src::WdgIf.c, category=SWSRC
          short-label=make::WdgIf_defs.mak, category=SWMAKE
          short-label=make::WdgIf_rules.mak, category=SWMAKE
    resource consumption ResourceConsumption
      memory section CODE_ASIL_D: options=safetyAsilD, sw-addrmethod=CODE_ASIL_D
      memory section CONST_ASIL_D_UNSPECIFIED: alignment=UNSPECIFIED, options=safetyAsilD, sw-addrmethod=CONST_ASIL_D
