AUTOSAR XML (schema 4-0-3)
package /AUTOSAR_SecOC/ImplementationDataTypes
  impl type SecOC_StateType: compu {0=SECOC_UNINIT, 1=SECOC_INIT}, range raw 0..1, implementation-data-type=uint32
  impl type SecOC_FreshnessArrayType: category=ARRAY, sw-calibration-access=READ-ONLY
    element freshnessValueTypeElement: array-size=8, array-size-semantics=FIXED-SIZE, implementation-data-type=uint8
package /AUTOSAR_SecOC/PortInterfaces
  client server interface VerifyStatusConfiguration: is-service=true
    operation VerifyStatusOverride: possible-error=[VerifyStatusConfiguration/E_OK, VerifyStatusConfiguration/E_NOT_OK]
      arg freshnessValueId: type=uint16, direction=IN
      arg overrideStatus: type=uint8, direction=IN
      arg numberOfMessagesToOverride: type=uint8, direction=IN
    error E_OK: error-code=0
    error E_NOT_OK: error-code=1
  client server interface TxFreshnessManagement: is-service=true
    operation GetTxFreshness: possible-error=[TxFreshnessManagement/E_OK, TxFreshnessManagement/E_NOT_OK, TxFreshnessManagement/E_BUSY]
      arg freshnessValueId: type=uint16, direction=IN
      arg freshnessValue: type=SecOC_FreshnessArrayType, direction=OUT
      arg freshnessValueLength: type=uint32, direction=INOUT
    operation SPduTxConfirmation: possible-error=TxFreshnessManagement/E_OK
      arg freshnessValueId: type=uint16, direction=IN
    error E_OK: error-code=0
    error E_NOT_OK: error-code=1
    error E_BUSY: error-code=2
  client server interface RxFreshnessManagement: is-service=true
    operation GetRxFreshness: possible-error=[RxFreshnessManagement/E_OK, RxFreshnessManagement/E_NOT_OK, RxFreshnessManagement/E_BUSY]
      6 x arg:
        freshnessValueId: type=uint16, direction=IN
        truncatedFreshnessValue: type=SecOC_FreshnessArrayType, direction=IN
        truncatedFreshnessLength: type=uint32, direction=IN
        authVerifyAttempts: type=uint16, direction=IN
        freshnessValue: type=SecOC_FreshnessArrayType, direction=OUT
        freshnessValueLength: type=uint32, direction=INOUT
    error E_OK: error-code=0
    error E_NOT_OK: error-code=1
    error E_BUSY: error-code=2
