AUTOSAR XML (schema 4-1-3)
package /AUTOSAR_Dem/CompuMethods
  compu method CM_MinRatioEvent: mask 0b00000001: 0b00000000..0b00000001
  compu method CM_FreezeFrameUpdate: mask 0b00000010: 0b00000000..0b00000010
  compu method CM_DemUdsDTC: mask 0b00000000111111111111111111111111: 0b00000000000000000000000000000000..0b00000000111111111111111111111111
  compu method CM_DemDTCSeverity: mask 0b00001100000000000000000000000000: 0b00000000000000000000000000000000..0b00001100000000000000000000000000
  compu method CM_FFClassIdx: mask 0b00000000000000000000000000000010: 0b00000000000000000000000000000000..0b00000000000000000000000000000010
  compu method CM_DemDTCFunctionalUnit: mask 0b00000000000000000000000100000000: 0b00000000000000000000000000000000..0b00000000000000000000000100000000
  compu method CM_DemDebounceCounterBased: mask 0b01111111: 0b00000000..0b01111111
  compu method CM_DemOBDEngineType: mask 0b00001000: 0b00000000..0b00001000
  compu method CM_DemOBDForceMisfireMonitoringReady: mask 0b00010000: 0b00000000..0b00010000
  compu method CM_DemOBDForceFuelSysMonitoringReady: mask 0b00100000: 0b00000000..0b00100000
  compu method CM_DemOBDForceCCMonitoringReady: mask 0b01000000: 0b00000000..0b00100000
  compu method CM_DemOBDSetCCMenabled: mask 0b00000100: 0b00000000..0b00000100
  compu method CM_DemEventEnabled_0: mask 0b00000001: 0b00000000..0b00000001
  compu method CM_DemEventEnabled_1: mask 0b00000010: 0b00000000..0b00000010
  compu method CM_DemEventEnabled_2: mask 0b00000100: 0b00000000..0b00000100
  compu method CM_DemEventEnabled_3: mask 0b00001000: 0b00000000..0b00001000
  compu method CM_DemEventEnabled_4: mask 0b00010000: 0b00000000..0b00010000
  compu method CM_DemEventEnabled_5: mask 0b00100000: 0b00000000..0b00100000
  compu method CM_DemEventEnabled_6: mask 0b01000000: 0b00000000..0b01000000
  compu method CM_DemEventEnabled_7: mask 0b10000000: 0b00000000..0b10000000
package /AUTOSAR_Dem/DataConstrs
  range CONSTR_DebounceCounterClassIdx: raw 0..1
  range CONSTR_DebounceTimeClassIdx: raw 0..-1
package /AUTOSAR_Dem/BswModuleDescriptions
  bsw module description Dem: module-id=54, provided-entrys=Dem_MainFunction
    bsw internal behavior InternalBehavior_0
      bsw schedulable entity Dem_MainFunction: implemented-entry=Dem_MainFunction
      bsw timing event TimingEvent_MainFunction: starts-on-event=Dem_MainFunction, period=0.02
package /AUTOSAR_Dem/BswModuleEntrys
  bsw module entry Dem_MainFunction: service-id=85, is-reentrant=false, is-synchronous=true, call-type=SCHEDULED, execution-context=TASK, sw-service-impl-policy=STANDARD
package /EB_Dem/Implementations
  bsw implementation BswImplementation_0: programming-language=C, sw-version=6.4.5, swc-bsw-mapping=SwcBswMapping_0, vendor-id=1, ar-release-version=4.0.3, behavior=InternalBehavior_0
    code-descriptors:
      code Files
        artifact-descriptors:
          short-label=Autosar::include::Dem.h, category=SWHDR
          short-label=Autosar::include::Dem_BSW_Types.h, category=SWHDR
          short-label=Autosar::include::Dem_Int.h, category=SWHDR
          short-label=Autosar::include::Dem_Int_Stc.h, category=SWHDR
          short-label=Autosar::include::Dem_NvMCbk.h, category=SWHDR
          short-label=Autosar::include::Dem_Stc.h, category=SWHDR
          short-label=Autosar::include::Dem_Trace.h, category=SWHDR
          short-label=Autosar::include::Dem_Types.h, category=SWHDR
          short-label=Autosar::include::Dem_Version.h, category=SWHDR
          short-label=Autosar::src::Dem.c, category=SWSRC
          short-label=Autosar::src::Dem_Core.c, category=SWSRC
          short-label=Autosar::src::Dem_DcmIfAccess.c, category=SWSRC
          short-label=Autosar::src::Dem_DcmIfFFandED.c, category=SWSRC
          short-label=Autosar::src::Dem_DcmIfOBD.c, category=SWSRC
          short-label=Autosar::src::Dem_DcmIfStatusInfo.c, category=SWSRC
          short-label=Autosar::src::Dem_J1939Dcm.c, category=SWSRC
          short-label=Autosar::src::Dem_J1939FF.c, category=SWSRC
          short-label=make::Dem_defs.mak, category=SWMAKE
          short-label=make::Dem_rules.mak, category=SWMAKE
    resource consumption ResourceConsumption
      21 x memory section:
        VAR_CLEARED_UNSPECIFIED: alignment=UNSPECIFIED, sw-addrmethod=VAR_CLEARED
        VAR_CLEARED_32: alignment=32, sw-addrmethod=VAR_CLEARED
        VAR_CLEARED_16: alignment=16, sw-addrmethod=VAR_CLEARED
        VAR_CLEARED_8: alignment=8, sw-addrmethod=VAR_CLEARED
        VAR_INIT_UNSPECIFIED: alignment=UNSPECIFIED, sw-addrmethod=VAR
        VAR_INIT_32: alignment=32, sw-addrmethod=VAR
        VAR_INIT_16: alignment=16, sw-addrmethod=VAR
        VAR_INIT_8: alignment=8, sw-addrmethod=VAR
        VAR_SAVED_ZONE_UNSPECIFIED: alignment=UNSPECIFIED, sw-addrmethod=VAR_CLEARED
        VAR_SAVED_ZONE_16: alignment=16, sw-addrmethod=VAR_CLEARED
        VAR_SAVED_ZONE_8: alignment=8, sw-addrmethod=VAR_CLEARED
        CONST_UNSPECIFIED: alignment=UNSPECIFIED, sw-addrmethod=CONST
        CONST_32: alignment=32, sw-addrmethod=CONST
        CONST_16: alignment=16, sw-addrmethod=CONST
        CONST_8: alignment=8, sw-addrmethod=CONST
        CALIB_UNSPECIFIED: alignment=UNSPECIFIED, sw-addrmethod=CALIB
        CALIB_32: alignment=32, sw-addrmethod=CALIB
        CALIB_16: alignment=16, sw-addrmethod=CALIB
        CALIB_8: alignment=8, sw-addrmethod=CALIB
        CODE: sw-addrmethod=CODE
        EB_INTGR_BSWM_TRIGGERMEMORYSTACK_CODE: sw-addrmethod=CALLOUT_CODE
