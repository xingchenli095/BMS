entry &elffile
do ../source/boards/S32K344EVB_Q172_SCOS/S32K344EVB_Q172.cmm &elffile
go
wait 10.0
sys.down
quit

