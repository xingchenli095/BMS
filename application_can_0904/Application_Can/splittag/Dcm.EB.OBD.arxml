AUTOSAR XML (schema 4-3-0)
package /Dcm
  module config Dcm
    DcmConfigSet
      DcmDsd
        DcmServiceTable_OBD (DcmDsdServiceTable): DcmDsdSidTabId=1
          7 x DcmDsdService, all with DcmDsdSidTabSubfuncAvail=0:
            ClrEmissionRelDTC: DcmDsdSidTabServiceId=4
            ReqCurrentPowerTrainDiag: DcmDsdSidTabServiceId=1
            ReqEmissionRelDTC: DcmDsdSidTabServiceId=3
            ReqExtEmissionRelDTC: DcmDsdSidTabServiceId=7
            ReqNvmEmissionRelDTC: DcmDsdSidTabServiceId=10
            ReqPowerTrainFreezeFrame: DcmDsdSidTabServiceId=2
            RequestVehicleInformation: DcmDsdSidTabServiceId=9
      DcmDsl
        3 x DcmDslBuffer, all with DcmDslBufferSize=1024:
          DcmBuffer_Func_OBD
          DcmBuffer_Phys_OBD
          DcmDslBufferTx_OBD
        DcmDslProtocol
          DcmServiceTable_OBD (DcmDslProtocolRow):
            DcmDslObdNRCResponseSupression = 0
            DcmDslProtocolID = DCM_OBD_ON_CAN
            DcmDslProtocolStackNumber = 1
            DcmDemClientRef = CLIENT_OBD
            DcmDslProtocolTxBufferID = DcmDslBufferTx_OBD
            CAN_DiagnosticConnection_OBD_Main (DcmDslConnection)
              CAN_DiagnosticConnection_OBD_Main (DcmDslMainConnection)
                Dcm_Pdu_USDT_CAN_Rx_Func_OBD (DcmDslProtocolRx): DcmDslProtocolRxBufferID=DcmBuffer_Func_OBD
                Dcm_Pdu_USDT_CAN_Rx_Phys_OBD (DcmDslProtocolRx): DcmDslProtocolRxBufferID=DcmBuffer_Phys_OBD
            DcmDslConnection_0 (DcmDslConnection)
              DcmDslConnection_0 (DcmDslPeriodicTransmission)
                DcmDslPeriodicConnection_0 (DcmDslPeriodicConnection): DcmDslPeriodicTxPduRef=Dcm_Pdu_UUDT_CAN_Tx_OBD_2024T
      DcmDsp
        3 x DcmDspPid, all with DcmDspPidSize=4:
          DcmDspPid_0: DcmDspPidIdentifier=1, DcmDspPidService=DCM_SERVICE_01_02
            DcmDspPidData_0 (DcmDspPidData): DcmDspPidDataSize=32
              DcmDspPidService01: DcmDspPidDataReadFnc=Dem_DcmReadDataOfPID01, DcmDspPidDataUsePort=USE_DATA_SYNCH_FNC
              DcmDspPidService02: DcmDspPidDataDemRef=DemPidDataElement_0
          DcmDspPid_1: DcmDspPidIdentifier=65, DcmDspPidService=DCM_SERVICE_01
            DcmDspPidData_1 (DcmDspPidData): DcmDspPidDataSize=32
              DcmDspPidService01: DcmDspPidDataReadFnc=Dem_DcmReadDataOfPID41, DcmDspPidDataUsePort=USE_DATA_SYNCH_FNC
          DcmDspPid_2: DcmDspPidIdentifier=3, DcmDspPidService=DCM_SERVICE_02
            4 x DcmDspPidData, all with DcmDspPidDataSize=8:
              DcmDspPid_02_Data_0
                DcmDspPidService02: DcmDspPidDataDemRef=DemPidDataElement_0
              DcmDspPid_02_Data_1: DcmDspPidDataPos=8
                DcmDspPidService02: DcmDspPidDataDemRef=DemPidDataElement_1
              DcmDspPid_02_Data_2: DcmDspPidDataPos=16
                DcmDspPidService02: DcmDspPidDataDemRef=DemPidDataElement_2
              DcmDspPid_02_Data_3: DcmDspPidDataPos=24
                DcmDspPidService02: DcmDspPidDataDemRef=DemPidDataElement_3
        DcmDspVehInfo_0 (DcmDspVehInfo): DcmDspVehInfoInfoType=1
          Service09_VinMessageCount (DcmDspVehInfoData): DcmDspVehInfoDataSize=1, DcmDspVehInfoDataUsePort=1
        DcmDspVehInfo_1 (DcmDspVehInfo): DcmDspVehInfoInfoType=2
          Service09_VehicleIdentificationNumber (DcmDspVehInfoData): DcmDspVehInfoDataSize=17
