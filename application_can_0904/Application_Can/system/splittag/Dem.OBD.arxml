AUTOSAR XML (schema 4-3-0)
package /Dem
  module config Dem
    DemConfigSet
      PID_1 (DemPidClass): DemPidIdentifier=1
        DemPidDataElement_0 (DemPidDataElement): DemPidDataElementClassRef=DemExternalCSDataElementClass_ExtDataRec_0x01
      PID_2 (DemPidClass): DemPidIdentifier=2
        4 x DemPidDataElement, all with DemPidDataElementClassRef=DemExternalCSDataElementClass_ExtDataRec_0x01:
          DemPidDataElement_{0..3}
    DemGeneral: DemOBDSupport=1
      CLIENT_OBD (DemClient)
      DemGeneralOBD: DemOBDCentralizedPID31Handling=1
      DEM_OPCYC_IGNITION (DemOperationCycle): DemOperationCycleType=DEM_OPCYC_IGNITION
      DEM_OPCYC_OBD_DCY (DemOperationCycle): DemOperationCycleType=DEM_OPCYC_OBD_DCY
