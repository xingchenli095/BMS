AUTOSAR XML (schema 00047)
package /CanSystem/FRAMES
  4 x can frame, all with frame-length=8:
    USDT_CAN_Rx_Func_OBD
      pdu to frame mapping USDT_CAN_Rx_Func_Tp_OBD: packing-byte-order=big-endian, pdu=N_Pdu_USDT_CAN_Rx_Func_Tp_OBD, start-position=7
    USDT_CAN_Rx_Phys_OBD
      pdu to frame mapping USDT_CAN_Rx_Phys_Tp_OBD: packing-byte-order=big-endian, pdu=N_Pdu_USDT_CAN_Rx_Phys_Tp_OBD, start-position=7
    USDT_CAN_Tx_OBD
      pdu to frame mapping USDT_CAN_Tx_Tp_OBD: packing-byte-order=big-endian, pdu=N_Pdu_USDT_CAN_Tx_Tp_OBD, start-position=7
    UUDT_CAN_Tx_OBD
      pdu to frame mapping UUDT_CAN_Tx_OBD: packing-byte-order=big-endian, pdu=Dcm_Pdu_UUDT_CAN_Tx_OBD, start-position=7
package /CanSystem/PDUS/DCM_PDU_Package
  dcm i pdu Dcm_Pdu_USDT_CAN_Rx_Func_OBD: length=7, diag-pdu-type=DIAG-REQUEST
  dcm i pdu Dcm_Pdu_USDT_CAN_Rx_Phys_OBD: length=8, diag-pdu-type=DIAG-REQUEST
  dcm i pdu Dcm_Pdu_USDT_CAN_Tx_OBD: length=8, diag-pdu-type=DIAG-RESPONSE
  dcm i pdu Dcm_Pdu_UUDT_CAN_Tx_OBD: length=8, diag-pdu-type=DIAG-RESPONSE
package /CanSystem/PDUS/N_PDU_Package
  n pdu N_Pdu_USDT_CAN_Rx_Func_Tp_OBD: length=8
  n pdu N_Pdu_USDT_CAN_Rx_Phys_Tp_OBD: length=8
  n pdu N_Pdu_USDT_CAN_Tx_Tp_OBD: length=8
