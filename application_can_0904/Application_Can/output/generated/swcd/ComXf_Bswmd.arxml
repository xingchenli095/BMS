AUTOSAR XML (schema 4-0-3)
package /AUTOSAR_ComXf/BswModuleDescriptions
  bsw module description ComXf: module-id=175
    provided-entrys:
      ComXf_9D7FDE5D5F414438C76F1B9E84FCBFC8
      ComXf_Inv_520AB6FCDD97019CD777879A4674C0ED_DF484B1EBB580D89DBA52DABCC7DEFEC_F01A0E3D96E0654D01BEA3CFC0D9035A
    bsw internal behavior InternalBehavior_0
      bsw called entity ComXf_ComXf_Inv_520AB6FCDD97019CD777879A4674C0ED_DF484B1EBB580D89DBA52DABCC7DEFEC_F01A0E3D96E0654D01BEA3CFC0D9035A: implemented-entry=ComXf_Inv_520AB6FCDD97019CD777879A4674C0ED_DF484B1EBB580D89DBA52DABCC7DEFEC_F01A0E3D96E0654D01BEA3CFC0D9035A
package /AUTOSAR_ComXf/BswModuleEntrys
  bsw module entry ComXf_9D7FDE5D5F414438C76F1B9E84FCBFC8: service-id=3, is-reentrant=false, is-synchronous=true, call-type=REGULAR, execution-context=TASK, sw-service-impl-policy=STANDARD
    sw service arg Buffer: direction=OUT, implementation-data-type=VoidPtr
    sw service arg BufferLength: direction=OUT, implementation-data-type=VoidPtr
    sw service arg DataElement: direction=IN, implementation-data-type=ConstVoidPtr
  bsw module entry ComXf_Inv_520AB6FCDD97019CD777879A4674C0ED_DF484B1EBB580D89DBA52DABCC7DEFEC_F01A0E3D96E0654D01BEA3CFC0D9035A: service-id=4, is-reentrant=false, is-synchronous=true, call-type=REGULAR, execution-context=TASK, sw-service-impl-policy=STANDARD
    sw service arg Buffer: direction=IN, implementation-data-type=ConstVoidPtr
    sw service arg BufferLength: direction=IN, implementation-data-type=uint16
    sw service arg DataElement: direction=OUT, implementation-data-type=VoidPtr
package /EB_ComXf/Implementations
  bsw implementation BswImplementation_0: programming-language=C, sw-version=1.0.40, vendor-id=1, ar-release-version=4.2.1, behavior=InternalBehavior_0, vendor-specific-module-def=Xfrm
    code-descriptors:
      code Files
        artifact-descriptors:
          short-label=Autosar::include::ComXf.h, category=SWHDR
          short-label=Autosar::include::ComXf_Api_Stc.h, category=SWHDR
          short-label=Autosar::include::ComXf_Int.h, category=SWHDR
          short-label=Autosar::include::ComXf_Version.h, category=SWHDR
          short-label=Autosar::src::ComXf.c, category=SWSRC
          short-label=make::ComXf_defs.mak, category=SWMAKE
          short-label=make::ComXf_rules.mak, category=SWMAKE
    resource consumption ResourceConsumption
      6 x memory section:
        CODE: sw-addrmethod=CODE
        VAR_FAST_INIT_UNSPECIFIED: alignment=UNSPECIFIED, sw-addrmethod=VAR_FAST
        CONFIG_DATA_UNSPECIFIED: alignment=UNSPECIFIED, sw-addrmethod=CONFIG_DATA
        VAR_INIT_8: alignment=8, sw-addrmethod=VAR_INIT
        VAR_CLEARED_UNSPECIFIED: alignment=UNSPECIFIED, sw-addrmethod=VAR_CLEARED
        CONST_32: alignment=32, sw-addrmethod=CONST
