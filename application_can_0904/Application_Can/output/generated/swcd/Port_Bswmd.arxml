AUTOSAR XML (schema 4-0-3)
package /AUTOSAR_Port/BswModuleDescriptions
  bsw module description Port: module-id=124, provided-entrys=Port_Init
    bsw internal behavior InternalBehavior_0
      11 x exclusive area:
        PORT_EXCLUSIVE_AREA_{00..10}
      bsw called entity Port_Init: can-enter-exclusive-area=[PORT_EXCLUSIVE_AREA_00, PORT_EXCLUSIVE_AREA_01, PORT_EXCLUSIVE_AREA_02, PORT_EXCLUSIVE_AREA_03, PORT_EXCLUSIVE_AREA_04, PORT_EXCLUSIVE_AREA_05, PORT_EXCLUSIVE_AREA_06, PORT_EXCLUSIVE_AREA_07, PORT_EXCLUSIVE_AREA_08, PORT_EXCLUSIVE_AREA_09, PORT_EXCLUSIVE_AREA_10], implemented-entry=Port_Init
package /AUTOSAR_Port/BswModuleEntrys
  bsw module entry Port_Init: service-id=0, is-reentrant=false, is-synchronous=true, call-type=REGULAR, execution-context=UNSPECIFIED, sw-service-impl-policy=STANDARD
package /Port_TS_T40D34M20I1R0/Implementations
  bsw implementation BswImplementation_0: programming-language=C, sw-version=2.0.1, vendor-id=43, ar-release-version=4.4.0, behavior=InternalBehavior_0, vendor-specific-module-def=Port
    code-descriptors:
      code Files
        artifact-descriptors:
          short-label=make::Port_defs.mak, category=SWMAKE
          short-label=make::Port_rules.mak, category=SWMAKE
    resource consumption ResourceConsumption
      12 x memory section:
        PORT_CODE: sw-addrmethod=CODE, symbol=CODE
        PORT_CONFIG_DATA_16: alignment=16, sw-addrmethod=CONFIG_DATA, symbol=CONFIG_DATA_16
        PORT_CONFIG_DATA_32: alignment=32, sw-addrmethod=CONFIG_DATA, symbol=CONFIG_DATA_32
        PORT_CONFIG_DATA_8: alignment=8, sw-addrmethod=CONFIG_DATA, symbol=CONFIG_DATA_8
        PORT_CONFIG_DATA_UNSPECIFIED: alignment=UNSPECIFIED, sw-addrmethod=CONFIG_DATA, symbol=CONFIG_DATA_UNSPECIFIED
        PORT_CONST_16: alignment=16, sw-addrmethod=CONST, symbol=CONST_16
        PORT_CONST_32: alignment=32, sw-addrmethod=CONST, symbol=CONST_32
        PORT_CONST_UNSPECIFIED: alignment=UNSPECIFIED, sw-addrmethod=CONST, symbol=CONST_UNSPECIFIED
        PORT_VAR_CLEARED_16_NO_CACHEABLE: sw-addrmethod=VAR_CLEARED, symbol=VAR_CLEARED_16_NO_CACHEABLE
        PORT_VAR_CLEARED_32: alignment=32, sw-addrmethod=VAR_CLEARED, symbol=VAR_CLEARED_32
        PORT_VAR_CLEARED_UNSPECIFIED: alignment=UNSPECIFIED, sw-addrmethod=VAR_CLEARED, symbol=VAR_CLEARED_UNSPECIFIED
        PORT_VAR_CLEARED_UNSPECIFIED_NO_CACHEABLE: sw-addrmethod=VAR_CLEARED, symbol=VAR_CLEARED_UNSPECIFIED_NO_CACHEABLE
