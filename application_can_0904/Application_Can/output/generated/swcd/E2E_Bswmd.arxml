AUTOSAR XML (schema 4-0-3)
package /AUTOSAR_E2E/BswModuleDescriptions
  bsw module description E2E: module-id=207, provided-entrys=E2E_GetVersionInfo
    bsw internal behavior InternalBehavior_0
      bsw called entity E2E_GetVersionInfo: implemented-entry=E2E_GetVersionInfo
package /AUTOSAR_E2E/BswModuleEntrys
  bsw module entry E2E_GetVersionInfo: service-id=20, is-reentrant=true, is-synchronous=true, call-type=REGULAR, execution-context=UNSPECIFIED, sw-service-impl-policy=STANDARD
package /EB_E2E/Implementations
  bsw implementation BswImplementation_0: programming-language=C, sw-version=2.0.18, vendor-id=1, ar-release-version=4.2.1, behavior=InternalBehavior_0, vendor-specific-module-def=E2E
    code-descriptors:
      code Files
        artifact-descriptors:
          short-label=Autosar::include::E2E.h, category=SWHDR
          short-label=Autosar::include::E2E_ComXf_S_Stc.h, category=SWHDR
          short-label=Autosar::include::E2E_Defs.h, category=SWHDR
          short-label=Autosar::include::E2E_E2EXf_Stc.h, category=SWHDR
          short-label=Autosar::include::E2E_Mem.h, category=SWHDR
          short-label=Autosar::include::E2E_No_Check_E2EXf.h, category=SWHDR
          short-label=Autosar::include::E2E_PXX_E2EXf.h, category=SWHDR
          short-label=Autosar::include::E2E_UnPackSig.h, category=SWHDR
          short-label=Autosar::src::E2E.c, category=SWSRC
          short-label=Autosar::src::E2E_Mem.c, category=SWSRC
          short-label=Autosar::src::E2E_No_Check_E2EXf.c, category=SWSRC
          short-label=Autosar::src::E2E_PXX_E2EXf.c, category=SWSRC
          short-label=make::E2E_defs.mak, category=SWMAKE
          short-label=make::E2E_rules.mak, category=SWMAKE
    resource consumption ResourceConsumption
      5 x memory section:
        CODE: sw-addrmethod=CODE
        CONST_8: alignment=8, sw-addrmethod=CONST
        CONST_16: alignment=16, sw-addrmethod=CONST
        CONST_32: alignment=32, sw-addrmethod=CONST
        CONST_UNSPECIFIED: alignment=UNSPECIFIED, sw-addrmethod=CONST
