AUTOSAR XML (schema 4-0-3)
package /AUTOSAR_NvM/SwcBswMappings
  swc bsw mapping SwcBswMapping_0: bsw-behavior=InternalBehavior_0, swc-bsw-runnable-mapping{bsw-entity=NvM_MainFunction, swc-runnable=RE_MainFunction}, swc-behavior=NvMIntBeh
package /AUTOSAR_NvM/BswModuleDescriptions
  bsw module description NvM: module-id=20, provided-entrys=NvM_MainFunction
    bsw internal behavior InternalBehavior_0
      exclusive area SCHM_NVM_EXCLUSIVE_AREA_0
      static-memorys:
        4 x data:
          NvM_GlobalWorkingStatus: type=uint16
          NvM_GlobalErrorStatus: type=uint8
          NvM_GlobalGenericStatus: type=uint16
          NvM_GlobalCallLevel: type=uint8
      bsw schedulable entity NvM_MainFunction: can-enter-exclusive-area=SCHM_NVM_EXCLUSIVE_AREA_0, implemented-entry=NvM_MainFunction
      bsw timing event TimingEvent_MainFunction: starts-on-event=NvM_MainFunction, period=0.01
package /AUTOSAR_NvM/BswModuleEntrys
  bsw module entry NvM_MainFunction: service-id=0x0e, is-reentrant=true, is-synchronous=true, call-type=SCHEDULED, execution-context=TASK, sw-service-impl-policy=STANDARD
package /EB_NvM/Implementations
  bsw implementation BswImplementation_0: programming-language=C, sw-version=6.17.26, swc-bsw-mapping=SwcBswMapping_0, vendor-id=1, ar-release-version=4.0.3, behavior=InternalBehavior_0, vendor-specific-module-def=NvM
    code-descriptors:
      code Files
        artifact-descriptors:
          short-label=Autosar::include::NvM.h, category=SWHDR
          short-label=Autosar::include::NvM_Api_Stc.h, category=SWHDR
          short-label=Autosar::include::NvM_BSW.h, category=SWHDR
          short-label=Autosar::include::NvM_BSW_Types.h, category=SWHDR
          short-label=Autosar::include::NvM_BlockCheck.h, category=SWHDR
          short-label=Autosar::include::NvM_CalcCrc.h, category=SWHDR
          short-label=Autosar::include::NvM_Cbk.h, category=SWHDR
          short-label=Autosar::include::NvM_DataIntern.h, category=SWHDR
          short-label=Autosar::include::NvM_FunctionIntern.h, category=SWHDR
          short-label=Autosar::include::NvM_Int_Types.h, category=SWHDR
          short-label=Autosar::include::NvM_Queue.h, category=SWHDR
          short-label=Autosar::include::NvM_StateMachine.h, category=SWHDR
          short-label=Autosar::include::NvM_Trace.h, category=SWHDR
          short-label=Autosar::include::NvM_Trace_Internal.h, category=SWHDR
          short-label=Autosar::include::NvM_Version.h, category=SWHDR
          short-label=Autosar::include::NvM_Wrapper.h, category=SWHDR
          short-label=Autosar::src::NvM.c, category=SWSRC
          short-label=Autosar::src::NvM_ASR32_Rte.c, category=SWSRC
          short-label=Autosar::src::NvM_ASR40_Rte.c, category=SWSRC
          short-label=Autosar::src::NvM_ASR42_Rte.c, category=SWSRC
          short-label=Autosar::src::NvM_BlockCheck.c, category=SWSRC
          short-label=Autosar::src::NvM_CalcCrc.c, category=SWSRC
          short-label=Autosar::src::NvM_DataIntern.c, category=SWSRC
          short-label=Autosar::src::NvM_FirstInitAll.c, category=SWSRC
          short-label=Autosar::src::NvM_Queue.c, category=SWSRC
          short-label=Autosar::src::NvM_ReadAll.c, category=SWSRC
          short-label=Autosar::src::NvM_ReadBlock.c, category=SWSRC
          short-label=Autosar::src::NvM_RestoreBlockDefaults.c, category=SWSRC
          short-label=Autosar::src::NvM_Rte.c, category=SWSRC
          short-label=Autosar::src::NvM_StateMachine.c, category=SWSRC
          short-label=Autosar::src::NvM_ValidateAll.c, category=SWSRC
          short-label=Autosar::src::NvM_Wrapper.c, category=SWSRC
          short-label=Autosar::src::NvM_WriteAll.c, category=SWSRC
          short-label=Autosar::src::NvM_WriteBlock.c, category=SWSRC
          short-label=make::NvM_defs.mak, category=SWMAKE
          short-label=make::NvM_rules.mak, category=SWMAKE
    resource consumption ResourceConsumption
      22 x memory section:
        CODE: sw-addrmethod=CODE
        CODE_MC_SHARED: sw-addrmethod=CODE
        VAR_POWER_ON_INIT_8: alignment=8, sw-addrmethod=VAR_POWER_ON_INIT
        VAR_POWER_ON_INIT_MC_SHARED_UNSPECIFIED: alignment=UNSPECIFIED, sw-addrmethod=VAR_POWER_ON_INIT
        VAR_CLEARED_MC_SHARED_UNSPECIFIED: alignment=UNSPECIFIED, sw-addrmethod=VAR_CLEARED
        VAR_POWER_ON_INIT_UNSPECIFIED: alignment=UNSPECIFIED, sw-addrmethod=VAR_POWER_ON_INIT
        VAR_INIT_8: alignment=8, sw-addrmethod=VAR_INIT
        VAR_INIT_MC_SHARED_16: alignment=16, sw-addrmethod=VAR_INIT
        VAR_CLEARED_8: alignment=8, sw-addrmethod=VAR_CLEARED
        VAR_CLEARED_APPL_DATA_UNSPECIFIED: alignment=UNSPECIFIED, sw-addrmethod=VAR_CLEARED
        VAR_INIT_16: alignment=16, sw-addrmethod=VAR_INIT
        VAR_CLEARED_16: alignment=16, sw-addrmethod=VAR_CLEARED
        VAR_CLEARED_32: alignment=32, sw-addrmethod=VAR_CLEARED
        VAR_INIT_UNSPECIFIED: alignment=UNSPECIFIED, sw-addrmethod=VAR_INIT
        VAR_CLEARED_64: alignment=64, sw-addrmethod=VAR_CLEARED
        VAR_CLEARED_UNSPECIFIED: alignment=UNSPECIFIED, sw-addrmethod=VAR_CLEARED
        CONFIG_DATA_8: alignment=8, sw-addrmethod=CONFIG_DATA
        CONFIG_DATA_16: alignment=16, sw-addrmethod=CONFIG_DATA
        CONFIG_DATA_UNSPECIFIED: alignment=UNSPECIFIED, sw-addrmethod=CONFIG_DATA
        CONFIG_DATA_MC_SHARED_UNSPECIFIED: alignment=UNSPECIFIED, sw-addrmethod=CONFIG_DATA
        VAR_INIT_32: alignment=32, sw-addrmethod=VAR_INIT
        VAR_CLEARED_MC_SHARED_16: alignment=16, sw-addrmethod=VAR_CLEARED
