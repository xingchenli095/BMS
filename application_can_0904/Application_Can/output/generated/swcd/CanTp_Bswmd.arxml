AUTOSAR XML (schema 4-0-3)
package /AUTOSAR_CanTp/BswModuleDescriptions
  bsw module description CanTp: module-id=35, provided-entrys=CanTp_MainFunction
    bsw internal behavior InternalBehavior_0
      exclusive area SCHM_CANTP_EXCLUSIVE_AREA_0
      bsw schedulable entity CanTp_MainFunction: can-enter-exclusive-area=SCHM_CANTP_EXCLUSIVE_AREA_0, implemented-entry=CanTp_MainFunction
      bsw timing event TimingEvent_MainFunction: starts-on-event=CanTp_MainFunction, period=0.005
package /AUTOSAR_CanTp/BswModuleEntrys
  bsw module entry CanTp_MainFunction: service-id=0x06, is-reentrant=false, is-synchronous=true, call-type=SCHEDULED, execution-context=TASK, sw-service-impl-policy=STANDARD
package /AUTOSAR_CanTp/ImplementationDataTypes
  impl type CanTp_ULIndicationType: compu {0=CANTP_ULIND_NONE, 1=CANTP_ULIND_STATUS}, implementation-data-type=uint32, type-emitter=BSW
  impl type CanTp_ChStateType: implementation-data-type=uint8, type-emitter=BSW
package /EB_CanTp/Implementations
  bsw implementation BswImplementation_0: programming-language=C, sw-version=6.8.52, vendor-id=1, ar-release-version=4.0.3, behavior=InternalBehavior_0, vendor-specific-module-def=CanTp
    code-descriptors:
      code Files
        artifact-descriptors:
          short-label=Autosar::include::CanTp.h, category=SWHDR
          short-label=Autosar::include::CanTp_Api.h, category=SWHDR
          short-label=Autosar::include::CanTp_Cbk.h, category=SWHDR
          short-label=Autosar::include::CanTp_EntryTableApi.h, category=SWHDR
          short-label=Autosar::include::CanTp_EntryTableCbk.h, category=SWHDR
          short-label=Autosar::include::CanTp_Internal.h, category=SWHDR
          short-label=Autosar::include::CanTp_InternalLib.h, category=SWHDR
          short-label=Autosar::include::CanTp_Trace.h, category=SWHDR
          short-label=Autosar::include::CanTp_Trace_Internal.h, category=SWHDR
          short-label=Autosar::include::CanTp_Types.h, category=SWHDR
          short-label=Autosar::include::CanTp_Version.h, category=SWHDR
          short-label=Autosar::src::CanTp.c, category=SWSRC
          short-label=Autosar::src::CanTp_CancelReceive.c, category=SWSRC
          short-label=Autosar::src::CanTp_CancelTransmit.c, category=SWSRC
          short-label=Autosar::src::CanTp_ChangeParameter.c, category=SWSRC
          short-label=Autosar::src::CanTp_GetNSa.c, category=SWSRC
          short-label=Autosar::src::CanTp_GetVersionInfo.c, category=SWSRC
          short-label=Autosar::src::CanTp_Init.c, category=SWSRC
          short-label=Autosar::src::CanTp_MainFunction.c, category=SWSRC
          short-label=Autosar::src::CanTp_Merged.c, category=SWSRC
          short-label=Autosar::src::CanTp_PrepareFC.c, category=SWSRC
          short-label=Autosar::src::CanTp_PreparexF.c, category=SWSRC
          short-label=Autosar::src::CanTp_ReadParameter.c, category=SWSRC
          short-label=Autosar::src::CanTp_RxBufferDependentSend.c, category=SWSRC
          short-label=Autosar::src::CanTp_RxIndication.c, category=SWSRC
          short-label=Autosar::src::CanTp_STminCallback.c, category=SWSRC
          short-label=Autosar::src::CanTp_SetNSa.c, category=SWSRC
          short-label=Autosar::src::CanTp_StopChannel.c, category=SWSRC
          short-label=Autosar::src::CanTp_Transmit.c, category=SWSRC
          short-label=Autosar::src::CanTp_TransmitFrame.c, category=SWSRC
          short-label=Autosar::src::CanTp_TxBufferDependentSend.c, category=SWSRC
          short-label=Autosar::src::CanTp_TxConfirmation.c, category=SWSRC
          short-label=Autosar::src::CanTp_UnlockChannel.c, category=SWSRC
          short-label=make::CanTp_defs.mak, category=SWMAKE
          short-label=make::CanTp_rules.mak, category=SWMAKE
    resource consumption ResourceConsumption
      12 x memory section:
        CONST_ENTRY_JUMP_TABLE_UNSPECIFIED: alignment=UNSPECIFIED, sw-addrmethod=CONST
        CONST_UNSPECIFIED: alignment=UNSPECIFIED, sw-addrmethod=CONST
        CONST_EXIT_JUMP_TABLE_UNSPECIFIED: alignment=UNSPECIFIED, sw-addrmethod=CONST
        VAR_INIT_JUMP_TABLE_SHARED_UNSPECIFIED: alignment=UNSPECIFIED, sw-addrmethod=VAR_INIT
        VAR_CLEARED_8: alignment=8, sw-addrmethod=VAR_CLEARED
        VAR_CLEARED_16: alignment=16, sw-addrmethod=VAR_CLEARED
        VAR_CLEARED_UNSPECIFIED: alignment=UNSPECIFIED, sw-addrmethod=VAR_CLEARED
        CONFIG_DATA_UNSPECIFIED: alignment=UNSPECIFIED, sw-addrmethod=CONFIG_DATA
        VAR_INIT_UNSPECIFIED: alignment=UNSPECIFIED, sw-addrmethod=VAR
        CODE: sw-addrmethod=CODE
        CONST_32: alignment=32, sw-addrmethod=CONST
        CODE_CC_BLOCK: alignment=UNSPECIFIED, sw-addrmethod=CODE
