AUTOSAR XML (schema 4-2-1)
package /AUTOSAR_Dcm/ImplementationDataTypes
  35 x impl type:
    Dcm_SecLevelType: compu {1=DcmConf_DcmDspSecurity_Level_1, 2=DcmConf_DcmDspSecurity_Level_3}, implementation-data-type=uint8
    Dcm_SesCtrlType: compu {1=DcmConf_DcmDspSession_Default, 2=DcmConf_DcmDspSession_Programming, 3=DcmConf_DcmDspSession_Extended}, implementation-data-type=uint8
    Dcm_ProtocolType: compu {0=DCM_OBD_ON_CAN, 1=DCM_OBD_ON_FLEXRAY, 2=DCM_OBD_ON_IP, 3=DCM_UDS_ON_CAN, 4=DCM_UDS_ON_FLEXRAY, 5=DCM_UDS_ON_IP, 6=DCM_ROE_ON_CAN, 7=DCM_ROE_ON_FLEXRAY, 8=DCM_ROE_ON_IP, 9=DCM_PERIODICTRANS_ON_CAN, 10=DCM_PERIODICTRANS_ON_FLEXRAY, 11=DCM_PERIODICTRANS_ON_IP, 12=DCM_NO_ACTIVE_PROTOCOL, 240..254=DCM_SUPPLIER_1..DCM_SUPPLIER_15}, implementation-data-type=uint8
    Dcm_OpStatusType: compu {0=DCM_INITIAL, 1=DCM_PENDING, 2=DCM_CANCEL, 3=DCM_FORCE_RCRRP_OK}, implementation-data-type=uint8
    Dcm_ConfirmationStatusType: compu {0=DCM_RES_POS_OK, 1=DCM_RES_POS_NOT_OK, 2=DCM_RES_NEG_OK, 3=DCM_RES_NEG_NOT_OK}, implementation-data-type=uint8
    Dcm_NegativeResponseCodeType: compu {0=DCM_E_POSITIVERESPONSE, 16=DCM_E_GENERALREJECT, 17=DCM_E_SERVICENOTSUPPORTED, 18=DCM_E_SUBFUNCTIONNOTSUPPORTED, 19=DCM_E_INCORRECTMESSAGELENGTHORINVALIDFORMAT, 20=DCM_E_RESPONSETOOLONG, 33=DCM_E_BUSYREPEATREQUEST, 34=DCM_E_CONDITIONSNOTCORRECT, 36=DCM_E_REQUESTSEQUENCEERROR, 37=DCM_E_NORESPONSEFROMSUBNETCOMPONENT, 38=DCM_E_FAILUREPREVENTSEXECUTIONOFREQUESTEDACTION, 49=DCM_E_REQUESTOUTOFRANGE, 51=DCM_E_SECURITYACCESSDENIED, 52=DCM_E_AUTHENTICATIONREQUIRED, 53=DCM_E_INVALIDKEY, 54=DCM_E_EXCEEDNUMBEROFATTEMPTS, 55=DCM_E_REQUIREDTIMEDELAYNOTEXPIRED, 80=DCM_E_CERTIFICATEVERIFICATIONFAILEDINVALIDTIMEPERIOD, 81=DCM_E_CERTIFICATEVERIFICATIONFAILEDINVALIDSIGNATURE, 82=DCM_E_CERTIFICATEVERIFICATIONFAILEDINVALIDCHAINOFTRUST, 83=DCM_E_CERTIFICATEVERIFICATIONFAILEDINVALIDTYPE, 84=DCM_E_CERTIFICATEVERIFICATIONFAILEDINVALIDFORMAT, 85=DCM_E_CERTIFICATEVERIFICATIONFAILEDINVALIDCONTENT, 86=DCM_E_CERTIFICATEVERIFICATIONFAILEDINVALIDSCOPE, 87=DCM_E_CERTIFICATEVERIFICATIONFAILEDREVOKED, 88=DCM_E_OWNERSHIPVERIFICATIONFAILED, 112=DCM_E_UPLOADDOWNLOADNOTACCEPTED, 113=DCM_E_TRANSFERDATASUSPENDED, 114=DCM_E_GENERALPROGRAMMINGFAILURE, 115=DCM_E_WRONGBLOCKSEQUENCECOUNTER, 120=DCM_E_REQUESTCORRECTLYRECEIVEDRESPONSEPENDING, 126=DCM_E_SUBFUNCTIONNOTSUPPORTEDINACTIVESESSION, 127=DCM_E_SERVICENOTSUPPORTEDINACTIVESESSION, 129=DCM_E_RPMTOOHIGH, 130=DCM_E_RPMTOOLOW, 131=DCM_E_ENGINEISRUNNING, 132=DCM_E_ENGINEISNOTRUNNING, 133=DCM_E_ENGINERUNTIMETOOLOW, 134=DCM_E_TEMPERATURETOOHIGH, 135=DCM_E_TEMPERATURETOOLOW, 136=DCM_E_VEHICLESPEEDTOOHIGH, 137=DCM_E_VEHICLESPEEDTOOLOW, 138=DCM_E_THROTTLE_PEDALTOOHIGH, 139=DCM_E_THROTTLE_PEDALTOOLOW, 140=DCM_E_TRANSMISSIONRANGENOTINNEUTRAL, 141=DCM_E_TRANSMISSIONRANGENOTINGEAR, 143=DCM_E_BRAKESWITCH_NOTCLOSED, 144=DCM_E_SHIFTERLEVERNOTINPARK, 145=DCM_E_TORQUECONVERTERCLUTCHLOCKED, 146=DCM_E_VOLTAGETOOHIGH, 147=DCM_E_VOLTAGETOOLOW}, implementation-data-type=uint8
    Dcm_SecAccDataRecLevel_1_ArrayType: category=ARRAY
      element AuxU8_Dcm_SecAccDataRecLevel_1_ArrayType: array-size=4, array-size-semantics=FIXED-SIZE, implementation-data-type=uint8
    Dcm_SecSeedLevel_1_ArrayType: category=ARRAY
      element AuxU8_Dcm_SecSeedLevel_1_ArrayType: array-size=8, array-size-semantics=FIXED-SIZE, implementation-data-type=uint8
    Dcm_SecKeyLevel_1_ArrayType: category=ARRAY
      element AuxU8_Dcm_SecKeyLevel_1_ArrayType: array-size=4, array-size-semantics=FIXED-SIZE, implementation-data-type=uint8
    Dcm_SecAccDataRecLevel_3_ArrayType: category=ARRAY
      element AuxU8_Dcm_SecAccDataRecLevel_3_ArrayType: array-size=4, array-size-semantics=FIXED-SIZE, implementation-data-type=uint8
    Dcm_SecSeedLevel_3_ArrayType: category=ARRAY
      element AuxU8_Dcm_SecSeedLevel_3_ArrayType: array-size=8, array-size-semantics=FIXED-SIZE, implementation-data-type=uint8
    Dcm_SecKeyLevel_3_ArrayType: category=ARRAY
      element AuxU8_Dcm_SecKeyLevel_3_ArrayType: array-size=4, array-size-semantics=FIXED-SIZE, implementation-data-type=uint8
    DataArrayTypeUint8_Session: category=ARRAY
      element AuxU8_Dcm_DataSession_ArrayType: array-size=1, array-size-semantics=FIXED-SIZE, implementation-data-type=uint8
    Dcm_DataSession_ArrayType: category=ARRAY
      element AuxU8_Dcm_DataSession_ArrayType: array-size=1, array-size-semantics=FIXED-SIZE, implementation-data-type=uint8
    DataArrayTypeUint8_NvM_Dummy: category=ARRAY
      element AuxU8_Dcm_DataNvM_Dummy_ArrayType: array-size=17, array-size-semantics=FIXED-SIZE, implementation-data-type=uint8
    Dcm_DataNvM_Dummy_ArrayType: category=ARRAY
      element AuxU8_Dcm_DataNvM_Dummy_ArrayType: array-size=17, array-size-semantics=FIXED-SIZE, implementation-data-type=uint8
    DataArrayTypeUint8_Vehicle_Identification_Number: category=ARRAY
      element AuxU8_Dcm_DataVehicle_Identification_Number_ArrayType: array-size=17, array-size-semantics=FIXED-SIZE, implementation-data-type=uint8
    Dcm_DataVehicle_Identification_Number_ArrayType: category=ARRAY
      element AuxU8_Dcm_DataVehicle_Identification_Number_ArrayType: array-size=17, array-size-semantics=FIXED-SIZE, implementation-data-type=uint8
    Dcm_DidSupportedType: compu {0=DCM_DID_SUPPORTED, 1=DCM_DID_NOT_SUPPORTED}, implementation-data-type=uint8
    Dcm_StartFlexibleInArrayData_DIAGNOSTIC_LOOPBACK_DcmDspStartRoutineInSignal_dataInType: category=ARRAY
      element AuxU8_Dcm_StartFlexibleInArrayData_DIAGNOSTIC_LOOPBACK_DcmDspStartRoutineInSignal_dataInType: array-size=1024, array-size-semantics=FIXED-SIZE, implementation-data-type=uint8
    DcmDspRoutineInfo_256_DcmDspStartRoutineInSignal_ArrayType: category=ARRAY
      element AuxU8_DcmDspRoutineInfo_256_DcmDspStartRoutineInSignal_ArrayType: array-size=1024, array-size-semantics=FIXED-SIZE, implementation-data-type=uint8
    StartFlexibleInArrayDataType_DIAGNOSTIC_LOOPBACK_DcmDspStartRoutineInSignal_dataIn: category=ARRAY
      element AuxU8_StartFlexibleInArrayDataType_DIAGNOSTIC_LOOPBACK_DcmDspStartRoutineInSignal_dataIn: array-size=1024, array-size-semantics=FIXED-SIZE, implementation-data-type=uint8
    Dcm_StartFlexibleOutArrayData_DIAGNOSTIC_LOOPBACK_DcmDspStartRoutineOutSignal_dataOutType: category=ARRAY
      element AuxU8_Dcm_StartFlexibleOutArrayData_DIAGNOSTIC_LOOPBACK_DcmDspStartRoutineOutSignal_dataOutType: array-size=1024, array-size-semantics=FIXED-SIZE, implementation-data-type=uint8
    DcmDspRoutineInfo_256_DcmDspStartRoutineOutSignal_ArrayType: category=ARRAY
      element AuxU8_DcmDspRoutineInfo_256_DcmDspStartRoutineOutSignal_ArrayType: array-size=1024, array-size-semantics=FIXED-SIZE, implementation-data-type=uint8
    StartFlexibleOutArrayDataType_DIAGNOSTIC_LOOPBACK_DcmDspStartRoutineOutSignal_dataOut: category=ARRAY
      element AuxU8_StartFlexibleOutArrayDataType_DIAGNOSTIC_LOOPBACK_DcmDspStartRoutineOutSignal_dataOut: array-size=1024, array-size-semantics=FIXED-SIZE, implementation-data-type=uint8
    Dcm_StartDataIn_DIAGNOSTIC_TRIGGER_DTC_routineInfo_InPrimitivType: implementation-data-type=uint8
    Dcm_StartDataIn_DIAGNOSTIC_TRIGGER_DTC_routineInfo_InType: implementation-data-type=Dcm_StartDataIn_DIAGNOSTIC_TRIGGER_DTC_routineInfo_InPrimitivType
    StartDataInType_DIAGNOSTIC_TRIGGER_DTC_routineInfo_In: implementation-data-type=uint8
    Dcm_StartDataOut_DIAGNOSTIC_TRIGGER_DTC_routineInfo_OutPrimitivType: implementation-data-type=uint8
    Dcm_StartDataOut_DIAGNOSTIC_TRIGGER_DTC_routineInfo_OutType: implementation-data-type=Dcm_StartDataOut_DIAGNOSTIC_TRIGGER_DTC_routineInfo_OutPrimitivType
    StartDataOutType_DIAGNOSTIC_TRIGGER_DTC_routineInfo_Out: implementation-data-type=uint8
    Dcm_RequestData_ArrayType: category=ARRAY
      element AuxU8_Dcm_RequestData_ArrayType: array-size=1028, array-size-semantics=FIXED-SIZE, implementation-data-type=uint8
    Dcm_Uint8PtrDataType: category=DATA_REFERENCE, sw-pointer-target-props={target-category=TYPE_REFERENCE, implementation-data-type=uint8}
    InfoTypeServicesArrayType_Service09_VinMessageCount: category=ARRAY
      element AuxU8_InfoTypeServicesArrayType_Service09_VinMessageCount: array-size=1, array-size-semantics=FIXED-SIZE, implementation-data-type=uint8
    InfoTypeServicesArrayType_Service09_VehicleIdentificationNumber: category=ARRAY
      element AuxU8_InfoTypeServicesArrayType_Service09_VehicleIdentificationNumber: array-size=17, array-size-semantics=FIXED-SIZE, implementation-data-type=uint8
package /AUTOSAR_Dcm/PortInterfaces
  10 x client server interface, all with is-service=true:
    DCMServices
      4 x operation, all with possible-error=DCMServices/E_NOT_OK:
        GetSecurityLevel
          arg SecLevel: type=Dcm_SecLevelType, direction=OUT
        GetSesCtrlType
          arg SesCtrlType: type=Dcm_SesCtrlType, direction=OUT
        GetActiveProtocol
          arg ActiveProtocol: type=Dcm_ProtocolType, direction=OUT
        ResetToDefaultSession
      error E_NOT_OK: error-code=1
    DCM_Roe
      operation TriggerOnEvent: possible-error=DCM_Roe/E_NOT_OK
      error E_NOT_OK: error-code=1
    SecurityAccess_Level_1
      operation GetSeed: possible-error=[SecurityAccess_Level_1/E_NOT_OK, SecurityAccess_Level_1/DCM_E_PENDING]
        4 x arg:
          SecurityAccessDataRecord: type=Dcm_SecAccDataRecLevel_1_ArrayType, direction=IN
          OpStatus: type=Dcm_OpStatusType, direction=IN
          Seed: type=Dcm_SecSeedLevel_1_ArrayType, direction=OUT
          ErrorCode: type=Dcm_NegativeResponseCodeType, direction=OUT
      operation CompareKey: possible-error=[SecurityAccess_Level_1/E_NOT_OK, SecurityAccess_Level_1/DCM_E_PENDING, SecurityAccess_Level_1/DCM_E_COMPARE_KEY_FAILED]
        arg Key: type=Dcm_SecKeyLevel_1_ArrayType, direction=IN
        arg OpStatus: type=Dcm_OpStatusType, direction=IN
        arg ErrorCode: type=Dcm_NegativeResponseCodeType, direction=OUT
      error E_NOT_OK: error-code=1
      error DCM_E_PENDING: error-code=10
      error DCM_E_COMPARE_KEY_FAILED: error-code=11
    SecurityAccess_Level_3
      operation GetSeed: possible-error=[SecurityAccess_Level_3/E_NOT_OK, SecurityAccess_Level_3/DCM_E_PENDING]
        4 x arg:
          SecurityAccessDataRecord: type=Dcm_SecAccDataRecLevel_3_ArrayType, direction=IN
          OpStatus: type=Dcm_OpStatusType, direction=IN
          Seed: type=Dcm_SecSeedLevel_3_ArrayType, direction=OUT
          ErrorCode: type=Dcm_NegativeResponseCodeType, direction=OUT
      operation CompareKey: possible-error=[SecurityAccess_Level_3/E_NOT_OK, SecurityAccess_Level_3/DCM_E_PENDING, SecurityAccess_Level_3/DCM_E_COMPARE_KEY_FAILED]
        arg Key: type=Dcm_SecKeyLevel_3_ArrayType, direction=IN
        arg OpStatus: type=Dcm_OpStatusType, direction=IN
        arg ErrorCode: type=Dcm_NegativeResponseCodeType, direction=OUT
      error E_NOT_OK: error-code=1
      error DCM_E_PENDING: error-code=10
      error DCM_E_COMPARE_KEY_FAILED: error-code=11
    ServiceRequestNotification
      operation Indication: possible-error=[ServiceRequestNotification/E_NOT_OK, E_REQUEST_NOT_ACCEPTED]
        6 x arg:
          SID: type=uint8, direction=IN
          RequestData: type=Dcm_RequestData_ArrayType, direction=IN
          DataSize: type=uint16, direction=IN
          ReqType: type=uint8, direction=IN
          SourceAddress: type=uint16, direction=IN
          ErrorCode: type=Dcm_NegativeResponseCodeType, direction=OUT
      operation Confirmation: possible-error=ServiceRequestNotification/E_NOT_OK
        4 x arg, all with direction=IN:
          SID: type=uint8
          ReqType: type=uint8
          SourceAddress: type=uint16
          ConfirmationStatus: type=Dcm_ConfirmationStatusType
      error E_NOT_OK: error-code=1
      error E_REQUEST_NOT_ACCEPTED: error-code=8
    CallbackDCMRequestServices
      operation StartProtocol: possible-error=[CallbackDCMRequestServices/E_NOT_OK, E_PROTOCOL_NOT_ALLOWED]
        arg ProtocolID: type=Dcm_ProtocolType, direction=IN
      operation StopProtocol: possible-error=CallbackDCMRequestServices/E_NOT_OK
        arg ProtocolID: type=Dcm_ProtocolType, direction=IN
      error E_NOT_OK: error-code=1
      error E_PROTOCOL_NOT_ALLOWED: error-code=5
    RoutineServices_DIAGNOSTIC_LOOPBACK
      operation Start: possible-error=[RoutineServices_DIAGNOSTIC_LOOPBACK/E_NOT_OK, RoutineServices_DIAGNOSTIC_LOOPBACK/DCM_E_PENDING, RoutineServices_DIAGNOSTIC_LOOPBACK/DCM_E_FORCE_RCRRP]
        5 x arg:
          dataIn0: type=Dcm_StartFlexibleInArrayData_DIAGNOSTIC_LOOPBACK_DcmDspStartRoutineInSignal_dataInType, direction=IN
          OpStatus: type=Dcm_OpStatusType, direction=IN
          dataOut0: type=Dcm_StartFlexibleOutArrayData_DIAGNOSTIC_LOOPBACK_DcmDspStartRoutineOutSignal_dataOutType, direction=OUT
          currentDataLength: type=uint16, direction=INOUT
          ErrorCode: type=Dcm_NegativeResponseCodeType, direction=OUT
      error E_NOT_OK: error-code=1
      error DCM_E_PENDING: error-code=10
      error DCM_E_FORCE_RCRRP: error-code=12
    RoutineServices_DIAGNOSTIC_TRIGGER_DTC
      operation Start: possible-error=[RoutineServices_DIAGNOSTIC_TRIGGER_DTC/E_NOT_OK, RoutineServices_DIAGNOSTIC_TRIGGER_DTC/DCM_E_PENDING, RoutineServices_DIAGNOSTIC_TRIGGER_DTC/DCM_E_FORCE_RCRRP]
        4 x arg:
          dataIn0: type=Dcm_StartDataIn_DIAGNOSTIC_TRIGGER_DTC_routineInfo_InType, direction=IN
          OpStatus: type=Dcm_OpStatusType, direction=IN
          dataOut0: type=Dcm_StartDataOut_DIAGNOSTIC_TRIGGER_DTC_routineInfo_OutType, direction=OUT
          ErrorCode: type=Dcm_NegativeResponseCodeType, direction=OUT
      error E_NOT_OK: error-code=1
      error DCM_E_PENDING: error-code=10
      error DCM_E_FORCE_RCRRP: error-code=12
    InfotypeServices_Service09_VinMessageCount
      operation GetInfotypeValueData: possible-error=[InfotypeServices_Service09_VinMessageCount/E_NOT_OK, InfotypeServices_Service09_VinMessageCount/DCM_E_PENDING]
        arg OpStatus: type=Dcm_OpStatusType, direction=IN
        arg DataValueBuffer: type=InfoTypeServicesArrayType_Service09_VinMessageCount, direction=OUT
      error E_NOT_OK: error-code=1
      error DCM_E_PENDING: error-code=10
    InfotypeServices_Service09_VehicleIdentificationNumber
      operation GetInfotypeValueData: possible-error=[InfotypeServices_Service09_VehicleIdentificationNumber/E_NOT_OK, InfotypeServices_Service09_VehicleIdentificationNumber/DCM_E_PENDING]
        arg OpStatus: type=Dcm_OpStatusType, direction=IN
        arg DataValueBuffer: type=InfoTypeServicesArrayType_Service09_VehicleIdentificationNumber, direction=OUT
      error E_NOT_OK: error-code=1
      error DCM_E_PENDING: error-code=10
