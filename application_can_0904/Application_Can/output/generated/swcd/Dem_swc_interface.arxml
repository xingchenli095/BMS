AUTOSAR XML (schema 4-0-3)
package /AUTOSAR_Dem/CompuMethods
  compu method CM_EventStatusExtendedType: 1=DEM_UDS_STATUS_TF, 2=DEM_UDS_STATUS_TFTOC, 4=DEM_UDS_STATUS_PDTC, 8=DEM_UDS_STATUS_CDTC, 16=DEM_UDS_STATUS_TNCSLC, 32=DEM_UDS_STATUS_TFSLC, 64=DEM_UDS_STATUS_TNCTOC, 128=DEM_UDS_STATUS_WIR
package /AUTOSAR_Dem/ImplementationDataTypes
  15 x impl type:
    Dem_EventIdType:
      compu {1=DemConf_DemEventParameter_DTC_0x000001_Event, 2=DemConf_DemEventParameter_Permanent_DTC, 3=DemConf_DemEventParameter_CANSM_E_BUS_OFF_0, 4=DemConf_DemEventParameter_WDGM_E_MONITORING, 5=DemConf_DemEventParameter_WDGM_E_SET_MODE, 6=DemConf_DemEventParameter_WDGM_E_DATA_CORRUPTION, 7=DemConf_DemEventParameter_ECUM_E_RAM_CHECK_FAILED, 8=DemConf_DemEventParameter_MCU_E_CLOCK_FAILURE, 9=DemConf_DemEventParameter_WDGM_E_MF_TIMINGVIOLATION, 10=DemConf_DemEventParameter_DTC_0x000002_Event, 11=DemConf_DemEventParameter_USER_DEFINE_MEMORY_Event, 12=DemConf_DemEventParameter_MCU_E_TIMEOUT_FAILURE, 13=DemConf_DemEventParameter_MCU_E_INVALIDFXOSC_CONFIG, 14=DemConf_DemEventParameter_MCU_E_CLOCKMUXSWITCH_FAILURE}
      range raw 1..14
      implementation-data-type=uint16
    Dem_EventStatusType: compu {0=DEM_EVENT_STATUS_PASSED, 1=DEM_EVENT_STATUS_FAILED, 2=DEM_EVENT_STATUS_PREPASSED, 3=DEM_EVENT_STATUS_PREFAILED}, range raw 0..3, implementation-data-type=uint8
    Dem_DebounceResetStatusType: compu {0=DEM_DEBOUNCE_STATUS_FREEZE, 1=DEM_DEBOUNCE_STATUS_RESET}, range raw 0..1, implementation-data-type=uint8
    Dem_EventStatusExtendedType: compu-method=CM_EventStatusExtendedType, implementation-data-type=uint8
    Dem_UdsStatusByteType: compu-method=CM_EventStatusExtendedType, implementation-data-type=uint8
    Dem_DebouncingStateType: compu {1=DEM_TEMPORARILY_DEFECTIVE, 2=DEM_FINALY_DEFECTIVE, 4=DEM_TEMPORARILY_HEALED, 8=DEM_TEST_COMPLETE, 16=DEM_DTR_UPDATE}, implementation-data-type=uint8
    Dem_DTCOriginType: compu {1=DEM_DTC_ORIGIN_PRIMARY_MEMORY, 2=DEM_DTC_ORIGIN_MIRROR_MEMORY, 3=DEM_DTC_ORIGIN_PERMANENT_MEMORY, 4=DEM_DTC_ORIGIN_SECONDARY_MEMORY, 257=DEM_DTC_ORIGIN_USERDEFINED_MEMORY_MAPPED_TO_SECONDARY}, range raw 1..511, implementation-data-type=uint16
    Dem_DTCFormatType: compu {0=DEM_DTC_FORMAT_OBD, 1=DEM_DTC_FORMAT_UDS, 2=DEM_DTC_FORMAT_J1939}, range raw 0..2, implementation-data-type=uint8
    Dem_InitMonitorReasonType: compu {1=DEM_INIT_MONITOR_CLEAR, 2=DEM_INIT_MONITOR_RESTART}, range raw 1..2, implementation-data-type=uint8
    Dem_OperationCycleStateType: compu {0=DEM_CYCLE_STATE_START, 1=DEM_CYCLE_STATE_END}, range raw 0..1, implementation-data-type=uint8
    Dem_DTCStatusMaskType: implementation-data-type=uint8
    Dem_IndicatorStatusType: compu {0=DEM_INDICATOR_OFF, 1=DEM_INDICATOR_CONTINUOUS, 2=DEM_INDICATOR_BLINKING, 3=DEM_INDICATOR_BLINK_CONT, 4=DEM_INDICATOR_SLOW_FLASH, 5=DEM_INDICATOR_FAST_FLASH}, range raw 0..5, implementation-data-type=uint8
    Dem_MaxDataValueType: category=ARRAY
      element Dem_MaxDataValueElement: array-size=7, array-size-semantics=FIXED-SIZE, implementation-data-type=uint8
    DataArrayType_DemExternalCSDataElementClass_Session: category=ARRAY
      element Dem_DataDemExternalCSDataElementClass_Session_ArrayElement: array-size=1, array-size-semantics=FIXED-SIZE, implementation-data-type=uint8
    DataArrayType_DemExternalCSDataElementClass_ExtDataRec_0x01: category=ARRAY
      element Dem_DataDemExternalCSDataElementClass_ExtDataRec_0x01_ArrayElement: array-size=7, array-size-semantics=FIXED-SIZE, implementation-data-type=uint8
package /AUTOSAR_Dem/PortInterfaces
  29 x client server interface, all with is-service=true:
    DiagnosticMonitor
      6 x operation, all with possible-error=DiagnosticMonitor/E_NOT_OK:
        SetEventStatus
          arg EventStatus: type=Dem_EventStatusType, direction=IN
        ResetEventStatus
        ResetEventDebounceStatus
          arg DebounceResetStatus: type=Dem_DebounceResetStatusType, direction=IN
        PrestoreFreezeFrame
        ClearPrestoredFreezeFrame
        SetEventDisabled
      error E_NOT_OK: error-code=1
    DiagnosticInfo
      10 x operation:
        GetEventStatus: possible-error=DiagnosticInfo/E_NOT_OK
          arg EventStatusExtended: type=Dem_EventStatusExtendedType, direction=OUT
        GetEventFailed: possible-error=DiagnosticInfo/E_NOT_OK
          arg EventFailed: type=boolean, direction=OUT
        GetEventTested: possible-error=DiagnosticInfo/E_NOT_OK
          arg EventTested: type=boolean, direction=OUT
        GetDTCOfEvent: possible-error=[DiagnosticInfo/E_NOT_OK, DiagnosticInfo/DEM_E_NO_DTC_AVAILABLE]
          arg DTCFormat: type=Dem_DTCFormatType, direction=IN
          arg DTCOfEvent: type=uint32, direction=OUT
        GetFaultDetectionCounter: possible-error=DiagnosticInfo/E_NOT_OK
          arg FaultDetectionCounter: type=sint8, direction=OUT
        GetEventFreezeFrameData: possible-error=[DiagnosticInfo/DEM_E_NODATAAVAILABLE, DiagnosticInfo/DEM_E_WRONG_RECORDNUMBER, DiagnosticInfo/DEM_E_WRONG_DIDNUMBER]
          4 x arg:
            RecordNumber: type=uint8, direction=IN
            ReportTotalRecord: type=boolean, direction=IN
            DataId: type=uint16, direction=IN
            DestBuffer: type=Dem_MaxDataValueType, direction=OUT
        GetEventExtendedDataRecord: possible-error=DiagnosticInfo/E_NOT_OK
          arg RecordNumber: type=uint8, direction=IN
          arg DestBuffer: type=Dem_MaxDataValueType, direction=OUT
        GetDebouncingOfEvent: possible-error=DiagnosticInfo/E_NOT_OK
          arg DebouncingState: type=Dem_DebouncingStateType, direction=OUT
        GetEventExtendedDataRecordEx: possible-error=[DiagnosticInfo/E_NOT_OK, DiagnosticInfo/DEM_E_NODATAAVAILABLE, DiagnosticInfo/DEM_E_WRONG_RECORDNUMBER, DiagnosticInfo/DEM_E_WRONG_BUFFERSIZE]
          arg RecordNumber: type=uint8, direction=IN
          arg DestBuffer: type=uint8, direction=OUT
          arg BufSize: type=uint16, direction=INOUT
        GetEventFreezeFrameDataEx: possible-error=[DiagnosticInfo/E_NOT_OK, DiagnosticInfo/DEM_E_NODATAAVAILABLE, DiagnosticInfo/DEM_E_WRONG_RECORDNUMBER, DiagnosticInfo/DEM_E_WRONG_DIDNUMBER, DiagnosticInfo/DEM_E_WRONG_BUFFERSIZE]
          4 x arg:
            RecordNumber: type=uint8, direction=IN
            DataId: type=uint16, direction=IN
            DestBuffer: type=uint8, direction=OUT
            BufSize: type=uint16, direction=INOUT
      7 x error:
        E_NOT_OK: error-code=1
        DEM_E_NO_DTC_AVAILABLE: error-code=2
        DEM_E_NO_FDC_AVAILABLE: error-code=3
        DEM_E_WRONG_BUFFERSIZE: error-code=21
        DEM_E_NODATAAVAILABLE: error-code=48
        DEM_E_WRONG_RECORDNUMBER: error-code=49
        DEM_E_WRONG_DIDNUMBER: error-code=50
    GeneralDiagnosticInfo
      10 x operation:
        GetEventStatus: possible-error=GeneralDiagnosticInfo/E_NOT_OK
          arg EventId: type=Dem_EventIdType, direction=IN
          arg EventStatusExtended: type=Dem_EventStatusExtendedType, direction=OUT
        GetEventFailed: possible-error=GeneralDiagnosticInfo/E_NOT_OK
          arg EventId: type=Dem_EventIdType, direction=IN
          arg EventFailed: type=boolean, direction=OUT
        GetEventTested: possible-error=GeneralDiagnosticInfo/E_NOT_OK
          arg EventId: type=Dem_EventIdType, direction=IN
          arg EventTested: type=boolean, direction=OUT
        GetDTCOfEvent: possible-error=[GeneralDiagnosticInfo/E_NOT_OK, GeneralDiagnosticInfo/DEM_E_NO_DTC_AVAILABLE]
          arg EventId: type=Dem_EventIdType, direction=IN
          arg DTCFormat: type=Dem_DTCFormatType, direction=IN
          arg DTCOfEvent: type=uint32, direction=OUT
        GetFaultDetectionCounter: possible-error=GeneralDiagnosticInfo/E_NOT_OK
          arg EventId: type=Dem_EventIdType, direction=IN
          arg FaultDetectionCounter: type=sint8, direction=OUT
        GetEventFreezeFrameData: possible-error=[GeneralDiagnosticInfo/DEM_E_NODATAAVAILABLE, GeneralDiagnosticInfo/DEM_E_WRONG_RECORDNUMBER, GeneralDiagnosticInfo/DEM_E_WRONG_DIDNUMBER]
          5 x arg:
            EventId: type=Dem_EventIdType, direction=IN
            RecordNumber: type=uint8, direction=IN
            ReportTotalRecord: type=boolean, direction=IN
            DataId: type=uint16, direction=IN
            DestBuffer: type=Dem_MaxDataValueType, direction=OUT
        GetEventExtendedDataRecord: possible-error=GeneralDiagnosticInfo/E_NOT_OK
          arg EventId: type=Dem_EventIdType, direction=IN
          arg RecordNumber: type=uint8, direction=IN
          arg DestBuffer: type=Dem_MaxDataValueType, direction=OUT
        GetDebouncingOfEvent: possible-error=GeneralDiagnosticInfo/E_NOT_OK
          arg EventId: type=Dem_EventIdType, direction=IN
          arg DebouncingState: type=Dem_DebouncingStateType, direction=OUT
        GetEventExtendedDataRecordEx: possible-error=[GeneralDiagnosticInfo/E_NOT_OK, GeneralDiagnosticInfo/DEM_E_NODATAAVAILABLE, GeneralDiagnosticInfo/DEM_E_WRONG_RECORDNUMBER, GeneralDiagnosticInfo/DEM_E_WRONG_BUFFERSIZE]
          4 x arg:
            EventId: type=Dem_EventIdType, direction=IN
            RecordNumber: type=uint8, direction=IN
            DestBuffer: type=uint8, direction=OUT
            BufSize: type=uint16, direction=INOUT
        GetEventFreezeFrameDataEx: possible-error=[GeneralDiagnosticInfo/E_NOT_OK, GeneralDiagnosticInfo/DEM_E_NODATAAVAILABLE, GeneralDiagnosticInfo/DEM_E_WRONG_RECORDNUMBER, GeneralDiagnosticInfo/DEM_E_WRONG_DIDNUMBER, GeneralDiagnosticInfo/DEM_E_WRONG_BUFFERSIZE]
          5 x arg:
            EventId: type=Dem_EventIdType, direction=IN
            RecordNumber: type=uint8, direction=IN
            DataId: type=uint16, direction=IN
            DestBuffer: type=uint8, direction=OUT
            BufSize: type=uint16, direction=INOUT
      7 x error:
        E_NOT_OK: error-code=1
        DEM_E_NO_DTC_AVAILABLE: error-code=2
        DEM_E_NO_FDC_AVAILABLE: error-code=3
        DEM_E_WRONG_BUFFERSIZE: error-code=21
        DEM_E_NODATAAVAILABLE: error-code=48
        DEM_E_WRONG_RECORDNUMBER: error-code=49
        DEM_E_WRONG_DIDNUMBER: error-code=50
    OperationCycle
      operation SetOperationCycleState: possible-error=OperationCycle/E_NOT_OK
        arg CycleState: type=Dem_OperationCycleStateType, direction=IN
      operation SetCycleQualified: possible-error=OperationCycle/E_NOT_OK
      error E_NOT_OK: error-code=1
    AgingCycle
      operation SetAgingCycleState: possible-error=AgingCycle/E_NOT_OK
      error E_NOT_OK: error-code=1
    ExternalAgingCycle
      operation SetAgingCycleCounterValue: possible-error=ExternalAgingCycle/E_NOT_OK
        arg CounterValue: type=uint8, direction=IN
      error E_NOT_OK: error-code=1
    EnableCondition
      operation SetEnableCondition: possible-error=EnableCondition/E_NOT_OK
        arg ConditionFulfilled: type=boolean, direction=IN
      error E_NOT_OK: error-code=1
    StorageCondition
      operation SetStorageCondition: possible-error=StorageCondition/E_NOT_OK
        arg ConditionFulfilled: type=boolean, direction=IN
      error E_NOT_OK: error-code=1
    IndicatorStatus
      operation GetIndicatorStatus: possible-error=IndicatorStatus/E_NOT_OK
        arg IndicatorStatus: type=Dem_IndicatorStatusType, direction=OUT
      error E_NOT_OK: error-code=1
    EvMemOverflowIndication
      operation GetEventMemoryOverflow: possible-error=EvMemOverflowIndication/E_NOT_OK
        arg OverflowIndication: type=boolean, direction=OUT
      operation GetNumberOfEventMemoryEntries: possible-error=EvMemOverflowIndication/E_NOT_OK
        arg GetNumberOfEventMemoryEntries: type=uint8, direction=OUT
      error E_NOT_OK: error-code=1
    DTCSuppression
      operation SetDTCSuppression: possible-error=DTCSuppression/E_NOT_OK
        arg DTC: type=uint32, direction=IN
        arg DTCFormat: type=Dem_DTCFormatType, direction=IN
        arg SuppressionStatus: type=boolean, direction=IN
      error E_NOT_OK: error-code=1
    CddIf
      operation ClearDTC: possible-error=[DEM_CLEAR_WRONG_DTC, DEM_CLEAR_WRONG_DTCORIGIN, DEM_CLEAR_FAILED, DEM_CLEAR_PENDING, DEM_CLEAR_BUSY, DEM_CLEAR_MEMORY_ERROR]
        arg DTC: type=uint32, direction=IN
        arg DTCFormat: type=Dem_DTCFormatType, direction=IN
        arg DTCOrigin: type=Dem_DTCOriginType, direction=IN
      6 x error:
        DEM_CLEAR_WRONG_DTC: error-code=1
        DEM_CLEAR_WRONG_DTCORIGIN: error-code=2
        DEM_CLEAR_FAILED: error-code=3
        DEM_CLEAR_PENDING: error-code=4
        DEM_CLEAR_BUSY: error-code=5
        DEM_CLEAR_MEMORY_ERROR: error-code=6
    IUMPRNumerator
      operation RepIUMPRFaultDetect: possible-error=IUMPRNumerator/E_NOT_OK
      error E_NOT_OK: error-code=1
    IUMPRDenominator
      operation RepIUMPRDenLock: possible-error=IUMPRDenominator/E_NOT_OK
      operation RepIUMPRDenRelease: possible-error=IUMPRDenominator/E_NOT_OK
      error E_NOT_OK: error-code=1
    PfcCyclePfcCycleQualified
      operation SetPfcCycleSetPfcCycleQualified: possible-error=PfcCyclePfcCycleQualified/E_NOT_OK
      operation GetPfcCycleQualified: possible-error=PfcCyclePfcCycleQualified/E_NOT_OK
        arg isqualified: type=boolean, direction=OUT
      error E_NOT_OK: error-code=1
    ResetReadiness
      operation ResetReadiness
    PowerTakeOff
      operation SetPtoStatus: possible-error=PowerTakeOff/E_NOT_OK
        arg PtoStatus: type=boolean, direction=IN
      error E_NOT_OK: error-code=1
    CallbackInitMonitorForEvent
      operation InitMonitorForEvent: possible-error=CallbackInitMonitorForEvent/E_NOT_OK
        arg InitMonitorReason: type=Dem_InitMonitorReasonType, direction=IN
      error E_NOT_OK: error-code=1
    CallbackInitMonitorForFunction
      operation InitMonitorForFunction: possible-error=CallbackInitMonitorForFunction/E_NOT_OK
      error E_NOT_OK: error-code=1
    CallbackEventStatusChange
      operation EventStatusChanged
        arg EventStatusByteOld: type=Dem_UdsStatusByteType, direction=IN
        arg EventStatusByteNew: type=Dem_UdsStatusByteType, direction=IN
    GeneralCallbackEventStatusChange
      operation EventStatusChanged
        arg EventId: type=Dem_EventIdType, direction=IN
        arg EventStatusByteOld: type=Dem_UdsStatusByteType, direction=IN
        arg EventStatusByteNew: type=Dem_UdsStatusByteType, direction=IN
    CallbackDTCStatusChange
      operation DTCStatusChanged: possible-error=CallbackDTCStatusChange/E_NOT_OK
        arg DTC: type=uint32, direction=IN
        arg DTCStatusOld: type=Dem_DTCStatusMaskType, direction=IN
        arg DTCStatusNew: type=Dem_DTCStatusMaskType, direction=IN
      error E_NOT_OK: error-code=1
    CallbackEventDataChanged
      operation EventDataChanged
    GeneralCallbackEventDataChanged
      operation EventDataChanged
        arg EventId: type=Dem_EventIdType, direction=IN
    CallbackClearEventAllowed
      operation ClearEventAllowed: possible-error=CallbackClearEventAllowed/E_NOT_OK
        arg Allowed: type=boolean, direction=OUT
      error E_NOT_OK: error-code=1
    DataServices_DemExternalCSDataElementClass_Session
      operation ReadData: possible-error=DataServices_DemExternalCSDataElementClass_Session/E_NOT_OK
        arg Data: type=DataArrayType_DemExternalCSDataElementClass_Session, direction=OUT
      error E_NOT_OK: error-code=1
    DataServices_DemExternalCSDataElementClass_ExtDataRec_0x01
      operation ReadData: possible-error=DataServices_DemExternalCSDataElementClass_ExtDataRec_0x01/E_NOT_OK
        arg Data: type=DataArrayType_DemExternalCSDataElementClass_ExtDataRec_0x01, direction=OUT
      error E_NOT_OK: error-code=1
    CallbackGetFaultDetectCounter
      operation GetFaultDetectionCounter: possible-error=CallbackGetFaultDetectCounter/E_NOT_OK
        arg FaultDetectionCounter: type=sint8, direction=OUT
      error E_NOT_OK: error-code=1
    SetClearDTC
      operation SetClearDTC: possible-error=SetClearDTC/E_NOT_OK
        arg DTC: type=uint32, direction=IN
        arg DTCFormat: type=Dem_DTCFormatType, direction=IN
        arg DTCOrigin: type=Dem_DTCOriginType, direction=IN
      error E_NOT_OK: error-code=1
