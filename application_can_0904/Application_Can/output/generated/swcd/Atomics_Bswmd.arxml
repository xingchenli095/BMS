AUTOSAR XML (schema 4-0-3)
package /AUTOSAR_Atomics/BswModuleDescriptions
  bsw module description Atomics: module-id=0, provided-entrys=Atomics_DONT_CARE
    bsw internal behavior InternalBehavior_0
      bsw interrupt entity DONT_CARE: implemented-entry=Atomics_DONT_CARE, interrupt-category=CAT-1
package /AUTOSAR_Atomics/BswModuleEntrys
  bsw module entry Atomics_DONT_CARE: is-reentrant=false, is-synchronous=true, call-type=INTERRUPT, execution-context=INTERRUPT-CAT-1, sw-service-impl-policy=STANDARD
package /EB_Atomics/Implementations
  bsw implementation BswImplementation_0: programming-language=C, sw-version=1.0.18, vendor-id=1, ar-release-version=4.0.3, behavior=InternalBehavior_0, vendor-specific-module-def=Atomics
    code-descriptors:
      code Files
        artifact-descriptors:
          short-label=Autosar::include::Atomics.h, category=SWHDR
          short-label=Autosar::include::Atomics_TSPlatforms.h, category=SWHDR
          short-label=Autosar::include::Atomics_eb_vendor_check.h, category=SWHDR
          short-label=Autosar::include::Atomics_os_compatibility.h, category=SWHDR
          short-label=Autosar::include::Atomics_os_version_compare.h, category=SWHDR
          short-label=Autosar::include::Atomics_platform_types.h, category=SWHDR
          short-label=Autosar::include::Atomics_user_functions.h, category=SWHDR
          short-label=Autosar::include::Atomics_user_functions_customizations.h, category=SWHDR
          short-label=Autosar::include::Atomics_user_types.h, category=SWHDR
          short-label=Autosar::include::Atomics_user_types_customizations.h, category=SWHDR
          short-label=Autosar::src::Atomics.c, category=SWSRC
          short-label=Autosar::src::Atomics_TSPlatforms.c, category=SWSRC
          short-label=make::Atomics_defs.mak, category=SWMAKE
          short-label=make::Atomics_rules.mak, category=SWMAKE
    resource consumption ResourceConsumption
      memory section CODE: sw-addrmethod=CODE
