AUTOSAR XML (schema 4-0-3)
package /AUTOSAR_SCrc/BswModuleDescriptions
  bsw module description SCrc: module-id=0, provided-entrys=[SCrc_CalculateCRC8, SCrc_CalculateCRC8H2F, SCrc_CalculateCRC16, SCrc_CalculateCRC32P4]
    bsw internal behavior InternalBehavior_0
      4 x bsw called entity:
        SCrc_CalculateCRC8: implemented-entry=SCrc_CalculateCRC8
        SCrc_CalculateCRC8H2F: implemented-entry=SCrc_CalculateCRC8H2F
        SCrc_CalculateCRC16: implemented-entry=SCrc_CalculateCRC16
        SCrc_CalculateCRC32P4: implemented-entry=SCrc_CalculateCRC32P4
package /AUTOSAR_SCrc/BswModuleEntrys
  4 x bsw module entry, all with is-reentrant=true, is-synchronous=true, call-type=REGULAR, execution-context=UNSPECIFIED, sw-service-impl-policy=STANDARD:
    SCrc_CalculateCRC8
    SCrc_CalculateCRC8H2F
    SCrc_CalculateCRC16
    SCrc_CalculateCRC32P4
package /EB_SCrc/Implementations
  bsw implementation BswImplementation_0: programming-language=C, sw-version=2.0.12, vendor-id=1, ar-release-version=4.0.3, behavior=InternalBehavior_0, vendor-specific-module-def=SCrc
    code-descriptors:
      code Files
        artifact-descriptors:
          short-label=Autosar::include::SCrc.h, category=SWHDR
          short-label=Autosar::include::SCrc_CRC16.h, category=SWHDR
          short-label=Autosar::include::SCrc_CRC32P4.h, category=SWHDR
          short-label=Autosar::include::SCrc_CRC8.h, category=SWHDR
          short-label=Autosar::include::SCrc_CRC8H2F.h, category=SWHDR
          short-label=Autosar::include::SCrc_LocalSrcCfg.h, category=SWHDR
          short-label=Autosar::src::SCrc.c, category=SWSRC
          short-label=make::SCrc_defs.mak, category=SWMAKE
          short-label=make::SCrc_rules.mak, category=SWMAKE
    resource consumption ResourceConsumption
      4 x memory section:
        CODE: sw-addrmethod=CODE
        CONST_8: alignment=8, sw-addrmethod=CONST
        CONST_16: alignment=16, sw-addrmethod=CONST
        CONST_32: alignment=32, sw-addrmethod=CONST
