AUTOSAR XML (schema 4-2-1)
package /AUTOSAR_Dcm/SwcBswMappings
  swc bsw mapping SwcBswMapping_0: bsw-behavior=InternalBehavior_0, swc-bsw-runnable-mapping{bsw-entity=Dcm_MainFunction, swc-runnable=RE_MainFunction}, swc-behavior=DcmIntBeh
package /AUTOSAR_Dcm/BswModuleDescriptions
  bsw module description Dcm: module-id=53, provided-entrys=Dcm_MainFunction
    provided-mode-groups:
      6 x mode declaration group prototype:
        DcmDiagnosticSessionControl: type=DcmDiagnosticSessionControl
        DcmEcuReset: type=DcmEcuReset
        DcmRapidPowerShutdown: type=DcmRapidPowerShutdown
        DcmCommunicationControl_CanNetwork: type=DcmCommunicationControl
        DcmControlDTCSetting: type=DcmControlDTCSetting
        DcmResponseOnEvent_0: type=DcmResponseOnEvent_0
    bsw internal behavior InternalBehavior_0: data-type-mapping=ModeMapping
      exclusive area SCHM_DCM_EXCLUSIVE_AREA_0
      bsw schedulable entity Dcm_MainFunction: can-enter-exclusive-area=SCHM_DCM_EXCLUSIVE_AREA_0, implemented-entry=Dcm_MainFunction
        managed-mode-groups:
          DcmDiagnosticSessionControl
          DcmEcuReset
          DcmRapidPowerShutdown
          DcmCommunicationControl_CanNetwork
          DcmControlDTCSetting
          DcmResponseOnEvent_0
      bsw timing event TimingEvent_MainFunction: starts-on-event=Dcm_MainFunction, period=0.005
      mode-sender-policys:
        provided-mode-group=DcmDiagnosticSessionControl, queue-length=3
        provided-mode-group=DcmEcuReset, queue-length=7
        provided-mode-group=DcmRapidPowerShutdown, queue-length=2
        provided-mode-group=DcmCommunicationControl_CanNetwork, queue-length=12
        provided-mode-group=DcmControlDTCSetting, queue-length=2
        provided-mode-group=DcmResponseOnEvent_0, queue-length=3
  data type mapping set ModeMapping
    mode-request-type-maps:
      implementation-data-type=uint8, mode-group=DcmDiagnosticSessionControl
      implementation-data-type=uint8, mode-group=DcmEcuReset
      implementation-data-type=uint8, mode-group=DcmRapidPowerShutdown
      implementation-data-type=uint8, mode-group=DcmCommunicationControl
      implementation-data-type=uint8, mode-group=DcmControlDTCSetting
      implementation-data-type=uint8, mode-group=DcmResponseOnEvent_0
package /AUTOSAR_Dcm/BswModuleEntrys
  bsw module entry Dcm_MainFunction: service-id=37, is-reentrant=false, is-synchronous=true, call-type=SCHEDULED, execution-context=TASK, sw-service-impl-policy=STANDARD
package /AUTOSAR_Dcm/ModeDeclarationGroups
  6 x mode declaration group:
    DcmDiagnosticSessionControl: category=EXPLICIT_ORDER, initial-mode=Default, on-transition-value=0
      mode Default: value=1
      mode Programming: value=2
      mode Extended: value=3
    DcmEcuReset: initial-mode=NONE
      7 x mode:
        NONE
        HARD
        KEYONOFF
        SOFT
        JUMPTOBOOTLOADER
        JUMPTOSYSSUPPLIERBOOTLOADER
        EXECUTE
    DcmRapidPowerShutdown: initial-mode=ENABLE_RAPIDPOWERSHUTDOWN
      mode ENABLE_RAPIDPOWERSHUTDOWN
      mode DISABLE_RAPIDPOWERSHUTDOWN
    DcmCommunicationControl: category=EXPLICIT_ORDER, initial-mode=DCM_ENABLE_RX_TX_NORM, on-transition-value=12
      12 x mode:
        DCM_ENABLE_RX_TX_NORM: value=0
        DCM_ENABLE_RX_DISABLE_TX_NORM: value=1
        DCM_DISABLE_RX_ENABLE_TX_NORM: value=2
        DCM_DISABLE_RX_TX_NORM: value=3
        DCM_ENABLE_RX_TX_NM: value=4
        DCM_ENABLE_RX_DISABLE_TX_NM: value=5
        DCM_DISABLE_RX_ENABLE_TX_NM: value=6
        DCM_DISABLE_RX_TX_NM: value=7
        DCM_ENABLE_RX_TX_NORM_NM: value=8
        DCM_ENABLE_RX_DISABLE_TX_NORM_NM: value=9
        DCM_DISABLE_RX_ENABLE_TX_NORM_NM: value=10
        DCM_DISABLE_RX_TX_NORM_NM: value=11
    DcmControlDTCSetting: initial-mode=ENABLEDTCSETTING
      mode ENABLEDTCSETTING
      mode DISABLEDTCSETTING
    DcmResponseOnEvent_0: category=EXPLICIT_ORDER, initial-mode=EVENT_CLEARED, on-transition-value=3
      mode EVENT_STARTED: value=2
      mode EVENT_STOPPED: value=1
      mode EVENT_CLEARED: value=0
package /EB_Dcm/Implementations
  bsw implementation BswImplementation_0: programming-language=C, sw-version=5.0.13, swc-bsw-mapping=SwcBswMapping_0, vendor-id=1, ar-release-version=4.0.3, behavior=InternalBehavior_0, vendor-specific-module-def=Dcm
    code-descriptors:
      code Files
        artifact-descriptors:
          short-label=Autosar::include::Dcm.h, category=SWHDR
          short-label=Autosar::include::Dcm_Authentication.h, category=SWHDR
          short-label=Autosar::include::Dcm_Authentication_AuthenticationHandler.h, category=SWHDR
          short-label=Autosar::include::Dcm_Authentication_CryptoStackFacade.h, category=SWHDR
          short-label=Autosar::include::Dcm_Authentication_DiagnosticPolicyHandler.h, category=SWHDR
          short-label=Autosar::include::Dcm_Cbk.h, category=SWHDR
          short-label=Autosar::include::Dcm_Dsl_ComMChannelStateManager.h, category=SWHDR
          short-label=Autosar::include::Dcm_Dsl_ComMChannelStateManager_External_Interface.h, category=SWHDR
          short-label=Autosar::include::Dcm_Dsl_CommunicationServices.h, category=SWHDR
          short-label=Autosar::include::Dcm_Dsl_CommunicationServices_BufferManager.h, category=SWHDR
          short-label=Autosar::include::Dcm_Dsl_CommunicationServices_MetaData.h, category=SWHDR
          short-label=Autosar::include::Dcm_Dsl_CommunicationServices_RxConnections.h, category=SWHDR
          short-label=Autosar::include::Dcm_Dsl_CommunicationServices_TxConnections.h, category=SWHDR
          short-label=Autosar::include::Dcm_Dsl_DiagnosticSessionHandler.h, category=SWHDR
          short-label=Autosar::include::Dcm_Dsl_PostBootOperationsHandler.h, category=SWHDR
          short-label=Autosar::include::Dcm_Dsl_RoeServices.h, category=SWHDR
          short-label=Autosar::include::Dcm_Dsl_SecurityLevelHandler.h, category=SWHDR
          short-label=Autosar::include::Dcm_Dsl_Supervisor.h, category=SWHDR
          short-label=Autosar::include::Dcm_Dsl_Supervisor_CommunicationSessionHandling.h, category=SWHDR
          short-label=Autosar::include::Dcm_Dsl_Supervisor_MainConnectionHandling.h, category=SWHDR
          short-label=Autosar::include::Dcm_Dsl_Supervisor_ProtocolHandling.h, category=SWHDR
          short-label=Autosar::include::Dcm_DspExternal.h, category=SWHDR
          short-label=Autosar::include::Dcm_Dsp_ApplicationDiagnosticRequests.h, category=SWHDR
          short-label=Autosar::include::Dcm_Dsp_Contexts.h, category=SWHDR
          short-label=Autosar::include::Dcm_Dsp_DataTransferServices.h, category=SWHDR
          short-label=Autosar::include::Dcm_Dsp_DemFacade.h, category=SWHDR
          short-label=Autosar::include::Dcm_Dsp_DidServices.h, category=SWHDR
          short-label=Autosar::include::Dcm_Dsp_DidSignals.h, category=SWHDR
          short-label=Autosar::include::Dcm_Dsp_EndiannessInterpretation.h, category=SWHDR
          short-label=Autosar::include::Dcm_Dsp_MemoryServices.h, category=SWHDR
          short-label=Autosar::include::Dcm_Dsp_MidServices.h, category=SWHDR
          short-label=Autosar::include::Dcm_Dsp_PidServices.h, category=SWHDR
          short-label=Autosar::include::Dcm_Dsp_SvcH_Authentication.h, category=SWHDR
          short-label=Autosar::include::Dcm_Dsp_SvcH_CommunicationControl.h, category=SWHDR
          short-label=Autosar::include::Dcm_Dsp_SvcH_ControlDTCSetting.h, category=SWHDR
          short-label=Autosar::include::Dcm_Dsp_SvcH_DynamicallyDefineDataIdentifier.h, category=SWHDR
          short-label=Autosar::include::Dcm_Dsp_SvcH_InputOutputControlByIdentifier.h, category=SWHDR
          short-label=Autosar::include::Dcm_Dsp_SvcH_LinkControl.h, category=SWHDR
          short-label=Autosar::include::Dcm_Dsp_SvcH_ReadDTCInformation.h, category=SWHDR
          short-label=Autosar::include::Dcm_Dsp_SvcH_ReadDataByIdentifier.h, category=SWHDR
          short-label=Autosar::include::Dcm_Dsp_SvcH_ReadDataByPeriodicIdentifier.h, category=SWHDR
          short-label=Autosar::include::Dcm_Dsp_SvcH_ReadMemoryByAddress.h, category=SWHDR
          short-label=Autosar::include::Dcm_Dsp_SvcH_ReadScalingDataByIdentifier.h, category=SWHDR
          short-label=Autosar::include::Dcm_Dsp_SvcH_RequestControlOfOnBoardSysTstComp.h, category=SWHDR
          short-label=Autosar::include::Dcm_Dsp_SvcH_RequestDownload.h, category=SWHDR
          short-label=Autosar::include::Dcm_Dsp_SvcH_RequestOnboardMonitoringTestResults.h, category=SWHDR
          short-label=Autosar::include::Dcm_Dsp_SvcH_RequestTransferExit.h, category=SWHDR
          short-label=Autosar::include::Dcm_Dsp_SvcH_RequestUpload.h, category=SWHDR
          short-label=Autosar::include::Dcm_Dsp_SvcH_RequestVehicleInformation.h, category=SWHDR
          short-label=Autosar::include::Dcm_Dsp_SvcH_ResponseOnEvent.h, category=SWHDR
          short-label=Autosar::include::Dcm_Dsp_SvcH_RoutineControl.h, category=SWHDR
          short-label=Autosar::include::Dcm_Dsp_SvcH_SecurityAccess.h, category=SWHDR
          short-label=Autosar::include::Dcm_Dsp_SvcH_TesterPresent.h, category=SWHDR
          short-label=Autosar::include::Dcm_Dsp_SvcH_TransferData.h, category=SWHDR
          short-label=Autosar::include::Dcm_Dsp_SvcH_WriteDataByIdentifier.h, category=SWHDR
          short-label=Autosar::include::Dcm_Dsp_SvcH_WriteMemoryByAddress.h, category=SWHDR
          short-label=Autosar::include::Dcm_Dsp_VinServices.h, category=SWHDR
          short-label=Autosar::include::Dcm_GenericServiceHandlers.h, category=SWHDR
          short-label=Autosar::include::Dcm_Hsm.h, category=SWHDR
          short-label=Autosar::include::Dcm_HsmCfg.h, category=SWHDR
          short-label=Autosar::include::Dcm_HsmDcm.h, category=SWHDR
          short-label=Autosar::include::Dcm_HsmDcmInt.h, category=SWHDR
          short-label=Autosar::include::Dcm_Int.h, category=SWHDR
          short-label=Autosar::include::Dcm_Trace.h, category=SWHDR
          short-label=Autosar::include::Dcm_Trace_Internal.h, category=SWHDR
          short-label=Autosar::include::Dcm_Types.h, category=SWHDR
          short-label=Autosar::include::Dcm_Version.h, category=SWHDR
          short-label=Autosar::src::Dcm.c, category=SWSRC
          short-label=Autosar::src::Dcm_Authentication.c, category=SWSRC
          short-label=Autosar::src::Dcm_Authentication_AuthenticationHandler.c, category=SWSRC
          short-label=Autosar::src::Dcm_Authentication_CryptoStackFacade.c, category=SWSRC
          short-label=Autosar::src::Dcm_Authentication_DiagnosticPolicyHandler.c, category=SWSRC
          short-label=Autosar::src::Dcm_Dsd.c, category=SWSRC
          short-label=Autosar::src::Dcm_Dsl_ComMChannelStateManager.c, category=SWSRC
          short-label=Autosar::src::Dcm_Dsl_CommunicationServices.c, category=SWSRC
          short-label=Autosar::src::Dcm_Dsl_CommunicationServices_BufferManager.c, category=SWSRC
          short-label=Autosar::src::Dcm_Dsl_CommunicationServices_MetaData.c, category=SWSRC
          short-label=Autosar::src::Dcm_Dsl_CommunicationServices_RxConnections.c, category=SWSRC
          short-label=Autosar::src::Dcm_Dsl_CommunicationServices_TxConnections.c, category=SWSRC
          short-label=Autosar::src::Dcm_Dsl_DiagnosticSessionHandler.c, category=SWSRC
          short-label=Autosar::src::Dcm_Dsl_PostBootOperationsHandler.c, category=SWSRC
          short-label=Autosar::src::Dcm_Dsl_RoeServices.c, category=SWSRC
          short-label=Autosar::src::Dcm_Dsl_SecurityLevelHandler.c, category=SWSRC
          short-label=Autosar::src::Dcm_Dsl_Supervisor.c, category=SWSRC
          short-label=Autosar::src::Dcm_Dsl_Supervisor_CommunicationSessionHandling.c, category=SWSRC
          short-label=Autosar::src::Dcm_Dsl_Supervisor_MainConnectionHandling.c, category=SWSRC
          short-label=Autosar::src::Dcm_Dsl_Supervisor_ProtocolHandling.c, category=SWSRC
          short-label=Autosar::src::Dcm_Dsp.c, category=SWSRC
          short-label=Autosar::src::Dcm_Dsp_ApplicationDiagnosticRequests.c, category=SWSRC
          short-label=Autosar::src::Dcm_Dsp_Contexts.c, category=SWSRC
          short-label=Autosar::src::Dcm_Dsp_DataTransferServices.c, category=SWSRC
          short-label=Autosar::src::Dcm_Dsp_DemFacade.c, category=SWSRC
          short-label=Autosar::src::Dcm_Dsp_DidServices.c, category=SWSRC
          short-label=Autosar::src::Dcm_Dsp_DidSignals.c, category=SWSRC
          short-label=Autosar::src::Dcm_Dsp_EndiannessInterpretation.c, category=SWSRC
          short-label=Autosar::src::Dcm_Dsp_MemoryServices.c, category=SWSRC
          short-label=Autosar::src::Dcm_Dsp_MidServices.c, category=SWSRC
          short-label=Autosar::src::Dcm_Dsp_PidServices.c, category=SWSRC
          short-label=Autosar::src::Dcm_Dsp_SvcH_Authentication.c, category=SWSRC
          short-label=Autosar::src::Dcm_Dsp_SvcH_CommunicationControl.c, category=SWSRC
          short-label=Autosar::src::Dcm_Dsp_SvcH_ControlDTCSetting.c, category=SWSRC
          short-label=Autosar::src::Dcm_Dsp_SvcH_DynamicallyDefineDataIdentifier.c, category=SWSRC
          short-label=Autosar::src::Dcm_Dsp_SvcH_InputOutputControlByIdentifier.c, category=SWSRC
          short-label=Autosar::src::Dcm_Dsp_SvcH_LinkControl.c, category=SWSRC
          short-label=Autosar::src::Dcm_Dsp_SvcH_ReadDTCInformation.c, category=SWSRC
          short-label=Autosar::src::Dcm_Dsp_SvcH_ReadDataByIdentifier.c, category=SWSRC
          short-label=Autosar::src::Dcm_Dsp_SvcH_ReadDataByPeriodicIdentifier.c, category=SWSRC
          short-label=Autosar::src::Dcm_Dsp_SvcH_ReadMemoryByAddress.c, category=SWSRC
          short-label=Autosar::src::Dcm_Dsp_SvcH_ReadScalingDataByIdentifier.c, category=SWSRC
          short-label=Autosar::src::Dcm_Dsp_SvcH_RequestControlOfOnBoardSysTstComp.c, category=SWSRC
          short-label=Autosar::src::Dcm_Dsp_SvcH_RequestDownload.c, category=SWSRC
          short-label=Autosar::src::Dcm_Dsp_SvcH_RequestOnboardMonitoringTestResults.c, category=SWSRC
          short-label=Autosar::src::Dcm_Dsp_SvcH_RequestTransferExit.c, category=SWSRC
          short-label=Autosar::src::Dcm_Dsp_SvcH_RequestUpload.c, category=SWSRC
          short-label=Autosar::src::Dcm_Dsp_SvcH_RequestVehicleInformation.c, category=SWSRC
          short-label=Autosar::src::Dcm_Dsp_SvcH_ResponseOnEvent.c, category=SWSRC
          short-label=Autosar::src::Dcm_Dsp_SvcH_RoutineControl.c, category=SWSRC
          short-label=Autosar::src::Dcm_Dsp_SvcH_SecurityAccess.c, category=SWSRC
          short-label=Autosar::src::Dcm_Dsp_SvcH_TesterPresent.c, category=SWSRC
          short-label=Autosar::src::Dcm_Dsp_SvcH_TransferData.c, category=SWSRC
          short-label=Autosar::src::Dcm_Dsp_SvcH_WriteDataByIdentifier.c, category=SWSRC
          short-label=Autosar::src::Dcm_Dsp_SvcH_WriteMemoryByAddress.c, category=SWSRC
          short-label=Autosar::src::Dcm_Dsp_VinServices.c, category=SWSRC
          short-label=Autosar::src::Dcm_Hsm.c, category=SWSRC
          short-label=Autosar::src::Dcm_HsmDcmData.c, category=SWSRC
          short-label=Autosar::src::Dcm_HsmDcmFnct.c, category=SWSRC
          short-label=make::Dcm_defs.mak, category=SWMAKE
          short-label=make::Dcm_rules.mak, category=SWMAKE
    resource consumption ResourceConsumption
      17 x memory section:
        CONST_UNSPECIFIED: alignment=UNSPECIFIED, sw-addrmethod=CONST
        CONST_32: alignment=32, sw-addrmethod=CONST
        CONST_16: alignment=16, sw-addrmethod=CONST
        VAR_CLEARED_8: alignment=8, sw-addrmethod=VAR_CLEARED
        CONST_8: alignment=8, sw-addrmethod=CONST
        CODE: sw-addrmethod=CODE
        CALLOUT_CODE: sw-addrmethod=CODE
        VAR_INIT_UNSPECIFIED: alignment=UNSPECIFIED, sw-addrmethod=VAR
        VAR_CLEARED_UNSPECIFIED: alignment=UNSPECIFIED, sw-addrmethod=VAR_CLEARED
        VAR_POWER_ON_CLEARED_UNSPECIFIED: alignment=UNSPECIFIED, sw-addrmethod=VAR
        VAR_INIT_8: alignment=8, sw-addrmethod=VAR
        VAR_INIT_16: alignment=16, sw-addrmethod=VAR
        VAR_CLEARED_16: alignment=16, sw-addrmethod=VAR_CLEARED
        VAR_CLEARED_32: alignment=32, sw-addrmethod=VAR_CLEARED
        VAR_INIT_32: alignment=32, sw-addrmethod=VAR
        CALIB_8: alignment=8, sw-addrmethod=CALIB
        CALIB_UNSPECIFIED: alignment=UNSPECIFIED, sw-addrmethod=CALIB
