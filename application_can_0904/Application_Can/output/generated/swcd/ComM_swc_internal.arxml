AUTOSAR XML (schema 4-0-3)
package /AUTOSAR_ComM/SwComponentTypes
  service sw component type ComM
    behavior SwcInternalBehavior_0: data-type-mapping=DataTypeMappingSet_0, handle-termination-and-restart=NO-SUPPORT, included-data-type-set=data-type=ComM_ModeType
      runnable RE_Main_0: symbol=ComM_MainFunction_0
package /EB_ComM/SwcImplementations
  swc implementation SwcImplementation_0: programming-language=C, sw-version=5.21.1, vendor-id=1, behavior=SwcInternalBehavior_0
    code-descriptors:
      code ComMCode: artifact-descriptors=autosar-engineering-object={short-label=EngObject, category=SWSRC}
    resource consumption Resources
      memory section CODE: sw-addrmethod=CODE
