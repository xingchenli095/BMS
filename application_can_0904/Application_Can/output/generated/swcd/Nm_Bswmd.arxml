AUTOSAR XML (schema 4-2-1)
package /AUTOSAR_Nm/BswModuleDescriptions
  bsw module description Nm: module-id=29, provided-entrys=Nm_MainFunction
    bsw internal behavior InternalBehavior_0
      exclusive area SCHM_NM_EXCLUSIVE_AREA_0
      bsw schedulable entity Nm_MainFunction: can-enter-exclusive-area=SCHM_NM_EXCLUSIVE_AREA_0, implemented-entry=Nm_MainFunction
      bsw timing event TimingEvent_MainFunction: starts-on-event=Nm_MainFunction, period=0.02
package /AUTOSAR_Nm/BswModuleEntrys
  bsw module entry Nm_MainFunction: service-id=0x10, is-reentrant=false, is-synchronous=true, call-type=SCHEDULED, execution-context=TASK, sw-service-impl-policy=STANDARD
package /EB_Nm/Implementations
  bsw implementation BswImplementation_0: programming-language=C, sw-version=5.12.11, vendor-id=1, ar-release-version=4.0.3, behavior=InternalBehavior_0, vendor-specific-module-def=Nm
    code-descriptors:
      code Files
        artifact-descriptors:
          short-label=Autosar::include::Nm.h, category=SWHDR
          short-label=Autosar::include::Nm_Cbk.h, category=SWHDR
          short-label=Autosar::include::Nm_Int.h, category=SWHDR
          short-label=Autosar::include::Nm_Trace.h, category=SWHDR
          short-label=Autosar::include::Nm_Trace_Internal.h, category=SWHDR
          short-label=Autosar::include::Nm_Version.h, category=SWHDR
          short-label=Autosar::src::Nm.c, category=SWSRC
          short-label=make::Nm_defs.mak, category=SWMAKE
          short-label=make::Nm_rules.mak, category=SWMAKE
    resource consumption ResourceConsumption
      7 x memory section:
        CODE: sw-addrmethod=CODE
        CONST_UNSPECIFIED: alignment=UNSPECIFIED, sw-addrmethod=CONST
        CONST_8: alignment=8, sw-addrmethod=CONST
        VAR_CLEARED_UNSPECIFIED: alignment=UNSPECIFIED, sw-addrmethod=VAR_CLEARED
        VAR_CLEARED_16: alignment=16, sw-addrmethod=VAR_CLEARED
        VAR_INIT_8: alignment=8, sw-addrmethod=VAR_INIT
        VAR_CLEARED_8: alignment=8, sw-addrmethod=VAR_CLEARED
