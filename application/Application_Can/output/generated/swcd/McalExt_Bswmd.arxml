AUTOSAR XML (schema 4-0-3)
package /AUTOSAR_McalExt/SwAddrMethods_McalExt
  sw addr method CONFIG_DATA_8_NO: memory-allocation-keyword-policy=ADDR-METHOD-SHORT-NAME-AND-ALIGNMENT, options=CONFIG_DATA_8_NO, section-type=CONFIG-DATA
