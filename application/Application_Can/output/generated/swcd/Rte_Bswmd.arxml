AUTOSAR XML (schema 4-0-3)
package /AUTOSAR_MemMap/SwAddrMethods
  sw addr method CODE: memory-allocation-keyword-policy=ADDR-METHOD-SHORT-NAME, section-type=CODE
  sw addr method VAR: memory-allocation-keyword-policy=ADDR-METHOD-SHORT-NAME-AND-ALIGNMENT, section-initialization-policy=INIT, section-type=VAR
  sw addr method CONST: memory-allocation-keyword-policy=ADDR-METHOD-SHORT-NAME-AND-ALIGNMENT, section-type=CONST
package /AUTOSAR_Rte/BswModuleDescriptions
  bsw module description Rte: module-id=2, provided-entrys=[Rte_Start, Rte_Stop, SchM_Init, SchM_Deinit, SchM_GetVersionInfo]
    bsw internal behavior InternalBehavior_0
      5 x bsw called entity:
        Rte_Start: implemented-entry=Rte_Start
        Rte_Stop: implemented-entry=Rte_Stop
        SchM_Init: implemented-entry=SchM_Init
        SchM_Deinit: implemented-entry=SchM_Deinit
        SchM_GetVersionInfo: implemented-entry=SchM_GetVersionInfo
package /AUTOSAR_Rte/BswModuleEntrys
  5 x bsw module entry, all with is-reentrant=false, is-synchronous=true, call-type=REGULAR, execution-context=TASK, sw-service-impl-policy=STANDARD:
    Rte_Start
      return type returnType: direction=OUT, implementation-data-type=Std_ReturnType
    Rte_Stop
      return type returnType: direction=OUT, implementation-data-type=Std_ReturnType
    SchM_Init
    SchM_Deinit
    SchM_GetVersionInfo
      sw service arg versioninfo: direction=OUT, implementation-data-type=Std_VersionInfoType
package /EB_Rte/Implementations
  bsw implementation BswImplementation_0: programming-language=C, sw-version=6.8.4, vendor-id=1, ar-release-version=4.0.3, behavior=InternalBehavior_0
    code-descriptors:
      code Files
        artifact-descriptors:
          short-label=Autosar::include::Rte_Version.h, category=SWHDR
          short-label=make::Rte_defs.mak, category=SWMAKE
          short-label=make::Rte_rules.mak, category=SWMAKE
    resource consumption ResourceConsumption
      12 x memory section:
        CODE: sw-addrmethod=CODE
        CONST_8: alignment=8, sw-addrmethod=CONST
        CONST_UNSPECIFIED: alignment=UNSPECIFIED, sw-addrmethod=CONST
        VAR_CLEARED_8: alignment=8, sw-addrmethod=VAR_CLEARED
        VAR_INIT_UNSPECIFIED: alignment=UNSPECIFIED, sw-addrmethod=VAR_INIT
        VAR_CLEARED_16: alignment=16, sw-addrmethod=VAR_CLEARED
        VAR_INIT_8: alignment=8, sw-addrmethod=VAR_INIT
        VAR_CLEARED_32: alignment=32, sw-addrmethod=VAR_CLEARED
        CONST_32: alignment=32, sw-addrmethod=CONST
        CONST_16: alignment=16, sw-addrmethod=CONST
        APPL_CODE: sw-addrmethod=CODE
        VAR_UNSPECIFIED: alignment=UNSPECIFIED, sw-addrmethod=VAR
