AUTOSAR XML (schema 4-0-3)
package /AUTOSAR_Adc/BswModuleDescriptions
  bsw module description Adc: module-id=123, provided-entrys=Adc_Init
    bsw internal behavior InternalBehavior_0
      66 x exclusive area:
        ADC_EXCLUSIVE_AREA_{00..05}
        ADC_EXCLUSIVE_AREA_{10..51}
        ADC_EXCLUSIVE_AREA_{54..71}
      bsw called entity Adc_Init: can-enter-exclusive-area=[ADC_EXCLUSIVE_AREA_00, ADC_EXCLUSIVE_AREA_01, ADC_EXCLUSIVE_AREA_02, ADC_EXCLUSIVE_AREA_03, ADC_EXCLUSIVE_AREA_04, ADC_EXCLUSIVE_AREA_05, ADC_EXCLUSIVE_AREA_10, ADC_EXCLUSIVE_AREA_11, ADC_EXCLUSIVE_AREA_12, ADC_EXCLUSIVE_AREA_13, ADC_EXCLUSIVE_AREA_14, ADC_EXCLUSIVE_AREA_15, ADC_EXCLUSIVE_AREA_16, ADC_EXCLUSIVE_AREA_17, ADC_EXCLUSIVE_AREA_18, ADC_EXCLUSIVE_AREA_19, ADC_EXCLUSIVE_AREA_20, ADC_EXCLUSIVE_AREA_21, ADC_EXCLUSIVE_AREA_22, ADC_EXCLUSIVE_AREA_23, ADC_EXCLUSIVE_AREA_24, ADC_EXCLUSIVE_AREA_25, ADC_EXCLUSIVE_AREA_26, ADC_EXCLUSIVE_AREA_27, ADC_EXCLUSIVE_AREA_28, ADC_EXCLUSIVE_AREA_29, ADC_EXCLUSIVE_AREA_30, ADC_EXCLUSIVE_AREA_31, ADC_EXCLUSIVE_AREA_32, ADC_EXCLUSIVE_AREA_33, ADC_EXCLUSIVE_AREA_34, ADC_EXCLUSIVE_AREA_35, ADC_EXCLUSIVE_AREA_36, ADC_EXCLUSIVE_AREA_37, ADC_EXCLUSIVE_AREA_38, ADC_EXCLUSIVE_AREA_39, ADC_EXCLUSIVE_AREA_40, ADC_EXCLUSIVE_AREA_41, ADC_EXCLUSIVE_AREA_42, ADC_EXCLUSIVE_AREA_43, ADC_EXCLUSIVE_AREA_44, ADC_EXCLUSIVE_AREA_45, ADC_EXCLUSIVE_AREA_46, ADC_EXCLUSIVE_AREA_47, ADC_EXCLUSIVE_AREA_48, ADC_EXCLUSIVE_AREA_49, ADC_EXCLUSIVE_AREA_50, ADC_EXCLUSIVE_AREA_51, ADC_EXCLUSIVE_AREA_54, ADC_EXCLUSIVE_AREA_55, ADC_EXCLUSIVE_AREA_56, ADC_EXCLUSIVE_AREA_57, ADC_EXCLUSIVE_AREA_58, ADC_EXCLUSIVE_AREA_59, ADC_EXCLUSIVE_AREA_60, ADC_EXCLUSIVE_AREA_61, ADC_EXCLUSIVE_AREA_62, ADC_EXCLUSIVE_AREA_63, ADC_EXCLUSIVE_AREA_64, ADC_EXCLUSIVE_AREA_65, ADC_EXCLUSIVE_AREA_66, ADC_EXCLUSIVE_AREA_67, ADC_EXCLUSIVE_AREA_68, ADC_EXCLUSIVE_AREA_69, ADC_EXCLUSIVE_AREA_70, ADC_EXCLUSIVE_AREA_71], implemented-entry=Adc_Init
package /AUTOSAR_Adc/BswModuleEntrys
  bsw module entry Adc_Init: service-id=0, is-reentrant=false, is-synchronous=true, call-type=REGULAR, execution-context=UNSPECIFIED, sw-service-impl-policy=STANDARD
package /Adc_TS_T40D34M20I1R0/Implementations
  bsw implementation BswImplementation_0: programming-language=C, sw-version=2.0.1, vendor-id=43, ar-release-version=4.4.0, behavior=InternalBehavior_0, vendor-specific-module-def=Adc
    code-descriptors:
      code Files: artifact-descriptors=[{short-label=make::Adc_defs.mak, category=SWMAKE}, {short-label=make::Adc_rules.mak, category=SWMAKE}]
    resource consumption ResourceConsumption
      13 x memory section:
        ADC_CODE: sw-addrmethod=CODE, symbol=CODE
        ADC_CONFIG_DATA_16: alignment=16, sw-addrmethod=CONFIG_DATA, symbol=CONFIG_DATA_16
        ADC_CONFIG_DATA_8: alignment=8, sw-addrmethod=CONFIG_DATA, symbol=CONFIG_DATA_8
        ADC_CONFIG_DATA_UNSPECIFIED: alignment=UNSPECIFIED, sw-addrmethod=CONFIG_DATA, symbol=CONFIG_DATA_UNSPECIFIED
        ADC_CONST_32: alignment=32, sw-addrmethod=CONST, symbol=CONST_32
        ADC_CONST_8: alignment=8, sw-addrmethod=CONST, symbol=CONST_8
        ADC_CONST_UNSPECIFIED: alignment=UNSPECIFIED, sw-addrmethod=CONST, symbol=CONST_UNSPECIFIED
        ADC_VAR_CLEARED_32: alignment=32, sw-addrmethod=VAR_CLEARED, symbol=VAR_CLEARED_32
        ADC_VAR_CLEARED_32_NO_CACHEABLE: sw-addrmethod=VAR_CLEARED, symbol=VAR_CLEARED_32_NO_CACHEABLE
        ADC_VAR_CLEARED_8: alignment=8, sw-addrmethod=VAR_CLEARED, symbol=VAR_CLEARED_8
        ADC_VAR_CLEARED_8_NO_CACHEABLE: sw-addrmethod=VAR_CLEARED, symbol=VAR_CLEARED_8_NO_CACHEABLE
        ADC_VAR_CLEARED_BOOLEAN: alignment=BOOLEAN, sw-addrmethod=VAR_CLEARED, symbol=VAR_CLEARED_BOOLEAN
        ADC_VAR_CLEARED_UNSPECIFIED: alignment=UNSPECIFIED, sw-addrmethod=VAR_CLEARED, symbol=VAR_CLEARED_UNSPECIFIED
