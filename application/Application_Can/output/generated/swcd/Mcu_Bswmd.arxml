AUTOSAR XML (schema 4-0-3)
package /AUTOSAR_Mcu/BswModuleDescriptions
  bsw module description Mcu: module-id=101, provided-entrys=Mcu_Init
    bsw internal behavior InternalBehavior_0
      exclusive area MCU_EXCLUSIVE_AREA_{00..02}
      bsw called entity Mcu_Init: can-enter-exclusive-area=[MCU_EXCLUSIVE_AREA_00, MCU_EXCLUSIVE_AREA_01, MCU_EXCLUSIVE_AREA_02], implemented-entry=Mcu_Init
package /AUTOSAR_Mcu/BswModuleEntrys
  bsw module entry Mcu_Init: service-id=0, is-reentrant=false, is-synchronous=true, call-type=REGULAR, execution-context=UNSPECIFIED, sw-service-impl-policy=STANDARD
package /Mcu_TS_T40D34M20I1R0/Implementations
  bsw implementation BswImplementation_0: programming-language=C, sw-version=2.0.1, vendor-id=43, ar-release-version=4.4.0, behavior=InternalBehavior_0, vendor-specific-module-def=Mcu
    code-descriptors:
      code Files: artifact-descriptors=[{short-label=make::Mcu_defs.mak, category=SWMAKE}, {short-label=make::Mcu_rules.mak, category=SWMAKE}]
    resource consumption ResourceConsumption
      14 x memory section:
        MCU_CODE: sw-addrmethod=CODE, symbol=CODE
        MCU_CODE_AC: sw-addrmethod=CODE, symbol=CODE_AC
        MCU_CONFIG_DATA_UNSPECIFIED: alignment=UNSPECIFIED, sw-addrmethod=CONFIG_DATA, symbol=CONFIG_DATA_UNSPECIFIED
        MCU_CONST_16: alignment=16, sw-addrmethod=CONST, symbol=CONST_16
        MCU_CONST_32: alignment=32, sw-addrmethod=CONST, symbol=CONST_32
        MCU_CONST_8: alignment=8, sw-addrmethod=CONST, symbol=CONST_8
        MCU_CONST_UNSPECIFIED: alignment=UNSPECIFIED, sw-addrmethod=CONST, symbol=CONST_UNSPECIFIED
        MCU_RAMCODE: sw-addrmethod=CODE, symbol=RAMCODE
        MCU_VAR_CLEARED_32: alignment=32, sw-addrmethod=VAR_CLEARED, symbol=VAR_CLEARED_32
        MCU_VAR_CLEARED_8: alignment=8, sw-addrmethod=VAR_CLEARED, symbol=VAR_CLEARED_8
        MCU_VAR_CLEARED_UNSPECIFIED: alignment=UNSPECIFIED, sw-addrmethod=VAR_CLEARED, symbol=VAR_CLEARED_UNSPECIFIED
        MCU_VAR_INIT_32: alignment=32, sw-addrmethod=VAR_INIT, symbol=VAR_INIT_32
        MCU_VAR_INIT_8: alignment=8, sw-addrmethod=VAR_INIT, symbol=VAR_INIT_8
        MCU_VAR_INIT_UNSPECIFIED: alignment=UNSPECIFIED, sw-addrmethod=VAR_INIT, symbol=VAR_INIT_UNSPECIFIED
