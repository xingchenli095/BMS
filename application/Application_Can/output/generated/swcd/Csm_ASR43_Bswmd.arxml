AUTOSAR XML (schema 4-0-3)
package /AUTOSAR_Csm/ImplementationDataTypes
  impl type Uint8Ptr2Const: category=ARRAY, type-emitter=BSW
    element AuxCsm_Uint8Ptr2Const: array-size=1, array-size-semantics=FIXED-SIZE, implementation-data-type=uint8
  impl type Crypto_OperationModeType: compu {1=CRYPTO_OPERATIONMODE_START, 2=CRYPTO_OPERATIONMODE_UPDATE, 3=CRYPTO_OPERATIONMODE_STREAMSTART, 4=CRYPTO_OPERATIONMODE_FINISH, 7=CRYPTO_OPERATIONMODE_SINGLECALL}, range raw 1..7, implementation-data-type=uint8, type-emitter=BSW
  impl type Crypto_VerifyResultType: compu {0=CRYPTO_E_VER_OK, 1=CRYPTO_E_VER_NOT_OK}, range raw 0..1, implementation-data-type=uint8, type-emitter=BSW
package /AUTOSAR_Csm/BswModuleDescriptions
  bsw module description Csm: module-id=110
    provided-entrys:
      Csm_Init
      Csm_CertificateParse
      Csm_CertificateVerify
      Csm_KeyCopy
      Csm_KeyDerive
      Csm_KeyElementCopy
      Csm_KeyElementGet
      Csm_KeyElementSet
      Csm_KeyExchangeCalcPubVal
      Csm_KeyExchangeCalcSecret
      Csm_KeyGenerate
      Csm_KeySetValid
      Csm_RandomSeed
      Csm_MacGenerate
      Csm_MacVerify
      Csm_CancelJob
    bsw internal behavior InternalBehavior_0
      exclusive area SCHM_CSM_EXCLUSIVE_AREA_0
      16 x bsw called entity:
        Csm_Init: implemented-entry=Csm_Init
        CE_Key_CertificateParse: implemented-entry=Csm_CertificateParse
        CE_Key_CertificateVerify: implemented-entry=Csm_CertificateVerify
        CE_Key_KeyCopy: implemented-entry=Csm_KeyCopy
        CE_Key_KeyDerive: implemented-entry=Csm_KeyDerive
        CE_Key_KeyElementCopy: implemented-entry=Csm_KeyElementCopy
        CE_Key_KeyElementGet: implemented-entry=Csm_KeyElementGet
        CE_Key_KeyElementSet: implemented-entry=Csm_KeyElementSet
        CE_Key_KeyExchangeCalcPubVal: implemented-entry=Csm_KeyExchangeCalcPubVal
        CE_Key_KeyExchangeCalcSecret: implemented-entry=Csm_KeyExchangeCalcSecret
        CE_Key_KeyGenerate: implemented-entry=Csm_KeyGenerate
        CE_Key_KeySetValid: implemented-entry=Csm_KeySetValid
        CE_Key_RandomSeed: implemented-entry=Csm_RandomSeed
        CE_Job_MacGenerate: can-enter-exclusive-area=SCHM_CSM_EXCLUSIVE_AREA_0, implemented-entry=Csm_MacGenerate
        CE_Job_MacVerify: can-enter-exclusive-area=SCHM_CSM_EXCLUSIVE_AREA_0, implemented-entry=Csm_MacVerify
        CE_Job_CancelJob: can-enter-exclusive-area=SCHM_CSM_EXCLUSIVE_AREA_0, implemented-entry=Csm_CancelJob
package /AUTOSAR_Csm/BswModuleEntrys
  16 x bsw module entry, all with is-synchronous=true, call-type=REGULAR, execution-context=UNSPECIFIED, sw-service-impl-policy=STANDARD:
    Csm_Init: service-id=0, is-reentrant=true
    Csm_CertificateParse: service-id=110, is-reentrant=true
      return type retval: direction=OUT, implementation-data-type=Std_ReturnType
      sw service arg keyId: direction=IN, implementation-data-type=uint32
    Csm_CertificateVerify: service-id=116, is-reentrant=true
      return type retval: direction=OUT, implementation-data-type=Std_ReturnType
      sw service arg keyId: direction=IN, implementation-data-type=uint32
      sw service arg verifyCryIfKeyId: direction=IN, implementation-data-type=uint32
      sw service arg verifyPtr: direction=OUT, implementation-data-type=Crypto_VerifyResultType
    Csm_KeyCopy: service-id=115, is-reentrant=true
      return type retval: direction=OUT, implementation-data-type=Std_ReturnType
      sw service arg keyId: direction=IN, implementation-data-type=uint32
      sw service arg targetKeyId: direction=IN, implementation-data-type=uint32
    Csm_KeyDerive: service-id=107, is-reentrant=true
      return type retval: direction=OUT, implementation-data-type=Std_ReturnType
      sw service arg keyId: direction=IN, implementation-data-type=uint32
      sw service arg targetKeyId: direction=IN, implementation-data-type=uint32
    Csm_KeyElementCopy: service-id=113, is-reentrant=true
      return type retval: direction=OUT, implementation-data-type=Std_ReturnType
      4 x sw service arg, all with direction=IN, implementation-data-type=uint32:
        keyId
        keyElementId
        targetKeyId
        targetKeyElementId
    Csm_KeyElementGet: service-id=104, is-reentrant=true
      return type retval: direction=OUT, implementation-data-type=Std_ReturnType
      4 x sw service arg:
        keyId: direction=IN, implementation-data-type=uint32
        keyElementId: direction=IN, implementation-data-type=uint32
        keyPtr: direction=OUT, implementation-data-type=uint8
        keyLengthPtr: direction=INOUT, implementation-data-type=uint32
    Csm_KeyElementSet: service-id=120, is-reentrant=false
      return type retval: direction=OUT, implementation-data-type=Std_ReturnType
      4 x sw service arg, all with direction=IN:
        keyId: implementation-data-type=uint32
        keyElementId: implementation-data-type=uint32
        keyPtr: implementation-data-type=Uint8Ptr2Const, sw-impl-policy=CONST
        keyLength: implementation-data-type=uint32
    Csm_KeyExchangeCalcPubVal: service-id=108, is-reentrant=true
      return type retval: direction=OUT, implementation-data-type=Std_ReturnType
      sw service arg keyId: direction=IN, implementation-data-type=uint32
      sw service arg publicValuePtr: direction=OUT, implementation-data-type=uint8
      sw service arg publicValueLengthPtr: direction=INOUT, implementation-data-type=uint32
    Csm_KeyExchangeCalcSecret: service-id=109, is-reentrant=true
      return type retval: direction=OUT, implementation-data-type=Std_ReturnType
      sw service arg keyId: direction=IN, implementation-data-type=uint32
      sw service arg partnerPublicValuePtr: direction=IN, implementation-data-type=Uint8Ptr2Const, sw-impl-policy=CONST
      sw service arg partnerPublicValueLength: direction=IN, implementation-data-type=uint32
    Csm_KeyGenerate: service-id=106, is-reentrant=true
      return type retval: direction=OUT, implementation-data-type=Std_ReturnType
      sw service arg keyId: direction=IN, implementation-data-type=uint32
    Csm_KeySetValid: service-id=103, is-reentrant=false
      return type retval: direction=OUT, implementation-data-type=Std_ReturnType
      sw service arg keyId: direction=IN, implementation-data-type=uint32
    Csm_RandomSeed: service-id=105, is-reentrant=true
      return type retval: direction=OUT, implementation-data-type=Std_ReturnType
      sw service arg keyId: direction=IN, implementation-data-type=uint32
      sw service arg seedPtr: direction=IN, implementation-data-type=Uint8Ptr2Const, sw-impl-policy=CONST
      sw service arg seedLength: direction=IN, implementation-data-type=uint32
    Csm_MacGenerate: service-id=96, is-reentrant=true
      return type retval: direction=OUT, implementation-data-type=Std_ReturnType
      6 x sw service arg:
        jobId: direction=IN, implementation-data-type=uint32
        mode: direction=IN, implementation-data-type=Crypto_OperationModeType
        dataPtr: direction=IN, implementation-data-type=Uint8Ptr2Const, sw-impl-policy=CONST
        dataLength: direction=IN, implementation-data-type=uint32
        macPtr: direction=OUT, implementation-data-type=uint8
        macLengthPtr: direction=INOUT, implementation-data-type=uint32
    Csm_MacVerify: service-id=97, is-reentrant=true
      return type retval: direction=OUT, implementation-data-type=Std_ReturnType
      7 x sw service arg:
        jobId: direction=IN, implementation-data-type=uint32
        mode: direction=IN, implementation-data-type=Crypto_OperationModeType
        dataPtr: direction=IN, implementation-data-type=Uint8Ptr2Const, sw-impl-policy=CONST
        dataLength: direction=IN, implementation-data-type=uint32
        macPtr: direction=IN, implementation-data-type=Uint8Ptr2Const, sw-impl-policy=CONST
        macLength: direction=IN, implementation-data-type=uint32
        verifyPtr: direction=OUT, implementation-data-type=Crypto_VerifyResultType
    Csm_CancelJob: service-id=111, is-reentrant=false
      return type retval: direction=OUT, implementation-data-type=Std_ReturnType
      sw service arg job: direction=IN, implementation-data-type=uint32
      sw service arg mode: direction=IN, implementation-data-type=Crypto_OperationModeType
package /EB_Csm/Implementations
  bsw implementation BswImplementation_0: programming-language=C, sw-version=3.1.22, vendor-id=1, ar-release-version=4.3.0, behavior=InternalBehavior_0, vendor-specific-module-def=Csm
    code-descriptors:
      code Files
        artifact-descriptors:
          short-label=Autosar::include::Csm.h, category=SWHDR
          short-label=Autosar::include::Csm_Cbk.h, category=SWHDR
          short-label=Autosar::include::Csm_Int.h, category=SWHDR
          short-label=Autosar::include::Csm_Version.h, category=SWHDR
          short-label=Autosar::src::Csm.c, category=SWSRC
          short-label=Autosar::src::Csm_Int.c, category=SWSRC
          short-label=make::Csm_defs.mak, category=SWMAKE
          short-label=make::Csm_rules.mak, category=SWMAKE
    resource consumption ResourceConsumption
      5 x memory section:
        CODE: sw-addrmethod=CODE
        VAR_INIT_8: alignment=8, sw-addrmethod=VAR
        VAR_INIT_UNSPECIFIED: alignment=UNSPECIFIED, sw-addrmethod=VAR
        CONST_UNSPECIFIED: alignment=UNSPECIFIED, sw-addrmethod=CONST
        CONST_32: alignment=32, sw-addrmethod=CONST
