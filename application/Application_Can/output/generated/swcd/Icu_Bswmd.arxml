AUTOSAR XML (schema 4-0-3)
package /AUTOSAR_Icu/BswModuleDescriptions
  bsw module description Icu: module-id=122, provided-entrys=Icu_Init
    bsw internal behavior InternalBehavior_0
      15 x exclusive area:
        ICU_EXCLUSIVE_AREA_00
        ICU_EXCLUSIVE_AREA_01
        ICU_EXCLUSIVE_AREA_03
        ICU_EXCLUSIVE_AREA_08
        ICU_EXCLUSIVE_AREA_09
        ICU_EXCLUSIVE_AREA_{46..53}
        ICU_EXCLUSIVE_AREA_57
        ICU_EXCLUSIVE_AREA_58
      bsw called entity Icu_Init: can-enter-exclusive-area=[ICU_EXCLUSIVE_AREA_00, ICU_EXCLUSIVE_AREA_01, ICU_EXCLUSIVE_AREA_03, ICU_EXCLUSIVE_AREA_08, ICU_EXCLUSIVE_AREA_09, ICU_EXCLUSIVE_AREA_46, ICU_EXCLUSIVE_AREA_47, ICU_EXCLUSIVE_AREA_48, ICU_EXCLUSIVE_AREA_49, ICU_EXCLUSIVE_AREA_50, ICU_EXCLUSIVE_AREA_51, ICU_EXCLUSIVE_AREA_52, ICU_EXCLUSIVE_AREA_53, ICU_EXCLUSIVE_AREA_57, ICU_EXCLUSIVE_AREA_58], implemented-entry=Icu_Init
package /AUTOSAR_Icu/BswModuleEntrys
  bsw module entry Icu_Init: service-id=0, is-reentrant=false, is-synchronous=true, call-type=REGULAR, execution-context=UNSPECIFIED, sw-service-impl-policy=STANDARD
package /Icu_TS_T40D34M20I1R0/Implementations
  bsw implementation BswImplementation_0: programming-language=C, sw-version=2.0.1, vendor-id=43, ar-release-version=4.4.0, behavior=InternalBehavior_0, vendor-specific-module-def=Icu
    code-descriptors:
      code Files: artifact-descriptors=[{short-label=make::Icu_defs.mak, category=SWMAKE}, {short-label=make::Icu_rules.mak, category=SWMAKE}]
    resource consumption ResourceConsumption
      6 x memory section:
        ICU_CODE: sw-addrmethod=CODE, symbol=CODE
        ICU_CONFIG_DATA_UNSPECIFIED: alignment=UNSPECIFIED, sw-addrmethod=CONFIG_DATA, symbol=CONFIG_DATA_UNSPECIFIED
        ICU_CONST_UNSPECIFIED: alignment=UNSPECIFIED, sw-addrmethod=CONST, symbol=CONST_UNSPECIFIED
        ICU_VAR_CLEARED_BOOLEAN: alignment=BOOLEAN, sw-addrmethod=VAR_CLEARED, symbol=VAR_CLEARED_BOOLEAN
        ICU_VAR_CLEARED_UNSPECIFIED: alignment=UNSPECIFIED, sw-addrmethod=VAR_CLEARED, symbol=VAR_CLEARED_UNSPECIFIED
        ICU_VAR_CLEARED_UNSPECIFIED_NO_CACHEABLE: sw-addrmethod=VAR_CLEARED, symbol=VAR_CLEARED_UNSPECIFIED_NO_CACHEABLE
