AUTOSAR XML (schema 4-0-3)
package /AUTOSAR_Crypto/BswModuleDescriptions
  bsw module description Crypto: module-id=114, provided-entrys=[Crypto_Init, Crypto_MainFunction]
    bsw internal behavior InternalBehavior_0
      exclusive area SCHM_CRYPTO_EXCLUSIVE_AREA_DRIVEROBJECT
      bsw schedulable entity Crypto_MainFunction: can-enter-exclusive-area=SCHM_CRYPTO_EXCLUSIVE_AREA_DRIVEROBJECT, implemented-entry=Crypto_MainFunction
      bsw called entity Crypto_Init: can-enter-exclusive-area=SCHM_CRYPTO_EXCLUSIVE_AREA_DRIVEROBJECT, implemented-entry=Crypto_Init
      bsw timing event TimingEvent_MainFunction: starts-on-event=Crypto_MainFunction, period=0.01
package /AUTOSAR_Crypto/BswModuleEntrys
  bsw module entry Crypto_MainFunction: service-id=12, is-reentrant=false, is-synchronous=true, call-type=SCHEDULED, execution-context=TASK, sw-service-impl-policy=STANDARD
  bsw module entry Crypto_Init: service-id=55, is-reentrant=false, is-synchronous=true, call-type=REGULAR, execution-context=UNSPECIFIED, sw-service-impl-policy=STANDARD
package /EB_Crypto/Implementations
  bsw implementation BswImplementation_0: programming-language=C, sw-version=1.7.51, vendor-id=1, ar-release-version=4.3.0, behavior=InternalBehavior_0, vendor-specific-module-def=Crypto
    code-descriptors:
      code Files
        artifact-descriptors:
          short-label=Autosar_Generic::include::Crypto.h, category=SWHDR
          short-label=Autosar_Generic::include::Crypto_AL.h, category=SWHDR
          short-label=Autosar_Generic::include::Crypto_AL_AEAD.h, category=SWHDR
          short-label=Autosar_Generic::include::Crypto_AL_AES_CFB.h, category=SWHDR
          short-label=Autosar_Generic::include::Crypto_AL_Base64.h, category=SWHDR
          short-label=Autosar_Generic::include::Crypto_AL_Cipher.h, category=SWHDR
          short-label=Autosar_Generic::include::Crypto_AL_Common.h, category=SWHDR
          short-label=Autosar_Generic::include::Crypto_AL_Der.h, category=SWHDR
          short-label=Autosar_Generic::include::Crypto_AL_DerCVC.h, category=SWHDR
          short-label=Autosar_Generic::include::Crypto_AL_ECC_NISTP256.h, category=SWHDR
          short-label=Autosar_Generic::include::Crypto_AL_Hash.h, category=SWHDR
          short-label=Autosar_Generic::include::Crypto_AL_KeyManagement.h, category=SWHDR
          short-label=Autosar_Generic::include::Crypto_AL_Mac.h, category=SWHDR
          short-label=Autosar_Generic::include::Crypto_AL_RSA.h, category=SWHDR
          short-label=Autosar_Generic::include::Crypto_AL_Random.h, category=SWHDR
          short-label=Autosar_Generic::include::Crypto_AL_RsaSsaPkcs1v15Gen.h, category=SWHDR
          short-label=Autosar_Generic::include::Crypto_AL_RsaSsaPkcs1v15Vrfy.h, category=SWHDR
          short-label=Autosar_Generic::include::Crypto_AL_RsaesOaep.h, category=SWHDR
          short-label=Autosar_Generic::include::Crypto_AL_SHA1.h, category=SWHDR
          short-label=Autosar_Generic::include::Crypto_AL_SHA3.h, category=SWHDR
          short-label=Autosar_Generic::include::Crypto_AL_Signature.h, category=SWHDR
          short-label=Autosar_Generic::include::Crypto_AL_SipHash.h, category=SWHDR
          short-label=Autosar_Generic::include::Crypto_Int.h, category=SWHDR
          short-label=Autosar_Generic::include::Crypto_KeyManagement.h, category=SWHDR
          short-label=Autosar_Generic::include::Crypto_Version.h, category=SWHDR
          short-label=Autosar_Generic::src::Crypto_AL_AEAD.c, category=SWSRC
          short-label=Autosar_Generic::src::Crypto_AL_AES_CFB.c, category=SWSRC
          short-label=Autosar_Generic::src::Crypto_AL_Base64.c, category=SWSRC
          short-label=Autosar_Generic::src::Crypto_AL_Cipher.c, category=SWSRC
          short-label=Autosar_Generic::src::Crypto_AL_Common.c, category=SWSRC
          short-label=Autosar_Generic::src::Crypto_AL_Der.c, category=SWSRC
          short-label=Autosar_Generic::src::Crypto_AL_DerCVC.c, category=SWSRC
          short-label=Autosar_Generic::src::Crypto_AL_ECC_NISTP256.c, category=SWSRC
          short-label=Autosar_Generic::src::Crypto_AL_Hash.c, category=SWSRC
          short-label=Autosar_Generic::src::Crypto_AL_KeyManagement.c, category=SWSRC
          short-label=Autosar_Generic::src::Crypto_AL_Mac.c, category=SWSRC
          short-label=Autosar_Generic::src::Crypto_AL_RSA.c, category=SWSRC
          short-label=Autosar_Generic::src::Crypto_AL_Random.c, category=SWSRC
          short-label=Autosar_Generic::src::Crypto_AL_RsaSsaPkcs1v15Gen.c, category=SWSRC
          short-label=Autosar_Generic::src::Crypto_AL_RsaSsaPkcs1v15Vrfy.c, category=SWSRC
          short-label=Autosar_Generic::src::Crypto_AL_RsaesOaep.c, category=SWSRC
          short-label=Autosar_Generic::src::Crypto_AL_SHA1.c, category=SWSRC
          short-label=Autosar_Generic::src::Crypto_AL_SHA3.c, category=SWSRC
          short-label=Autosar_Generic::src::Crypto_AL_Signature.c, category=SWSRC
          short-label=Autosar_Generic::src::Crypto_AL_SipHash.c, category=SWSRC
          short-label=Autosar_Generic::src::Crypto_Int.c, category=SWSRC
          short-label=Autosar_Generic::src::Crypto_KeyManagement.c, category=SWSRC
          short-label=make::Crypto_defs.mak, category=SWMAKE
          short-label=make::Crypto_rules.mak, category=SWMAKE
    resource consumption ResourceConsumption
      11 x memory section:
        CODE: sw-addrmethod=CODE
        CONST_8: alignment=8, sw-addrmethod=CONST
        CONST_32: alignment=32, sw-addrmethod=CONST
        CONST_UNSPECIFIED: alignment=UNSPECIFIED, sw-addrmethod=CONST
        VAR_INIT_BOOLEAN: alignment=BOOLEAN, sw-addrmethod=VAR_INIT
        VAR_INIT_8: alignment=8, sw-addrmethod=VAR_INIT
        VAR_INIT_UNSPECIFIED: alignment=UNSPECIFIED, sw-addrmethod=VAR_INIT
        VAR_CLEARED_8: alignment=8, sw-addrmethod=VAR_CLEARED
        VAR_CLEARED_32: alignment=32, sw-addrmethod=VAR_CLEARED
        VAR_CLEARED_64: alignment=64, sw-addrmethod=VAR_CLEARED
        VAR_CLEARED_UNSPECIFIED: alignment=UNSPECIFIED, sw-addrmethod=VAR_CLEARED
