AUTOSAR XML (schema 4-0-3)
package /AUTOSAR_WdgM/BswModuleDescriptions
  bsw module description WdgM: module-id=13, provided-entrys=WdgM_MainFunction
    bsw internal behavior InternalBehavior_0
      bsw schedulable entity WdgM_MainFunction: implemented-entry=WdgM_MainFunction
      bsw timing event TimingEvent_MainFunction: starts-on-event=WdgM_MainFunction, period=0.01
package /AUTOSAR_WdgM/BswModuleEntrys
  bsw module entry WdgM_MainFunction: service-id=8, is-reentrant=false, is-synchronous=true, call-type=SCHEDULED, execution-context=TASK, sw-service-impl-policy=STANDARD
package /EB_WdgM/Implementations
  bsw implementation BswImplementation_0: programming-language=C, sw-version=6.1.42, vendor-id=1, ar-release-version=4.0.3, behavior=InternalBehavior_0, vendor-specific-module-def=WdgM
    code-descriptors:
      code Files
        artifact-descriptors:
          short-label=Autosar::include::WdgM.h, category=SWHDR
          short-label=Autosar::include::WdgM_BSW_Lcfg.h, category=SWHDR
          short-label=Autosar::include::WdgM_Int.h, category=SWHDR
          short-label=Autosar::include::WdgM_Trace_Stc.h, category=SWHDR
          short-label=Autosar::include::WdgM_Version.h, category=SWHDR
          short-label=Autosar::src::WdgM.c, category=SWSRC
          short-label=make::WdgM_defs.mak, category=SWMAKE
          short-label=make::WdgM_rules.mak, category=SWMAKE
    resource consumption ResourceConsumption
      23 x memory section:
        CODE: sw-addrmethod=CODE
        CALLOUT_CODE_ASIL_D: options=safetyAsilD, sw-addrmethod=CODE_ASIL_D
        CODE_ASIL_D: executable-entity=WdgM_MainFunction, options=safetyAsilD, sw-addrmethod=CODE_ASIL_D
        CONST_8: alignment=8, sw-addrmethod=CONST
        CONST_ASIL_D_8: alignment=8, options=safetyAsilD, sw-addrmethod=CONST_ASIL_D
        CONST_16: alignment=16, sw-addrmethod=CONST
        CONST_ASIL_D_16: alignment=16, options=safetyAsilD, sw-addrmethod=CONST_ASIL_D
        CONST_ASIL_D_UNSPECIFIED: alignment=UNSPECIFIED, options=safetyAsilD, sw-addrmethod=CONST_ASIL_D
        VAR_CLEARED_ASIL_D_UNSPECIFIED: alignment=UNSPECIFIED, options=safetyAsilD, sw-addrmethod=VAR_CLEARED_ASIL_D
        VAR_INIT_ASIL_D_UNSPECIFIED: alignment=UNSPECIFIED, options=safetyAsilD, sw-addrmethod=VAR_INIT_ASIL_D
        VAR_CLEARED_16: alignment=16, sw-addrmethod=VAR_CLEARED
        VAR_CLEARED_ASIL_D_16: alignment=16, options=safetyAsilD, sw-addrmethod=VAR_CLEARED_ASIL_D
        VAR_CLEARED_ASIL_D_32: alignment=32, options=safetyAsilD, sw-addrmethod=VAR_CLEARED_ASIL_D
        VAR_INIT_ASIL_D_8: alignment=8, options=safetyAsilD, sw-addrmethod=VAR_INIT_ASIL_D
        VAR_INIT_8: alignment=8, sw-addrmethod=VAR_INIT
        VAR_INIT_16: alignment=16, sw-addrmethod=VAR_INIT
        VAR_CLEARED_UNSPECIFIED: alignment=UNSPECIFIED, sw-addrmethod=VAR_CLEARED
        VAR_CLEARED_ASIL_D_8: alignment=8, options=safetyAsilD, sw-addrmethod=VAR_CLEARED_ASIL_D
        VAR_INIT_ASIL_D_LOCAL_8: alignment=8, options=[safetyAsilD, coreLocal], sw-addrmethod=VAR_FAST_ASIL_D_LOCAL
        VAR_CLEARED_32: alignment=32, sw-addrmethod=VAR_CLEARED
        VAR_POWER_ON_INIT_ASIL_D_16: alignment=16, options=safetyAsilD, sw-addrmethod=VAR_POWER_ON_INIT_ASIL_D
        VAR_INIT_ASIL_D_32: alignment=32, options=safetyAsilD, sw-addrmethod=VAR_INIT_ASIL_D
        VAR_POWER_ON_INIT_ASIL_D_UNSPECIFIED: alignment=UNSPECIFIED, options=safetyAsilD, sw-addrmethod=VAR_POWER_ON_INIT_ASIL_D
