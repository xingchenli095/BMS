AUTOSAR XML (schema 4-0-3)
package /AUTOSAR_Dio/BswModuleDescriptions
  bsw module description Dio: module-id=120, provided-entrys=Dio_Init
    bsw internal behavior InternalBehavior_0
      exclusive area DIO_EXCLUSIVE_AREA_00
      exclusive area DIO_EXCLUSIVE_AREA_01
      bsw called entity Dio_Init: can-enter-exclusive-area=[DIO_EXCLUSIVE_AREA_00, DIO_EXCLUSIVE_AREA_01], implemented-entry=Dio_Init
package /AUTOSAR_Dio/BswModuleEntrys
  bsw module entry Dio_Init: service-id=16, is-reentrant=false, is-synchronous=true, call-type=REGULAR, execution-context=UNSPECIFIED, sw-service-impl-policy=STANDARD
package /Dio_TS_T40D34M20I1R0/Implementations
  bsw implementation BswImplementation_0: programming-language=C, sw-version=2.0.1, vendor-id=43, ar-release-version=4.4.0, behavior=InternalBehavior_0, vendor-specific-module-def=Dio
    code-descriptors:
      code Files: artifact-descriptors=[{short-label=make::Dio_defs.mak, category=SWMAKE}, {short-label=make::Dio_rules.mak, category=SWMAKE}]
    resource consumption ResourceConsumption
      6 x memory section:
        DIO_CODE: sw-addrmethod=CODE, symbol=CODE
        DIO_CONFIG_DATA_UNSPECIFIED: alignment=UNSPECIFIED, sw-addrmethod=CONFIG_DATA, symbol=CONFIG_DATA_UNSPECIFIED
        DIO_CONST_16: alignment=16, sw-addrmethod=CONST, symbol=CONST_16
        DIO_CONST_32: alignment=32, sw-addrmethod=CONST, symbol=CONST_32
        DIO_CONST_8: alignment=8, sw-addrmethod=CONST, symbol=CONST_8
        DIO_VAR_INIT_32: alignment=32, sw-addrmethod=VAR_INIT, symbol=VAR_INIT_32
