AUTOSAR XML (schema 4-0-3)
package /AUTOSAR_Crc/BswModuleDescriptions
  bsw module description Crc: module-id=201, provided-entrys=[Crc_CalculateCRC16, Crc_GetVersionInfo, Crc_CalculateCRC32]
    bsw internal behavior InternalBehavior_0
      bsw called entity Crc_GetVersionInfo: implemented-entry=Crc_GetVersionInfo
      bsw called entity Crc_CalculateCRC16: implemented-entry=Crc_CalculateCRC16
      bsw called entity Crc_CalculateCRC32: implemented-entry=Crc_CalculateCRC32
package /AUTOSAR_Crc/BswModuleEntrys
  bsw module entry Crc_CalculateCRC16: service-id=2, is-reentrant=true, is-synchronous=true, call-type=REGULAR, execution-context=TASK, sw-service-impl-policy=STANDARD
    return type Crc_RetValue16: direction=OUT, implementation-data-type=uint16
    4 x sw service arg, all with direction=IN:
      Crc_DataPtr: implementation-data-type=VoidPtr
      Crc_Length: implementation-data-type=uint32
      Crc_StartValue16: implementation-data-type=uint16
      Crc_IsFirstCall: implementation-data-type=boolean
  bsw module entry Crc_GetVersionInfo: service-id=4, is-reentrant=true, is-synchronous=true, call-type=REGULAR, execution-context=TASK, sw-service-impl-policy=STANDARD
    sw service arg VersionInfoPtr: direction=OUT, implementation-data-type=VoidPtr
  bsw module entry Crc_CalculateCRC32: service-id=3, is-reentrant=true, is-synchronous=true, call-type=REGULAR, execution-context=TASK, sw-service-impl-policy=STANDARD
    return type Crc_RetValue32: direction=OUT, implementation-data-type=uint32
    4 x sw service arg, all with direction=IN:
      Crc_DataPtr: implementation-data-type=VoidPtr
      Crc_Length: implementation-data-type=uint32
      Crc_StartValue32: implementation-data-type=uint32
      Crc_IsFirstCall: implementation-data-type=boolean
package /EB_Crc/Implementations
  bsw implementation BswImplementation_0: programming-language=C, sw-version=6.11.16, vendor-id=1, ar-release-version=4.0.3, behavior=InternalBehavior_0, vendor-specific-module-def=Crc
    code-descriptors:
      code Files
        artifact-descriptors:
          short-label=Autosar::include::Crc.h, category=SWHDR
          short-label=Autosar::include::Crc_Trace.h, category=SWHDR
          short-label=Autosar::include::Crc_Trace_Internal.h, category=SWHDR
          short-label=Autosar::include::Crc_Version.h, category=SWHDR
          short-label=Autosar::src::Crc.c, category=SWSRC
          short-label=make::Crc_defs.mak, category=SWMAKE
          short-label=make::Crc_rules.mak, category=SWMAKE
    resource consumption ResourceConsumption
      5 x memory section:
        CONST_8: alignment=8, sw-addrmethod=CONST
        CONST_16: alignment=16, sw-addrmethod=CONST
        CONST_32: alignment=32, sw-addrmethod=CONST
        CONST_64: alignment=64, sw-addrmethod=CONST
        CODE: sw-addrmethod=CODE
