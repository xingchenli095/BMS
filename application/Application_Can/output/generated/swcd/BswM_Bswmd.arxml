AUTOSAR XML (schema 4-0-3)
package /AUTOSAR_BswM/BswModuleDescriptions
  bsw module description BswM: module-id=042
    provided-entrys:
      BswM_MainFunction
      BswM_Init
      BswM_MRPFunc_BswM_ModeReqPort_Dcm_ResetModeRequest_JUMPTOSYSSUPPLIERBOOTLOADER
      BswM_MRPFunc_BswM_ModeReqPort_DcmResponseOnEvent_EVENT_STARTED
      BswM_MRPFunc_BswM_ModeReqPort_DcmCommunicationControl_DCM_DISABLE_RX_ENABLE_TX_NM
      BswM_MRPFunc_BswM_ModeReqPort_Dcm_ResetModeRequest_NONE
      BswM_MRPFunc_BswM_ModeReqPort_Dcm_ResetModeRequest_HARD
      BswM_MRPFunc_BswM_ModeReqPort_DcmCommunicationControl_DCM_DISABLE_RX_ENABLE_TX_NORM_NM
      BswM_MRPFunc_BswM_ModeReqPort_DcmResponseOnEvent_EVENT_CLEARED
      BswM_MRPFunc_BswM_ModeReqPort_DcmCommunicationControl_DCM_ENABLE_RX_TX_NM
      BswM_MRPFunc_BswM_ModeReqPort_Dcm_ResetModeRequest_SOFT
      BswM_MRPFunc_BswM_ModeReqPort_DcmCommunicationControl_DCM_DISABLE_RX_TX_NORM
      BswM_MRPFunc_BswM_ModeReqPort_DcmCommunicationControl_DCM_ENABLE_RX_DISABLE_TX_NM
      BswM_MRPFunc_BswM_ModeReqPort_DcmResponseOnEvent_EVENT_STOPPED
      BswM_MRPFunc_BswM_ModeReqPort_DcmDiagnosticSessionControl_Extended
      BswM_MRPFunc_BswM_ModeReqPort_DcmDiagnosticSessionControl_Default
      BswM_MRPFunc_BswM_ModeReqPort_Dcm_ResetModeRequest_KEYONOFF
      BswM_MRPFunc_BswM_ModeReqPort_DcmCommunicationControl_DCM_DISABLE_RX_TX_NORM_NM
      BswM_MRPFunc_BswM_ModeReqPort_Dcm_ResetModeRequest_JUMPTOBOOTLOADER
      BswM_MRPFunc_BswM_ModeReqPort_DcmCommunicationControl_DCM_ENABLE_RX_DISABLE_TX_NORM
      BswM_MRPFunc_BswM_ModeReqPort_Dcm_ResetModeRequest_EXECUTE
      BswM_MRPFunc_BswM_ModeReqPort_DcmCommunicationControl_DCM_DISABLE_RX_TX_NM
      BswM_MRPFunc_BswM_ModeReqPort_DcmCommunicationControl_DCM_ENABLE_RX_TX_NORM_NM
      BswM_MRPFunc_BswM_ModeReqPort_DcmCommunicationControl_DCM_ENABLE_RX_DISABLE_TX_NORM_NM
      BswM_MRPFunc_BswM_ModeReqPort_DcmDiagnosticSessionControl_Programming
      BswM_MRPFunc_BswM_ModeReqPort_DcmCommunicationControl_DCM_DISABLE_RX_ENABLE_TX_NORM
      BswM_MRPFunc_BswM_ModeReqPort_DcmCommunicationControl_DCM_ENABLE_RX_TX_NORM
    required-mode-groups:
      4 x mode declaration group prototype:
        BswM_ModeNotificationPort_BswM_ModeReqPort_DcmCommunicationControl: type=DcmCommunicationControl
        BswM_ModeNotificationPort_BswM_ModeReqPort_DcmDiagnosticSessionControl: type=DcmDiagnosticSessionControl
        BswM_ModeNotificationPort_BswM_ModeReqPort_DcmResponseOnEvent: type=DcmResponseOnEvent_0
        BswM_ModeNotificationPort_BswM_ModeReqPort_Dcm_ResetModeRequest: type=DcmEcuReset
    bsw internal behavior InternalBehavior_0: data-type-mapping=[BswMModeMapping, ModeMapping, DataTypeMappingSet_0, AppModeMapping]
      exclusive area SCHM_BSWM_EXCLUSIVE_AREA
      26 x bsw schedulable entity:
        SE_BswM_ModeReqPort_DcmCommunicationControl_DCM_ENABLE_RX_TX_NORM: accessed-mode-groups=BswM_ModeNotificationPort_BswM_ModeReqPort_DcmCommunicationControl, implemented-entry=BswM_MRPFunc_BswM_ModeReqPort_DcmCommunicationControl_DCM_ENABLE_RX_TX_NORM
        SE_BswM_ModeReqPort_DcmCommunicationControl_DCM_ENABLE_RX_DISABLE_TX_NORM: accessed-mode-groups=BswM_ModeNotificationPort_BswM_ModeReqPort_DcmCommunicationControl, implemented-entry=BswM_MRPFunc_BswM_ModeReqPort_DcmCommunicationControl_DCM_ENABLE_RX_DISABLE_TX_NORM
        SE_BswM_ModeReqPort_DcmCommunicationControl_DCM_DISABLE_RX_ENABLE_TX_NORM: accessed-mode-groups=BswM_ModeNotificationPort_BswM_ModeReqPort_DcmCommunicationControl, implemented-entry=BswM_MRPFunc_BswM_ModeReqPort_DcmCommunicationControl_DCM_DISABLE_RX_ENABLE_TX_NORM
        SE_BswM_ModeReqPort_DcmCommunicationControl_DCM_DISABLE_RX_TX_NORM: accessed-mode-groups=BswM_ModeNotificationPort_BswM_ModeReqPort_DcmCommunicationControl, implemented-entry=BswM_MRPFunc_BswM_ModeReqPort_DcmCommunicationControl_DCM_DISABLE_RX_TX_NORM
        SE_BswM_ModeReqPort_DcmCommunicationControl_DCM_ENABLE_RX_TX_NM: accessed-mode-groups=BswM_ModeNotificationPort_BswM_ModeReqPort_DcmCommunicationControl, implemented-entry=BswM_MRPFunc_BswM_ModeReqPort_DcmCommunicationControl_DCM_ENABLE_RX_TX_NM
        SE_BswM_ModeReqPort_DcmCommunicationControl_DCM_ENABLE_RX_DISABLE_TX_NM: accessed-mode-groups=BswM_ModeNotificationPort_BswM_ModeReqPort_DcmCommunicationControl, implemented-entry=BswM_MRPFunc_BswM_ModeReqPort_DcmCommunicationControl_DCM_ENABLE_RX_DISABLE_TX_NM
        SE_BswM_ModeReqPort_DcmCommunicationControl_DCM_DISABLE_RX_ENABLE_TX_NM: accessed-mode-groups=BswM_ModeNotificationPort_BswM_ModeReqPort_DcmCommunicationControl, implemented-entry=BswM_MRPFunc_BswM_ModeReqPort_DcmCommunicationControl_DCM_DISABLE_RX_ENABLE_TX_NM
        SE_BswM_ModeReqPort_DcmCommunicationControl_DCM_DISABLE_RX_TX_NM: accessed-mode-groups=BswM_ModeNotificationPort_BswM_ModeReqPort_DcmCommunicationControl, implemented-entry=BswM_MRPFunc_BswM_ModeReqPort_DcmCommunicationControl_DCM_DISABLE_RX_TX_NM
        SE_BswM_ModeReqPort_DcmCommunicationControl_DCM_ENABLE_RX_TX_NORM_NM: accessed-mode-groups=BswM_ModeNotificationPort_BswM_ModeReqPort_DcmCommunicationControl, implemented-entry=BswM_MRPFunc_BswM_ModeReqPort_DcmCommunicationControl_DCM_ENABLE_RX_TX_NORM_NM
        SE_BswM_ModeReqPort_DcmCommunicationControl_DCM_ENABLE_RX_DISABLE_TX_NORM_NM: accessed-mode-groups=BswM_ModeNotificationPort_BswM_ModeReqPort_DcmCommunicationControl, implemented-entry=BswM_MRPFunc_BswM_ModeReqPort_DcmCommunicationControl_DCM_ENABLE_RX_DISABLE_TX_NORM_NM
        SE_BswM_ModeReqPort_DcmCommunicationControl_DCM_DISABLE_RX_ENABLE_TX_NORM_NM: accessed-mode-groups=BswM_ModeNotificationPort_BswM_ModeReqPort_DcmCommunicationControl, implemented-entry=BswM_MRPFunc_BswM_ModeReqPort_DcmCommunicationControl_DCM_DISABLE_RX_ENABLE_TX_NORM_NM
        SE_BswM_ModeReqPort_DcmCommunicationControl_DCM_DISABLE_RX_TX_NORM_NM: accessed-mode-groups=BswM_ModeNotificationPort_BswM_ModeReqPort_DcmCommunicationControl, implemented-entry=BswM_MRPFunc_BswM_ModeReqPort_DcmCommunicationControl_DCM_DISABLE_RX_TX_NORM_NM
        SE_BswM_ModeReqPort_DcmDiagnosticSessionControl_Default: accessed-mode-groups=BswM_ModeNotificationPort_BswM_ModeReqPort_DcmDiagnosticSessionControl, implemented-entry=BswM_MRPFunc_BswM_ModeReqPort_DcmDiagnosticSessionControl_Default
        SE_BswM_ModeReqPort_DcmDiagnosticSessionControl_Programming: accessed-mode-groups=BswM_ModeNotificationPort_BswM_ModeReqPort_DcmDiagnosticSessionControl, implemented-entry=BswM_MRPFunc_BswM_ModeReqPort_DcmDiagnosticSessionControl_Programming
        SE_BswM_ModeReqPort_DcmDiagnosticSessionControl_Extended: accessed-mode-groups=BswM_ModeNotificationPort_BswM_ModeReqPort_DcmDiagnosticSessionControl, implemented-entry=BswM_MRPFunc_BswM_ModeReqPort_DcmDiagnosticSessionControl_Extended
        SE_BswM_ModeReqPort_DcmResponseOnEvent_EVENT_STARTED: accessed-mode-groups=BswM_ModeNotificationPort_BswM_ModeReqPort_DcmResponseOnEvent, implemented-entry=BswM_MRPFunc_BswM_ModeReqPort_DcmResponseOnEvent_EVENT_STARTED
        SE_BswM_ModeReqPort_DcmResponseOnEvent_EVENT_STOPPED: accessed-mode-groups=BswM_ModeNotificationPort_BswM_ModeReqPort_DcmResponseOnEvent, implemented-entry=BswM_MRPFunc_BswM_ModeReqPort_DcmResponseOnEvent_EVENT_STOPPED
        SE_BswM_ModeReqPort_DcmResponseOnEvent_EVENT_CLEARED: accessed-mode-groups=BswM_ModeNotificationPort_BswM_ModeReqPort_DcmResponseOnEvent, implemented-entry=BswM_MRPFunc_BswM_ModeReqPort_DcmResponseOnEvent_EVENT_CLEARED
        SE_BswM_ModeReqPort_Dcm_ResetModeRequest_NONE: accessed-mode-groups=BswM_ModeNotificationPort_BswM_ModeReqPort_Dcm_ResetModeRequest, implemented-entry=BswM_MRPFunc_BswM_ModeReqPort_Dcm_ResetModeRequest_NONE
        SE_BswM_ModeReqPort_Dcm_ResetModeRequest_HARD: accessed-mode-groups=BswM_ModeNotificationPort_BswM_ModeReqPort_Dcm_ResetModeRequest, implemented-entry=BswM_MRPFunc_BswM_ModeReqPort_Dcm_ResetModeRequest_HARD
        SE_BswM_ModeReqPort_Dcm_ResetModeRequest_KEYONOFF: accessed-mode-groups=BswM_ModeNotificationPort_BswM_ModeReqPort_Dcm_ResetModeRequest, implemented-entry=BswM_MRPFunc_BswM_ModeReqPort_Dcm_ResetModeRequest_KEYONOFF
        SE_BswM_ModeReqPort_Dcm_ResetModeRequest_SOFT: accessed-mode-groups=BswM_ModeNotificationPort_BswM_ModeReqPort_Dcm_ResetModeRequest, implemented-entry=BswM_MRPFunc_BswM_ModeReqPort_Dcm_ResetModeRequest_SOFT
        SE_BswM_ModeReqPort_Dcm_ResetModeRequest_JUMPTOBOOTLOADER: accessed-mode-groups=BswM_ModeNotificationPort_BswM_ModeReqPort_Dcm_ResetModeRequest, implemented-entry=BswM_MRPFunc_BswM_ModeReqPort_Dcm_ResetModeRequest_JUMPTOBOOTLOADER
        SE_BswM_ModeReqPort_Dcm_ResetModeRequest_JUMPTOSYSSUPPLIERBOOTLOADER: accessed-mode-groups=BswM_ModeNotificationPort_BswM_ModeReqPort_Dcm_ResetModeRequest, implemented-entry=BswM_MRPFunc_BswM_ModeReqPort_Dcm_ResetModeRequest_JUMPTOSYSSUPPLIERBOOTLOADER
        SE_BswM_ModeReqPort_Dcm_ResetModeRequest_EXECUTE: accessed-mode-groups=BswM_ModeNotificationPort_BswM_ModeReqPort_Dcm_ResetModeRequest, implemented-entry=BswM_MRPFunc_BswM_ModeReqPort_Dcm_ResetModeRequest_EXECUTE
        BswM_MainFunction: can-enter-exclusive-area=SCHM_BSWM_EXCLUSIVE_AREA, implemented-entry=BswM_MainFunction
      25 x bsw mode switch event, all with activation=ON-ENTRY:
        MSE_BswM_ModeReqPort_DcmCommunicationControl_DCM_ENABLE_RX_TX_NORM: starts-on-event=SE_BswM_ModeReqPort_DcmCommunicationControl_DCM_ENABLE_RX_TX_NORM, mode=BswM_ModeNotificationPort_BswM_ModeReqPort_DcmCommunicationControl.DCM_ENABLE_RX_TX_NORM
        MSE_BswM_ModeReqPort_DcmCommunicationControl_DCM_ENABLE_RX_DISABLE_TX_NORM: starts-on-event=SE_BswM_ModeReqPort_DcmCommunicationControl_DCM_ENABLE_RX_DISABLE_TX_NORM, mode=BswM_ModeNotificationPort_BswM_ModeReqPort_DcmCommunicationControl.DCM_ENABLE_RX_DISABLE_TX_NORM
        MSE_BswM_ModeReqPort_DcmCommunicationControl_DCM_DISABLE_RX_ENABLE_TX_NORM: starts-on-event=SE_BswM_ModeReqPort_DcmCommunicationControl_DCM_DISABLE_RX_ENABLE_TX_NORM, mode=BswM_ModeNotificationPort_BswM_ModeReqPort_DcmCommunicationControl.DCM_DISABLE_RX_ENABLE_TX_NORM
        MSE_BswM_ModeReqPort_DcmCommunicationControl_DCM_DISABLE_RX_TX_NORM: starts-on-event=SE_BswM_ModeReqPort_DcmCommunicationControl_DCM_DISABLE_RX_TX_NORM, mode=BswM_ModeNotificationPort_BswM_ModeReqPort_DcmCommunicationControl.DCM_DISABLE_RX_TX_NORM
        MSE_BswM_ModeReqPort_DcmCommunicationControl_DCM_ENABLE_RX_TX_NM: starts-on-event=SE_BswM_ModeReqPort_DcmCommunicationControl_DCM_ENABLE_RX_TX_NM, mode=BswM_ModeNotificationPort_BswM_ModeReqPort_DcmCommunicationControl.DCM_ENABLE_RX_TX_NM
        MSE_BswM_ModeReqPort_DcmCommunicationControl_DCM_ENABLE_RX_DISABLE_TX_NM: starts-on-event=SE_BswM_ModeReqPort_DcmCommunicationControl_DCM_ENABLE_RX_DISABLE_TX_NM, mode=BswM_ModeNotificationPort_BswM_ModeReqPort_DcmCommunicationControl.DCM_ENABLE_RX_DISABLE_TX_NM
        MSE_BswM_ModeReqPort_DcmCommunicationControl_DCM_DISABLE_RX_ENABLE_TX_NM: starts-on-event=SE_BswM_ModeReqPort_DcmCommunicationControl_DCM_DISABLE_RX_ENABLE_TX_NM, mode=BswM_ModeNotificationPort_BswM_ModeReqPort_DcmCommunicationControl.DCM_DISABLE_RX_ENABLE_TX_NM
        MSE_BswM_ModeReqPort_DcmCommunicationControl_DCM_DISABLE_RX_TX_NM: starts-on-event=SE_BswM_ModeReqPort_DcmCommunicationControl_DCM_DISABLE_RX_TX_NM, mode=BswM_ModeNotificationPort_BswM_ModeReqPort_DcmCommunicationControl.DCM_DISABLE_RX_TX_NM
        MSE_BswM_ModeReqPort_DcmCommunicationControl_DCM_ENABLE_RX_TX_NORM_NM: starts-on-event=SE_BswM_ModeReqPort_DcmCommunicationControl_DCM_ENABLE_RX_TX_NORM_NM, mode=BswM_ModeNotificationPort_BswM_ModeReqPort_DcmCommunicationControl.DCM_ENABLE_RX_TX_NORM_NM
        MSE_BswM_ModeReqPort_DcmCommunicationControl_DCM_ENABLE_RX_DISABLE_TX_NORM_NM: starts-on-event=SE_BswM_ModeReqPort_DcmCommunicationControl_DCM_ENABLE_RX_DISABLE_TX_NORM_NM, mode=BswM_ModeNotificationPort_BswM_ModeReqPort_DcmCommunicationControl.DCM_ENABLE_RX_DISABLE_TX_NORM_NM
        MSE_BswM_ModeReqPort_DcmCommunicationControl_DCM_DISABLE_RX_ENABLE_TX_NORM_NM: starts-on-event=SE_BswM_ModeReqPort_DcmCommunicationControl_DCM_DISABLE_RX_ENABLE_TX_NORM_NM, mode=BswM_ModeNotificationPort_BswM_ModeReqPort_DcmCommunicationControl.DCM_DISABLE_RX_ENABLE_TX_NORM_NM
        MSE_BswM_ModeReqPort_DcmCommunicationControl_DCM_DISABLE_RX_TX_NORM_NM: starts-on-event=SE_BswM_ModeReqPort_DcmCommunicationControl_DCM_DISABLE_RX_TX_NORM_NM, mode=BswM_ModeNotificationPort_BswM_ModeReqPort_DcmCommunicationControl.DCM_DISABLE_RX_TX_NORM_NM
        MSE_BswM_ModeReqPort_DcmDiagnosticSessionControl_Default: starts-on-event=SE_BswM_ModeReqPort_DcmDiagnosticSessionControl_Default, mode=BswM_ModeNotificationPort_BswM_ModeReqPort_DcmDiagnosticSessionControl.Default
        MSE_BswM_ModeReqPort_DcmDiagnosticSessionControl_Programming: starts-on-event=SE_BswM_ModeReqPort_DcmDiagnosticSessionControl_Programming, mode=BswM_ModeNotificationPort_BswM_ModeReqPort_DcmDiagnosticSessionControl.Programming
        MSE_BswM_ModeReqPort_DcmDiagnosticSessionControl_Extended: starts-on-event=SE_BswM_ModeReqPort_DcmDiagnosticSessionControl_Extended, mode=BswM_ModeNotificationPort_BswM_ModeReqPort_DcmDiagnosticSessionControl.Extended
        MSE_BswM_ModeReqPort_DcmResponseOnEvent_EVENT_STARTED: starts-on-event=SE_BswM_ModeReqPort_DcmResponseOnEvent_EVENT_STARTED, mode=BswM_ModeNotificationPort_BswM_ModeReqPort_DcmResponseOnEvent.EVENT_STARTED
        MSE_BswM_ModeReqPort_DcmResponseOnEvent_EVENT_STOPPED: starts-on-event=SE_BswM_ModeReqPort_DcmResponseOnEvent_EVENT_STOPPED, mode=BswM_ModeNotificationPort_BswM_ModeReqPort_DcmResponseOnEvent.EVENT_STOPPED
        MSE_BswM_ModeReqPort_DcmResponseOnEvent_EVENT_CLEARED: starts-on-event=SE_BswM_ModeReqPort_DcmResponseOnEvent_EVENT_CLEARED, mode=BswM_ModeNotificationPort_BswM_ModeReqPort_DcmResponseOnEvent.EVENT_CLEARED
        MSE_BswM_ModeReqPort_Dcm_ResetModeRequest_NONE: starts-on-event=SE_BswM_ModeReqPort_Dcm_ResetModeRequest_NONE, mode=BswM_ModeNotificationPort_BswM_ModeReqPort_Dcm_ResetModeRequest.NONE
        MSE_BswM_ModeReqPort_Dcm_ResetModeRequest_HARD: starts-on-event=SE_BswM_ModeReqPort_Dcm_ResetModeRequest_HARD, mode=BswM_ModeNotificationPort_BswM_ModeReqPort_Dcm_ResetModeRequest.HARD
        MSE_BswM_ModeReqPort_Dcm_ResetModeRequest_KEYONOFF: starts-on-event=SE_BswM_ModeReqPort_Dcm_ResetModeRequest_KEYONOFF, mode=BswM_ModeNotificationPort_BswM_ModeReqPort_Dcm_ResetModeRequest.KEYONOFF
        MSE_BswM_ModeReqPort_Dcm_ResetModeRequest_SOFT: starts-on-event=SE_BswM_ModeReqPort_Dcm_ResetModeRequest_SOFT, mode=BswM_ModeNotificationPort_BswM_ModeReqPort_Dcm_ResetModeRequest.SOFT
        MSE_BswM_ModeReqPort_Dcm_ResetModeRequest_JUMPTOBOOTLOADER: starts-on-event=SE_BswM_ModeReqPort_Dcm_ResetModeRequest_JUMPTOBOOTLOADER, mode=BswM_ModeNotificationPort_BswM_ModeReqPort_Dcm_ResetModeRequest.JUMPTOBOOTLOADER
        MSE_BswM_ModeReqPort_Dcm_ResetModeRequest_JUMPTOSYSSUPPLIERBOOTLOADER: starts-on-event=SE_BswM_ModeReqPort_Dcm_ResetModeRequest_JUMPTOSYSSUPPLIERBOOTLOADER, mode=BswM_ModeNotificationPort_BswM_ModeReqPort_Dcm_ResetModeRequest.JUMPTOSYSSUPPLIERBOOTLOADER
        MSE_BswM_ModeReqPort_Dcm_ResetModeRequest_EXECUTE: starts-on-event=SE_BswM_ModeReqPort_Dcm_ResetModeRequest_EXECUTE, mode=BswM_ModeNotificationPort_BswM_ModeReqPort_Dcm_ResetModeRequest.EXECUTE
      bsw timing event TimingEvent_MainFunction: starts-on-event=BswM_MainFunction, period=0.02
package /AUTOSAR_BswM/BswModuleEntrys
  27 x bsw module entry, all with is-reentrant=false, sw-service-impl-policy=STANDARD:
    BswM_MainFunction: service-id=3, is-synchronous=true, call-type=SCHEDULED, execution-context=TASK
    BswM_Init: service-id=0, is-synchronous=true, call-type=REGULAR, execution-context=UNSPECIFIED
    BswM_MRPFunc_BswM_ModeReqPort_Dcm_ResetModeRequest_JUMPTOSYSSUPPLIERBOOTLOADER: service-id=0, is-synchronous=false, call-type=SCHEDULED, execution-context=TASK
    BswM_MRPFunc_BswM_ModeReqPort_DcmResponseOnEvent_EVENT_STARTED: service-id=0, is-synchronous=false, call-type=SCHEDULED, execution-context=TASK
    BswM_MRPFunc_BswM_ModeReqPort_DcmCommunicationControl_DCM_DISABLE_RX_ENABLE_TX_NM: service-id=0, is-synchronous=false, call-type=SCHEDULED, execution-context=TASK
    BswM_MRPFunc_BswM_ModeReqPort_Dcm_ResetModeRequest_NONE: service-id=0, is-synchronous=false, call-type=SCHEDULED, execution-context=TASK
    BswM_MRPFunc_BswM_ModeReqPort_Dcm_ResetModeRequest_HARD: service-id=0, is-synchronous=false, call-type=SCHEDULED, execution-context=TASK
    BswM_MRPFunc_BswM_ModeReqPort_DcmCommunicationControl_DCM_DISABLE_RX_ENABLE_TX_NORM_NM: service-id=0, is-synchronous=false, call-type=SCHEDULED, execution-context=TASK
    BswM_MRPFunc_BswM_ModeReqPort_DcmResponseOnEvent_EVENT_CLEARED: service-id=0, is-synchronous=false, call-type=SCHEDULED, execution-context=TASK
    BswM_MRPFunc_BswM_ModeReqPort_DcmCommunicationControl_DCM_ENABLE_RX_TX_NM: service-id=0, is-synchronous=false, call-type=SCHEDULED, execution-context=TASK
    BswM_MRPFunc_BswM_ModeReqPort_Dcm_ResetModeRequest_SOFT: service-id=0, is-synchronous=false, call-type=SCHEDULED, execution-context=TASK
    BswM_MRPFunc_BswM_ModeReqPort_DcmCommunicationControl_DCM_DISABLE_RX_TX_NORM: service-id=0, is-synchronous=false, call-type=SCHEDULED, execution-context=TASK
    BswM_MRPFunc_BswM_ModeReqPort_DcmCommunicationControl_DCM_ENABLE_RX_DISABLE_TX_NM: service-id=0, is-synchronous=false, call-type=SCHEDULED, execution-context=TASK
    BswM_MRPFunc_BswM_ModeReqPort_DcmResponseOnEvent_EVENT_STOPPED: service-id=0, is-synchronous=false, call-type=SCHEDULED, execution-context=TASK
    BswM_MRPFunc_BswM_ModeReqPort_DcmDiagnosticSessionControl_Extended: service-id=0, is-synchronous=false, call-type=SCHEDULED, execution-context=TASK
    BswM_MRPFunc_BswM_ModeReqPort_DcmDiagnosticSessionControl_Default: service-id=0, is-synchronous=false, call-type=SCHEDULED, execution-context=TASK
    BswM_MRPFunc_BswM_ModeReqPort_Dcm_ResetModeRequest_KEYONOFF: service-id=0, is-synchronous=false, call-type=SCHEDULED, execution-context=TASK
    BswM_MRPFunc_BswM_ModeReqPort_DcmCommunicationControl_DCM_DISABLE_RX_TX_NORM_NM: service-id=0, is-synchronous=false, call-type=SCHEDULED, execution-context=TASK
    BswM_MRPFunc_BswM_ModeReqPort_Dcm_ResetModeRequest_JUMPTOBOOTLOADER: service-id=0, is-synchronous=false, call-type=SCHEDULED, execution-context=TASK
    BswM_MRPFunc_BswM_ModeReqPort_DcmCommunicationControl_DCM_ENABLE_RX_DISABLE_TX_NORM: service-id=0, is-synchronous=false, call-type=SCHEDULED, execution-context=TASK
    BswM_MRPFunc_BswM_ModeReqPort_Dcm_ResetModeRequest_EXECUTE: service-id=0, is-synchronous=false, call-type=SCHEDULED, execution-context=TASK
    BswM_MRPFunc_BswM_ModeReqPort_DcmCommunicationControl_DCM_DISABLE_RX_TX_NM: service-id=0, is-synchronous=false, call-type=SCHEDULED, execution-context=TASK
    BswM_MRPFunc_BswM_ModeReqPort_DcmCommunicationControl_DCM_ENABLE_RX_TX_NORM_NM: service-id=0, is-synchronous=false, call-type=SCHEDULED, execution-context=TASK
    BswM_MRPFunc_BswM_ModeReqPort_DcmCommunicationControl_DCM_ENABLE_RX_DISABLE_TX_NORM_NM: service-id=0, is-synchronous=false, call-type=SCHEDULED, execution-context=TASK
    BswM_MRPFunc_BswM_ModeReqPort_DcmDiagnosticSessionControl_Programming: service-id=0, is-synchronous=false, call-type=SCHEDULED, execution-context=TASK
    BswM_MRPFunc_BswM_ModeReqPort_DcmCommunicationControl_DCM_DISABLE_RX_ENABLE_TX_NORM: service-id=0, is-synchronous=false, call-type=SCHEDULED, execution-context=TASK
    BswM_MRPFunc_BswM_ModeReqPort_DcmCommunicationControl_DCM_ENABLE_RX_TX_NORM: service-id=0, is-synchronous=false, call-type=SCHEDULED, execution-context=TASK
package /AUTOSAR_BswM/SwcBswMappings
  swc bsw mapping SwcBswMapping_0: bsw-behavior=InternalBehavior_0, swc-bsw-runnable-mapping{bsw-entity=BswM_MainFunction, swc-runnable=RES_MainFunction}, swc-behavior=BswMInternalBehavior
package /EB_BswM/Implementations
  bsw implementation BswImplementation_0: programming-language=C, sw-version=1.16.0, swc-bsw-mapping=SwcBswMapping_0, vendor-id=1, ar-release-version=4.0.3, behavior=InternalBehavior_0, vendor-specific-module-def=BswM
    code-descriptors:
      code Files
        artifact-descriptors:
          short-label=Autosar::src::BswM.c, category=SWSRC
          short-label=generated::src::BswM_Cfg.c, category=SWSRC
          short-label=generated::src::BswM_PBcfg.c, category=SWSRC
          short-label=generated::src::BswM_Lcfg.c, category=SWSRC
          short-label=Autosar::include::BswM.h, category=SWHDR
          short-label=Autosar::include::BswM_Int.h, category=SWHDR
          short-label=Autosar::include::BswM_SymbolicNames_PBcfg.h, category=SWHDR
          short-label=Autosar::include::BswM_Types.h, category=SWHDR
          short-label=Autosar::include::BswM_Version.h, category=SWHDR
          short-label=generated::include::BswM_Cfg.h, category=SWHDR
          short-label=generated::include::BswM_Int_Cfg.h, category=SWHDR
          short-label=generated::include::BswM_CfgTypes.h, category=SWHDR
          short-label=generated::include::BswM_PBcfg.h, category=SWHDR
          short-label=generated::include::BswM_MemMap.h, category=SWHDR
          short-label=generated::include::BswM_Trace.h, category=SWHDR
          short-label=generated::include::BswM_Lcfg.h, category=SWHDR
          short-label=generated::include::BswM_CanSM.h, category=SWHDR
          short-label=generated::include::BswM_ComM.h, category=SWHDR
          short-label=generated::include::BswM_DCM.h, category=SWHDR
          short-label=generated::include::BswM_EcuM.h, category=SWHDR
          short-label=generated::include::BswM_Nm.h, category=SWHDR
          short-label=generated::include::BswM_NvM.h, category=SWHDR
          short-label=make::BswM_defs.mak, category=SWMAKE
          short-label=make::BswM_rules.mak, category=SWMAKE
    resource consumption ResourceConsumption
      8 x memory section:
        CONFIG_DATA_UNSPECIFIED: alignment=UNSPECIFIED, sw-addrmethod=CONFIG_DATA
        VAR_INIT_UNSPECIFIED: alignment=UNSPECIFIED, sw-addrmethod=VAR_INIT
        VAR_CLEARED_UNSPECIFIED: alignment=UNSPECIFIED, sw-addrmethod=VAR_CLEARED
        CONST_UNSPECIFIED: alignment=UNSPECIFIED, sw-addrmethod=CONST
        CONST_8: alignment=8, sw-addrmethod=CONST
        CONST_16: alignment=16, sw-addrmethod=CONST
        CONST_32: alignment=16, sw-addrmethod=CONST
        CODE: sw-addrmethod=CODE
