AUTOSAR XML (schema 4-0-3)
package /AUTOSAR_BswM/BswModuleDescriptions
  bsw module description BswM: module-id=042, provided-entrys=[BswM_MainFunction, BswM_Init]
    bsw internal behavior InternalBehavior_0: data-type-mapping=[BswMModeMapping, DataTypeMappingSet_0, AppModeMapping]
      exclusive area SCHM_BSWM_EXCLUSIVE_AREA
      bsw schedulable entity BswM_MainFunction: can-enter-exclusive-area=SCHM_BSWM_EXCLUSIVE_AREA, implemented-entry=BswM_MainFunction
      bsw timing event TimingEvent_MainFunction: starts-on-event=BswM_MainFunction, period=0.02
package /AUTOSAR_BswM/BswModuleEntrys
  bsw module entry BswM_MainFunction: service-id=3, is-reentrant=false, is-synchronous=true, call-type=SCHEDULED, execution-context=TASK, sw-service-impl-policy=STANDARD
  bsw module entry BswM_Init: service-id=0, is-reentrant=false, is-synchronous=true, call-type=REGULAR, execution-context=UNSPECIFIED, sw-service-impl-policy=STANDARD
package /AUTOSAR_BswM/SwcBswMappings
  swc bsw mapping SwcBswMapping_0: bsw-behavior=InternalBehavior_0, swc-bsw-runnable-mapping{bsw-entity=BswM_MainFunction, swc-runnable=RES_MainFunction}, swc-behavior=BswMInternalBehavior
package /EB_BswM/Implementations
  bsw implementation BswImplementation_0: programming-language=C, sw-version=1.16.0, swc-bsw-mapping=SwcBswMapping_0, vendor-id=1, ar-release-version=4.0.3, behavior=InternalBehavior_0, vendor-specific-module-def=BswM
    code-descriptors:
      code Files
        artifact-descriptors:
          short-label=Autosar::src::BswM.c, category=SWSRC
          short-label=generated::src::BswM_Cfg.c, category=SWSRC
          short-label=generated::src::BswM_PBcfg.c, category=SWSRC
          short-label=generated::src::BswM_Lcfg.c, category=SWSRC
          short-label=Autosar::include::BswM.h, category=SWHDR
          short-label=Autosar::include::BswM_Int.h, category=SWHDR
          short-label=Autosar::include::BswM_SymbolicNames_PBcfg.h, category=SWHDR
          short-label=Autosar::include::BswM_Types.h, category=SWHDR
          short-label=Autosar::include::BswM_Version.h, category=SWHDR
          short-label=generated::include::BswM_Cfg.h, category=SWHDR
          short-label=generated::include::BswM_Int_Cfg.h, category=SWHDR
          short-label=generated::include::BswM_CfgTypes.h, category=SWHDR
          short-label=generated::include::BswM_PBcfg.h, category=SWHDR
          short-label=generated::include::BswM_MemMap.h, category=SWHDR
          short-label=generated::include::BswM_Trace.h, category=SWHDR
          short-label=generated::include::BswM_Lcfg.h, category=SWHDR
          short-label=generated::include::BswM_CanSM.h, category=SWHDR
          short-label=generated::include::BswM_ComM.h, category=SWHDR
          short-label=generated::include::BswM_EcuM.h, category=SWHDR
          short-label=generated::include::BswM_NvM.h, category=SWHDR
          short-label=make::BswM_defs.mak, category=SWMAKE
          short-label=make::BswM_rules.mak, category=SWMAKE
    resource consumption ResourceConsumption
      8 x memory section:
        CONFIG_DATA_UNSPECIFIED: alignment=UNSPECIFIED, sw-addrmethod=CONFIG_DATA
        VAR_INIT_UNSPECIFIED: alignment=UNSPECIFIED, sw-addrmethod=VAR_INIT
        VAR_CLEARED_UNSPECIFIED: alignment=UNSPECIFIED, sw-addrmethod=VAR_CLEARED
        CONST_UNSPECIFIED: alignment=UNSPECIFIED, sw-addrmethod=CONST
        CONST_8: alignment=8, sw-addrmethod=CONST
        CONST_16: alignment=16, sw-addrmethod=CONST
        CONST_32: alignment=16, sw-addrmethod=CONST
        CODE: sw-addrmethod=CODE
