AUTOSAR XML (schema 4-0-3)
package /AUTOSAR_Mcl/BswModuleDescriptions
  bsw module description Mcl: module-id=255, provided-entrys=Mcl_Init
    bsw internal behavior InternalBehavior_0
      45 x exclusive area:
        MCL_EXCLUSIVE_AREA_{00..02}
        MCL_EXCLUSIVE_AREA_{04..09}
        MCL_EXCLUSIVE_AREA_{11..46}
      bsw called entity Mcl_Init: can-enter-exclusive-area=[MCL_EXCLUSIVE_AREA_00, MCL_EXCLUSIVE_AREA_01, MCL_EXCLUSIVE_AREA_02, MCL_EXCLUSIVE_AREA_04, MCL_EXCLUSIVE_AREA_05, MCL_EXCLUSIVE_AREA_06, MCL_EXCLUSIVE_AREA_07, MCL_EXCLUSIVE_AREA_08, MCL_EXCLUSIVE_AREA_09, MCL_EXCLUSIVE_AREA_11, MCL_EXCLUSIVE_AREA_12, MCL_EXCLUSIVE_AREA_13, MCL_EXCLUSIVE_AREA_14, MCL_EXCLUSIVE_AREA_15, MCL_EXCLUSIVE_AREA_16, MCL_EXCLUSIVE_AREA_17, MCL_EXCLUSIVE_AREA_18, MCL_EXCLUSIVE_AREA_19, MCL_EXCLUSIVE_AREA_20, MCL_EXCLUSIVE_AREA_21, MCL_EXCLUSIVE_AREA_22, MCL_EXCLUSIVE_AREA_23, MCL_EXCLUSIVE_AREA_24, MCL_EXCLUSIVE_AREA_25, MCL_EXCLUSIVE_AREA_26, MCL_EXCLUSIVE_AREA_27, MCL_EXCLUSIVE_AREA_28, MCL_EXCLUSIVE_AREA_29, MCL_EXCLUSIVE_AREA_30, MCL_EXCLUSIVE_AREA_31, MCL_EXCLUSIVE_AREA_32, MCL_EXCLUSIVE_AREA_33, MCL_EXCLUSIVE_AREA_34, MCL_EXCLUSIVE_AREA_35, MCL_EXCLUSIVE_AREA_36, MCL_EXCLUSIVE_AREA_37, MCL_EXCLUSIVE_AREA_38, MCL_EXCLUSIVE_AREA_39, MCL_EXCLUSIVE_AREA_40, MCL_EXCLUSIVE_AREA_41, MCL_EXCLUSIVE_AREA_42, MCL_EXCLUSIVE_AREA_43, MCL_EXCLUSIVE_AREA_44, MCL_EXCLUSIVE_AREA_45, MCL_EXCLUSIVE_AREA_46], implemented-entry=Mcl_Init
package /AUTOSAR_Mcl/BswModuleEntrys
  bsw module entry Mcl_Init: service-id=35, is-reentrant=false, is-synchronous=true, call-type=REGULAR, execution-context=UNSPECIFIED, sw-service-impl-policy=STANDARD
package /Mcl_TS_T40D34M20I1R0/Implementations
  bsw implementation BswImplementation_0: programming-language=C, sw-version=2.0.1, vendor-id=43, ar-release-version=4.4.0, behavior=InternalBehavior_0, vendor-specific-module-def=Mcl
    code-descriptors:
      code Files: artifact-descriptors=[{short-label=make::Mcl_defs.mak, category=SWMAKE}, {short-label=make::Mcl_rules.mak, category=SWMAKE}]
    resource consumption ResourceConsumption
      10 x memory section:
        MCL_CODE: sw-addrmethod=CODE, symbol=CODE
        MCL_CONFIG_DATA_UNSPECIFIED: alignment=UNSPECIFIED, sw-addrmethod=CONFIG_DATA, symbol=CONFIG_DATA_UNSPECIFIED
        MCL_CONST_UNSPECIFIED: alignment=UNSPECIFIED, sw-addrmethod=CONST, symbol=CONST_UNSPECIFIED
        MCL_VAR_CLEARED_16: alignment=16, sw-addrmethod=VAR_CLEARED, symbol=VAR_CLEARED_16
        MCL_VAR_CLEARED_8_NO_CACHEABLE: sw-addrmethod=VAR_CLEARED, symbol=VAR_CLEARED_8_NO_CACHEABLE
        MCL_VAR_CLEARED_BOOLEAN_NO_CACHEABLE: sw-addrmethod=VAR_CLEARED, symbol=VAR_CLEARED_BOOLEAN_NO_CACHEABLE
        MCL_VAR_CLEARED_UNSPECIFIED: alignment=UNSPECIFIED, sw-addrmethod=VAR_CLEARED, symbol=VAR_CLEARED_UNSPECIFIED
        MCL_VAR_CLEARED_UNSPECIFIED_NO_CACHEABLE: sw-addrmethod=VAR_CLEARED, symbol=VAR_CLEARED_UNSPECIFIED_NO_CACHEABLE
        MCL_VAR_INIT_UNSPECIFIED: alignment=UNSPECIFIED, sw-addrmethod=VAR_INIT, symbol=VAR_INIT_UNSPECIFIED
        MCL_VAR_INIT_UNSPECIFIED_NO_CACHEABLE: sw-addrmethod=VAR_INIT, symbol=VAR_INIT_UNSPECIFIED_NO_CACHEABLE
