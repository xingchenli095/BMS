AUTOSAR XML (schema 4-2-1)
package /AUTOSAR_Dcm/BswModuleDescriptions
  bsw module description Dcm: module-id=53, provided-entrys=Dcm_MainFunction
    bsw internal behavior InternalBehavior_0
      bsw schedulable entity Dcm_MainFunction: implemented-entry=Dcm_MainFunction
      bsw timing event TimingEvent_MainFunction: starts-on-event=Dcm_MainFunction, period=0.005
package /AUTOSAR_Dcm/BswModuleEntrys
  bsw module entry Dcm_MainFunction: service-id=37, is-reentrant=false, is-synchronous=true, call-type=SCHEDULED, execution-context=TASK, sw-service-impl-policy=STANDARD
package /EB_Dcm/Implementations
  bsw implementation BswImplementation_0: programming-language=C, sw-version=5.0.13, vendor-id=1, ar-release-version=4.0.3, behavior=InternalBehavior_0
    code-descriptors:
      code Files
        artifact-descriptors:
          short-label=Autosar::include::Dcm.h, category=SWHDR
          short-label=Autosar::include::Dcm_Authentication.h, category=SWHDR
          short-label=Autosar::include::Dcm_Authentication_AuthenticationHandler.h, category=SWHDR
          short-label=Autosar::include::Dcm_Authentication_CryptoStackFacade.h, category=SWHDR
          short-label=Autosar::include::Dcm_Authentication_DiagnosticPolicyHandler.h, category=SWHDR
          short-label=Autosar::include::Dcm_Cbk.h, category=SWHDR
          short-label=Autosar::include::Dcm_Dsl_ComMChannelStateManager.h, category=SWHDR
          short-label=Autosar::include::Dcm_Dsl_ComMChannelStateManager_External_Interface.h, category=SWHDR
          short-label=Autosar::include::Dcm_Dsl_CommunicationServices.h, category=SWHDR
          short-label=Autosar::include::Dcm_Dsl_CommunicationServices_BufferManager.h, category=SWHDR
          short-label=Autosar::include::Dcm_Dsl_CommunicationServices_MetaData.h, category=SWHDR
          short-label=Autosar::include::Dcm_Dsl_CommunicationServices_RxConnections.h, category=SWHDR
          short-label=Autosar::include::Dcm_Dsl_CommunicationServices_TxConnections.h, category=SWHDR
          short-label=Autosar::include::Dcm_Dsl_DiagnosticSessionHandler.h, category=SWHDR
          short-label=Autosar::include::Dcm_Dsl_PostBootOperationsHandler.h, category=SWHDR
          short-label=Autosar::include::Dcm_Dsl_RoeServices.h, category=SWHDR
          short-label=Autosar::include::Dcm_Dsl_SecurityLevelHandler.h, category=SWHDR
          short-label=Autosar::include::Dcm_Dsl_Supervisor.h, category=SWHDR
          short-label=Autosar::include::Dcm_Dsl_Supervisor_CommunicationSessionHandling.h, category=SWHDR
          short-label=Autosar::include::Dcm_Dsl_Supervisor_MainConnectionHandling.h, category=SWHDR
          short-label=Autosar::include::Dcm_Dsl_Supervisor_ProtocolHandling.h, category=SWHDR
          short-label=Autosar::include::Dcm_DspExternal.h, category=SWHDR
          short-label=Autosar::include::Dcm_Dsp_ApplicationDiagnosticRequests.h, category=SWHDR
          short-label=Autosar::include::Dcm_Dsp_Contexts.h, category=SWHDR
          short-label=Autosar::include::Dcm_Dsp_DataTransferServices.h, category=SWHDR
          short-label=Autosar::include::Dcm_Dsp_DemFacade.h, category=SWHDR
          short-label=Autosar::include::Dcm_Dsp_DidServices.h, category=SWHDR
          short-label=Autosar::include::Dcm_Dsp_DidSignals.h, category=SWHDR
          short-label=Autosar::include::Dcm_Dsp_EndiannessInterpretation.h, category=SWHDR
          short-label=Autosar::include::Dcm_Dsp_MemoryServices.h, category=SWHDR
          short-label=Autosar::include::Dcm_Dsp_MidServices.h, category=SWHDR
          short-label=Autosar::include::Dcm_Dsp_PidServices.h, category=SWHDR
          short-label=Autosar::include::Dcm_Dsp_SvcH_Authentication.h, category=SWHDR
          short-label=Autosar::include::Dcm_Dsp_SvcH_CommunicationControl.h, category=SWHDR
          short-label=Autosar::include::Dcm_Dsp_SvcH_ControlDTCSetting.h, category=SWHDR
          short-label=Autosar::include::Dcm_Dsp_SvcH_DynamicallyDefineDataIdentifier.h, category=SWHDR
          short-label=Autosar::include::Dcm_Dsp_SvcH_InputOutputControlByIdentifier.h, category=SWHDR
          short-label=Autosar::include::Dcm_Dsp_SvcH_LinkControl.h, category=SWHDR
          short-label=Autosar::include::Dcm_Dsp_SvcH_ReadDTCInformation.h, category=SWHDR
          short-label=Autosar::include::Dcm_Dsp_SvcH_ReadDataByIdentifier.h, category=SWHDR
          short-label=Autosar::include::Dcm_Dsp_SvcH_ReadDataByPeriodicIdentifier.h, category=SWHDR
          short-label=Autosar::include::Dcm_Dsp_SvcH_ReadMemoryByAddress.h, category=SWHDR
          short-label=Autosar::include::Dcm_Dsp_SvcH_ReadScalingDataByIdentifier.h, category=SWHDR
          short-label=Autosar::include::Dcm_Dsp_SvcH_RequestControlOfOnBoardSysTstComp.h, category=SWHDR
          short-label=Autosar::include::Dcm_Dsp_SvcH_RequestDownload.h, category=SWHDR
          short-label=Autosar::include::Dcm_Dsp_SvcH_RequestOnboardMonitoringTestResults.h, category=SWHDR
          short-label=Autosar::include::Dcm_Dsp_SvcH_RequestTransferExit.h, category=SWHDR
          short-label=Autosar::include::Dcm_Dsp_SvcH_RequestUpload.h, category=SWHDR
          short-label=Autosar::include::Dcm_Dsp_SvcH_RequestVehicleInformation.h, category=SWHDR
          short-label=Autosar::include::Dcm_Dsp_SvcH_ResponseOnEvent.h, category=SWHDR
          short-label=Autosar::include::Dcm_Dsp_SvcH_RoutineControl.h, category=SWHDR
          short-label=Autosar::include::Dcm_Dsp_SvcH_SecurityAccess.h, category=SWHDR
          short-label=Autosar::include::Dcm_Dsp_SvcH_TesterPresent.h, category=SWHDR
          short-label=Autosar::include::Dcm_Dsp_SvcH_TransferData.h, category=SWHDR
          short-label=Autosar::include::Dcm_Dsp_SvcH_WriteDataByIdentifier.h, category=SWHDR
          short-label=Autosar::include::Dcm_Dsp_SvcH_WriteMemoryByAddress.h, category=SWHDR
          short-label=Autosar::include::Dcm_Dsp_VinServices.h, category=SWHDR
          short-label=Autosar::include::Dcm_GenericServiceHandlers.h, category=SWHDR
          short-label=Autosar::include::Dcm_Hsm.h, category=SWHDR
          short-label=Autosar::include::Dcm_HsmCfg.h, category=SWHDR
          short-label=Autosar::include::Dcm_HsmDcm.h, category=SWHDR
          short-label=Autosar::include::Dcm_HsmDcmInt.h, category=SWHDR
          short-label=Autosar::include::Dcm_Int.h, category=SWHDR
          short-label=Autosar::include::Dcm_Trace.h, category=SWHDR
          short-label=Autosar::include::Dcm_Trace_Internal.h, category=SWHDR
          short-label=Autosar::include::Dcm_Types.h, category=SWHDR
          short-label=Autosar::include::Dcm_Version.h, category=SWHDR
          short-label=Autosar::src::Dcm.c, category=SWSRC
          short-label=Autosar::src::Dcm_Authentication.c, category=SWSRC
          short-label=Autosar::src::Dcm_Authentication_AuthenticationHandler.c, category=SWSRC
          short-label=Autosar::src::Dcm_Authentication_CryptoStackFacade.c, category=SWSRC
          short-label=Autosar::src::Dcm_Authentication_DiagnosticPolicyHandler.c, category=SWSRC
          short-label=Autosar::src::Dcm_Dsd.c, category=SWSRC
          short-label=Autosar::src::Dcm_Dsl_ComMChannelStateManager.c, category=SWSRC
          short-label=Autosar::src::Dcm_Dsl_CommunicationServices.c, category=SWSRC
          short-label=Autosar::src::Dcm_Dsl_CommunicationServices_BufferManager.c, category=SWSRC
          short-label=Autosar::src::Dcm_Dsl_CommunicationServices_MetaData.c, category=SWSRC
          short-label=Autosar::src::Dcm_Dsl_CommunicationServices_RxConnections.c, category=SWSRC
          short-label=Autosar::src::Dcm_Dsl_CommunicationServices_TxConnections.c, category=SWSRC
          short-label=Autosar::src::Dcm_Dsl_DiagnosticSessionHandler.c, category=SWSRC
          short-label=Autosar::src::Dcm_Dsl_PostBootOperationsHandler.c, category=SWSRC
          short-label=Autosar::src::Dcm_Dsl_RoeServices.c, category=SWSRC
          short-label=Autosar::src::Dcm_Dsl_SecurityLevelHandler.c, category=SWSRC
          short-label=Autosar::src::Dcm_Dsl_Supervisor.c, category=SWSRC
          short-label=Autosar::src::Dcm_Dsl_Supervisor_CommunicationSessionHandling.c, category=SWSRC
          short-label=Autosar::src::Dcm_Dsl_Supervisor_MainConnectionHandling.c, category=SWSRC
          short-label=Autosar::src::Dcm_Dsl_Supervisor_ProtocolHandling.c, category=SWSRC
          short-label=Autosar::src::Dcm_Dsp.c, category=SWSRC
          short-label=Autosar::src::Dcm_Dsp_ApplicationDiagnosticRequests.c, category=SWSRC
          short-label=Autosar::src::Dcm_Dsp_Contexts.c, category=SWSRC
          short-label=Autosar::src::Dcm_Dsp_DataTransferServices.c, category=SWSRC
          short-label=Autosar::src::Dcm_Dsp_DemFacade.c, category=SWSRC
          short-label=Autosar::src::Dcm_Dsp_DidServices.c, category=SWSRC
          short-label=Autosar::src::Dcm_Dsp_DidSignals.c, category=SWSRC
          short-label=Autosar::src::Dcm_Dsp_EndiannessInterpretation.c, category=SWSRC
          short-label=Autosar::src::Dcm_Dsp_MemoryServices.c, category=SWSRC
          short-label=Autosar::src::Dcm_Dsp_MidServices.c, category=SWSRC
          short-label=Autosar::src::Dcm_Dsp_PidServices.c, category=SWSRC
          short-label=Autosar::src::Dcm_Dsp_SvcH_Authentication.c, category=SWSRC
          short-label=Autosar::src::Dcm_Dsp_SvcH_CommunicationControl.c, category=SWSRC
          short-label=Autosar::src::Dcm_Dsp_SvcH_ControlDTCSetting.c, category=SWSRC
          short-label=Autosar::src::Dcm_Dsp_SvcH_DynamicallyDefineDataIdentifier.c, category=SWSRC
          short-label=Autosar::src::Dcm_Dsp_SvcH_InputOutputControlByIdentifier.c, category=SWSRC
          short-label=Autosar::src::Dcm_Dsp_SvcH_LinkControl.c, category=SWSRC
          short-label=Autosar::src::Dcm_Dsp_SvcH_ReadDTCInformation.c, category=SWSRC
          short-label=Autosar::src::Dcm_Dsp_SvcH_ReadDataByIdentifier.c, category=SWSRC
          short-label=Autosar::src::Dcm_Dsp_SvcH_ReadDataByPeriodicIdentifier.c, category=SWSRC
          short-label=Autosar::src::Dcm_Dsp_SvcH_ReadMemoryByAddress.c, category=SWSRC
          short-label=Autosar::src::Dcm_Dsp_SvcH_ReadScalingDataByIdentifier.c, category=SWSRC
          short-label=Autosar::src::Dcm_Dsp_SvcH_RequestControlOfOnBoardSysTstComp.c, category=SWSRC
          short-label=Autosar::src::Dcm_Dsp_SvcH_RequestDownload.c, category=SWSRC
          short-label=Autosar::src::Dcm_Dsp_SvcH_RequestOnboardMonitoringTestResults.c, category=SWSRC
          short-label=Autosar::src::Dcm_Dsp_SvcH_RequestTransferExit.c, category=SWSRC
          short-label=Autosar::src::Dcm_Dsp_SvcH_RequestUpload.c, category=SWSRC
          short-label=Autosar::src::Dcm_Dsp_SvcH_RequestVehicleInformation.c, category=SWSRC
          short-label=Autosar::src::Dcm_Dsp_SvcH_ResponseOnEvent.c, category=SWSRC
          short-label=Autosar::src::Dcm_Dsp_SvcH_RoutineControl.c, category=SWSRC
          short-label=Autosar::src::Dcm_Dsp_SvcH_SecurityAccess.c, category=SWSRC
          short-label=Autosar::src::Dcm_Dsp_SvcH_TesterPresent.c, category=SWSRC
          short-label=Autosar::src::Dcm_Dsp_SvcH_TransferData.c, category=SWSRC
          short-label=Autosar::src::Dcm_Dsp_SvcH_WriteDataByIdentifier.c, category=SWSRC
          short-label=Autosar::src::Dcm_Dsp_SvcH_WriteMemoryByAddress.c, category=SWSRC
          short-label=Autosar::src::Dcm_Dsp_VinServices.c, category=SWSRC
          short-label=Autosar::src::Dcm_Hsm.c, category=SWSRC
          short-label=Autosar::src::Dcm_HsmDcmData.c, category=SWSRC
          short-label=Autosar::src::Dcm_HsmDcmFnct.c, category=SWSRC
          short-label=make::Dcm_defs.mak, category=SWMAKE
          short-label=make::Dcm_rules.mak, category=SWMAKE
    mc-parameter-instances:
      5 x mc data instance, all with category=ARRAY:
        Dcm_DspPidConfig: array-size=3
          mc data instance PidConfig_DcmDspPid_0: category=STRUCTURE, symbol=[0]
            mc data instance BitField: category=STRUCTURE
              mc data instance OBDService_1: category=VALUE, resulting-properties={base-type=uint8, sw-bit-representation={bit-position=0, number-of-bits=1}, sw-calibration-access=READ-WRITE, data-constr=uint8}, symbol=BitField  # Calibration of this bit is only allowed if the original configuration has the bit set to 1. A bit value of 1 enables the service.
              mc data instance OBDService_2: category=VALUE, resulting-properties={base-type=uint8, sw-bit-representation={bit-position=1, number-of-bits=1}, sw-calibration-access=READ-WRITE, data-constr=uint8}, symbol=BitField  # Calibration of this bit is only allowed if the original configuration has the bit set to 1. A bit value of 1 enables the service.
          mc data instance PidConfig_DcmDspPid_2: category=STRUCTURE, symbol=[1]
            mc data instance BitField: category=STRUCTURE
              mc data instance OBDService_1: category=VALUE, resulting-properties={base-type=uint8, sw-bit-representation={bit-position=0, number-of-bits=1}, sw-calibration-access=READ-WRITE, data-constr=uint8}, symbol=BitField  # Calibration of this bit is only allowed if the original configuration has the bit set to 1. A bit value of 1 enables the service.
              mc data instance OBDService_2: category=VALUE, resulting-properties={base-type=uint8, sw-bit-representation={bit-position=1, number-of-bits=1}, sw-calibration-access=READ-WRITE, data-constr=uint8}, symbol=BitField  # Calibration of this bit is only allowed if the original configuration has the bit set to 1. A bit value of 1 enables the service.
          mc data instance PidConfig_DcmDspPid_1: category=STRUCTURE, symbol=[2]
            mc data instance BitField: category=STRUCTURE
              mc data instance OBDService_1: category=VALUE, resulting-properties={base-type=uint8, sw-bit-representation={bit-position=0, number-of-bits=1}, sw-calibration-access=READ-WRITE, data-constr=uint8}, symbol=BitField  # Calibration of this bit is only allowed if the original configuration has the bit set to 1. A bit value of 1 enables the service.
              mc data instance OBDService_2: category=VALUE, resulting-properties={base-type=uint8, sw-bit-representation={bit-position=1, number-of-bits=1}, sw-calibration-access=READ-WRITE, data-constr=uint8}, symbol=BitField  # Calibration of this bit is only allowed if the original configuration has the bit set to 1. A bit value of 1 enables the service.
        Dcm_DspPidUsed: array-size=1
          mc data instance DcmDspPid_0: category=VALUE, resulting-properties={base-type=uint8, sw-bit-representation={bit-position=0, number-of-bits=1}, sw-calibration-access=READ-WRITE, data-constr=uint8}, symbol=[0]  # DcmDspPidUsed parameter for Pid 0x01 ('1' means Pid is available) - If the value is '0' the Pid is not a available in all services.
          mc data instance DcmDspPid_2: category=VALUE, resulting-properties={base-type=uint8, sw-bit-representation={bit-position=1, number-of-bits=1}, sw-calibration-access=READ-WRITE, data-constr=uint8}, symbol=[0]  # DcmDspPidUsed parameter for Pid 0x03 ('1' means Pid is available) - If the value is '0' the Pid is not a available in all services.
          mc data instance DcmDspPid_1: category=VALUE, resulting-properties={base-type=uint8, sw-bit-representation={bit-position=2, number-of-bits=1}, sw-calibration-access=READ-WRITE, data-constr=uint8}, symbol=[0]  # DcmDspPidUsed parameter for Pid 0x41 ('1' means Pid is available) - If the value is '0' the Pid is not a available in all services.
        Dcm_DsdSubServiceUsed: array-size=38
          27 x mc data instance, all with category=VALUE:
            ServiceTable_0_ServiceId_0_Default_SubServiceId_1: resulting-properties={base-type=uint8, sw-bit-representation={bit-position=0, number-of-bits=1}, sw-calibration-access=READ-WRITE, data-constr=uint8}, symbol=[0][0][0]  # DcmDsdSubServiceUsed parameter for subservice Default in Service DiagnosticSessionControl belonging to Servicetable DcmDsdServiceTable
            ServiceTable_0_ServiceId_0_Programming_SubServiceId_2: resulting-properties={base-type=uint8, sw-bit-representation={bit-position=1, number-of-bits=1}, sw-calibration-access=READ-WRITE, data-constr=uint8}, symbol=[0][0][0]  # DcmDsdSubServiceUsed parameter for subservice Programming in Service DiagnosticSessionControl belonging to Servicetable DcmDsdServiceTable
            ServiceTable_0_ServiceId_0_Extended_SubServiceId_3: resulting-properties={base-type=uint8, sw-bit-representation={bit-position=2, number-of-bits=1}, sw-calibration-access=READ-WRITE, data-constr=uint8}, symbol=[0][0][0]  # DcmDsdSubServiceUsed parameter for subservice Extended in Service DiagnosticSessionControl belonging to Servicetable DcmDsdServiceTable
            ServiceTable_0_ServiceId_1_HARD_RESET_SubServiceId_1: resulting-properties={base-type=uint8, sw-bit-representation={bit-position=0, number-of-bits=1}, sw-calibration-access=READ-WRITE, data-constr=uint8}, symbol=[0][1][0]  # DcmDsdSubServiceUsed parameter for subservice HARD_RESET in Service DiagnosticEcuReset belonging to Servicetable DcmDsdServiceTable
            ServiceTable_0_ServiceId_3_REPORT_NUMBER_OF_DTC_BY_STATUS_MASK_SubServiceId_1: resulting-properties={base-type=uint8, sw-bit-representation={bit-position=0, number-of-bits=1}, sw-calibration-access=READ-WRITE, data-constr=uint8}, symbol=[0][3][0]  # DcmDsdSubServiceUsed parameter for subservice REPORT_NUMBER_OF_DTC_BY_STATUS_MASK in Service DiagnosticReadDTCInformation belonging to Servicetable DcmDsdServiceTable
            ServiceTable_0_ServiceId_3_REPORT_DTC_BY_STATUS_MASK_SubServiceId_2: resulting-properties={base-type=uint8, sw-bit-representation={bit-position=1, number-of-bits=1}, sw-calibration-access=READ-WRITE, data-constr=uint8}, symbol=[0][3][0]  # DcmDsdSubServiceUsed parameter for subservice REPORT_DTC_BY_STATUS_MASK in Service DiagnosticReadDTCInformation belonging to Servicetable DcmDsdServiceTable
            ServiceTable_0_ServiceId_3_REPORT_DTC_SNAPSHOT_RECORD_BY_DTC_NUMBER_SubServiceId_4: resulting-properties={base-type=uint8, sw-bit-representation={bit-position=2, number-of-bits=1}, sw-calibration-access=READ-WRITE, data-constr=uint8}, symbol=[0][3][0]  # DcmDsdSubServiceUsed parameter for subservice REPORT_DTC_SNAPSHOT_RECORD_BY_DTC_NUMBER in Service DiagnosticReadDTCInformation belonging to Servicetable DcmDsdServiceTable
            ServiceTable_0_ServiceId_3_REPORT_DTC_EXT_DATA_RECORD_BY_DTC_NUMBER_SubServiceId_6: resulting-properties={base-type=uint8, sw-bit-representation={bit-position=3, number-of-bits=1}, sw-calibration-access=READ-WRITE, data-constr=uint8}, symbol=[0][3][0]  # DcmDsdSubServiceUsed parameter for subservice REPORT_DTC_EXT_DATA_RECORD_BY_DTC_NUMBER in Service DiagnosticReadDTCInformation belonging to Servicetable DcmDsdServiceTable
            ServiceTable_0_ServiceId_3_REPORT_SUPPORTED_DTC_SubServiceId_10: resulting-properties={base-type=uint8, sw-bit-representation={bit-position=4, number-of-bits=1}, sw-calibration-access=READ-WRITE, data-constr=uint8}, symbol=[0][3][0]  # DcmDsdSubServiceUsed parameter for subservice REPORT_SUPPORTED_DTC in Service DiagnosticReadDTCInformation belonging to Servicetable DcmDsdServiceTable
            ServiceTable_0_ServiceId_3_REPORT_DTC_FAULT_DETECTION_COUNTER_SubServiceId_20: resulting-properties={base-type=uint8, sw-bit-representation={bit-position=5, number-of-bits=1}, sw-calibration-access=READ-WRITE, data-constr=uint8}, symbol=[0][3][0]  # DcmDsdSubServiceUsed parameter for subservice REPORT_DTC_FAULT_DETECTION_COUNTER in Service DiagnosticReadDTCInformation belonging to Servicetable DcmDsdServiceTable
            ServiceTable_0_ServiceId_3_REPORT_USER_DEF_MEMORY_DTC_BY_STATUS_MASK_SubServiceId_23: resulting-properties={base-type=uint8, sw-bit-representation={bit-position=6, number-of-bits=1}, sw-calibration-access=READ-WRITE, data-constr=uint8}, symbol=[0][3][0]  # DcmDsdSubServiceUsed parameter for subservice REPORT_USER_DEF_MEMORY_DTC_BY_STATUS_MASK in Service DiagnosticReadDTCInformation belonging to Servicetable DcmDsdServiceTable
            ServiceTable_0_ServiceId_3_REPORT_USER_DEF_MEMORY_DTC_SNAPSHOT_RECORD_BY_DTC_NUMBER_SubServiceId_24: resulting-properties={base-type=uint8, sw-bit-representation={bit-position=7, number-of-bits=1}, sw-calibration-access=READ-WRITE, data-constr=uint8}, symbol=[0][3][0]  # DcmDsdSubServiceUsed parameter for subservice REPORT_USER_DEF_MEMORY_DTC_SNAPSHOT_RECORD_BY_DTC_NUMBER in Service DiagnosticReadDTCInformation belonging to Servicetable DcmDsdServiceTable
            ServiceTable_0_ServiceId_3_REPORT_USER_DEF_MEMORY_DTC_EXT_DATA_RECORD_BY_DTC_NUMBER_SubServiceId_25: resulting-properties={base-type=uint8, sw-bit-representation={bit-position=0, number-of-bits=1}, sw-calibration-access=READ-WRITE, data-constr=uint8}, symbol=[0][3][1]  # DcmDsdSubServiceUsed parameter for subservice REPORT_USER_DEF_MEMORY_DTC_EXT_DATA_RECORD_BY_DTC_NUMBER in Service DiagnosticReadDTCInformation belonging to Servicetable DcmDsdServiceTable
            ServiceTable_0_ServiceId_5_Level1_Seed_requestSeed_SubServiceId_1: resulting-properties={base-type=uint8, sw-bit-representation={bit-position=0, number-of-bits=1}, sw-calibration-access=READ-WRITE, data-constr=uint8}, symbol=[0][5][0]  # DcmDsdSubServiceUsed parameter for subservice Level1_Seed_requestSeed in Service DiagnosticSecurityAccess belonging to Servicetable DcmDsdServiceTable
            ServiceTable_0_ServiceId_5_Level1_Seed_sendKey_SubServiceId_2: resulting-properties={base-type=uint8, sw-bit-representation={bit-position=1, number-of-bits=1}, sw-calibration-access=READ-WRITE, data-constr=uint8}, symbol=[0][5][0]  # DcmDsdSubServiceUsed parameter for subservice Level1_Seed_sendKey in Service DiagnosticSecurityAccess belonging to Servicetable DcmDsdServiceTable
            ServiceTable_0_ServiceId_5_Level3_Seed_requestSeed_SubServiceId_3: resulting-properties={base-type=uint8, sw-bit-representation={bit-position=2, number-of-bits=1}, sw-calibration-access=READ-WRITE, data-constr=uint8}, symbol=[0][5][0]  # DcmDsdSubServiceUsed parameter for subservice Level3_Seed_requestSeed in Service DiagnosticSecurityAccess belonging to Servicetable DcmDsdServiceTable
            ServiceTable_0_ServiceId_5_Level3_Seed_sendKey_SubServiceId_4: resulting-properties={base-type=uint8, sw-bit-representation={bit-position=3, number-of-bits=1}, sw-calibration-access=READ-WRITE, data-constr=uint8}, symbol=[0][5][0]  # DcmDsdSubServiceUsed parameter for subservice Level3_Seed_sendKey in Service DiagnosticSecurityAccess belonging to Servicetable DcmDsdServiceTable
            ServiceTable_0_ServiceId_6_ENABLE_RX_AND_TX_SubServiceId_0: resulting-properties={base-type=uint8, sw-bit-representation={bit-position=0, number-of-bits=1}, sw-calibration-access=READ-WRITE, data-constr=uint8}, symbol=[0][6][0]  # DcmDsdSubServiceUsed parameter for subservice ENABLE_RX_AND_TX in Service DiagnosticComControl belonging to Servicetable DcmDsdServiceTable
            ServiceTable_0_ServiceId_6_ENABLE_RX_AND_DISABLE_TX_SubServiceId_1: resulting-properties={base-type=uint8, sw-bit-representation={bit-position=1, number-of-bits=1}, sw-calibration-access=READ-WRITE, data-constr=uint8}, symbol=[0][6][0]  # DcmDsdSubServiceUsed parameter for subservice ENABLE_RX_AND_DISABLE_TX in Service DiagnosticComControl belonging to Servicetable DcmDsdServiceTable
            ServiceTable_0_ServiceId_6_DISABLE_RX_AND_ENABLE_TX_SubServiceId_2: resulting-properties={base-type=uint8, sw-bit-representation={bit-position=2, number-of-bits=1}, sw-calibration-access=READ-WRITE, data-constr=uint8}, symbol=[0][6][0]  # DcmDsdSubServiceUsed parameter for subservice DISABLE_RX_AND_ENABLE_TX in Service DiagnosticComControl belonging to Servicetable DcmDsdServiceTable
            ServiceTable_0_ServiceId_6_DISABLE_RX_AND_TX_SubServiceId_3: resulting-properties={base-type=uint8, sw-bit-representation={bit-position=3, number-of-bits=1}, sw-calibration-access=READ-WRITE, data-constr=uint8}, symbol=[0][6][0]  # DcmDsdSubServiceUsed parameter for subservice DISABLE_RX_AND_TX in Service DiagnosticComControl belonging to Servicetable DcmDsdServiceTable
            ServiceTable_0_ServiceId_9_DcmDsdSubService_0_SubServiceId_0: resulting-properties={base-type=uint8, sw-bit-representation={bit-position=1, number-of-bits=1}, sw-calibration-access=READ-WRITE, data-constr=uint8}, symbol=[0][9][0]  # DcmDsdSubServiceUsed parameter for subservice DcmDsdSubService_0 in Service DiagnosticTesterPresent belonging to Servicetable DcmDsdServiceTable
            ServiceTable_0_ServiceId_10_DTC_Setting_Mode_On_Control_SubServiceId_1: resulting-properties={base-type=uint8, sw-bit-representation={bit-position=0, number-of-bits=1}, sw-calibration-access=READ-WRITE, data-constr=uint8}, symbol=[0][10][0]  # DcmDsdSubServiceUsed parameter for subservice DTC_Setting_Mode_On_Control in Service DiagnosticControlDTCSetting belonging to Servicetable DcmDsdServiceTable
            ServiceTable_0_ServiceId_10_DTC_Setting_Mode_Off_Control_SubServiceId_2: resulting-properties={base-type=uint8, sw-bit-representation={bit-position=1, number-of-bits=1}, sw-calibration-access=READ-WRITE, data-constr=uint8}, symbol=[0][10][0]  # DcmDsdSubServiceUsed parameter for subservice DTC_Setting_Mode_Off_Control in Service DiagnosticControlDTCSetting belonging to Servicetable DcmDsdServiceTable
            ServiceTable_0_ServiceId_11_DcmDsdSubService_0x4_SubServiceId_4: resulting-properties={base-type=uint8, sw-bit-representation={bit-position=0, number-of-bits=1}, sw-calibration-access=READ-WRITE, data-constr=uint8}, symbol=[0][11][0]  # DcmDsdSubServiceUsed parameter for subservice DcmDsdSubService_0x4 in Service DiagnosticResponseOnEvent belonging to Servicetable DcmDsdServiceTable
            ServiceTable_0_ServiceId_11_DcmDsdSubService_0x40_SubServiceId_64: resulting-properties={base-type=uint8, sw-bit-representation={bit-position=1, number-of-bits=1}, sw-calibration-access=READ-WRITE, data-constr=uint8}, symbol=[0][11][0]  # DcmDsdSubServiceUsed parameter for subservice DcmDsdSubService_0x40 in Service DiagnosticResponseOnEvent belonging to Servicetable DcmDsdServiceTable
            ServiceTable_0_ServiceId_11_DcmDsdSubService_0x45_SubServiceId_69: resulting-properties={base-type=uint8, sw-bit-representation={bit-position=2, number-of-bits=1}, sw-calibration-access=READ-WRITE, data-constr=uint8}, symbol=[0][11][0]  # DcmDsdSubServiceUsed parameter for subservice DcmDsdSubService_0x45 in Service DiagnosticResponseOnEvent belonging to Servicetable DcmDsdServiceTable
        Dcm_DsdServiceUsed: array-size=4
          19 x mc data instance, all with category=VALUE:
            ServiceTable_0_DiagnosticSessionControl_ServiceId_16: resulting-properties={base-type=uint8, sw-bit-representation={bit-position=0, number-of-bits=1}, sw-calibration-access=READ-WRITE, data-constr=uint8}, symbol=[0][0]  # DcmDsdServiceUsed parameter for service DiagnosticSessionControl in Servicetable DcmDsdServiceTable
            ServiceTable_0_DiagnosticEcuReset_ServiceId_17: resulting-properties={base-type=uint8, sw-bit-representation={bit-position=1, number-of-bits=1}, sw-calibration-access=READ-WRITE, data-constr=uint8}, symbol=[0][0]  # DcmDsdServiceUsed parameter for service DiagnosticEcuReset in Servicetable DcmDsdServiceTable
            ServiceTable_0_DiagnosticClearDiagnosticInformation_ServiceId_20: resulting-properties={base-type=uint8, sw-bit-representation={bit-position=2, number-of-bits=1}, sw-calibration-access=READ-WRITE, data-constr=uint8}, symbol=[0][0]  # DcmDsdServiceUsed parameter for service DiagnosticClearDiagnosticInformation in Servicetable DcmDsdServiceTable
            ServiceTable_0_DiagnosticReadDTCInformation_ServiceId_25: resulting-properties={base-type=uint8, sw-bit-representation={bit-position=3, number-of-bits=1}, sw-calibration-access=READ-WRITE, data-constr=uint8}, symbol=[0][0]  # DcmDsdServiceUsed parameter for service DiagnosticReadDTCInformation in Servicetable DcmDsdServiceTable
            ServiceTable_0_DiagnosticReadDataByIdentifier_ServiceId_34: resulting-properties={base-type=uint8, sw-bit-representation={bit-position=4, number-of-bits=1}, sw-calibration-access=READ-WRITE, data-constr=uint8}, symbol=[0][0]  # DcmDsdServiceUsed parameter for service DiagnosticReadDataByIdentifier in Servicetable DcmDsdServiceTable
            ServiceTable_0_DiagnosticSecurityAccess_ServiceId_39: resulting-properties={base-type=uint8, sw-bit-representation={bit-position=5, number-of-bits=1}, sw-calibration-access=READ-WRITE, data-constr=uint8}, symbol=[0][0]  # DcmDsdServiceUsed parameter for service DiagnosticSecurityAccess in Servicetable DcmDsdServiceTable
            ServiceTable_0_DiagnosticComControl_ServiceId_40: resulting-properties={base-type=uint8, sw-bit-representation={bit-position=6, number-of-bits=1}, sw-calibration-access=READ-WRITE, data-constr=uint8}, symbol=[0][0]  # DcmDsdServiceUsed parameter for service DiagnosticComControl in Servicetable DcmDsdServiceTable
            ServiceTable_0_DiagnosticWriteDataByIdentifier_ServiceId_46: resulting-properties={base-type=uint8, sw-bit-representation={bit-position=7, number-of-bits=1}, sw-calibration-access=READ-WRITE, data-constr=uint8}, symbol=[0][0]  # DcmDsdServiceUsed parameter for service DiagnosticWriteDataByIdentifier in Servicetable DcmDsdServiceTable
            ServiceTable_0_DiagnosticRoutineControl_ServiceId_49: resulting-properties={base-type=uint8, sw-bit-representation={bit-position=0, number-of-bits=1}, sw-calibration-access=READ-WRITE, data-constr=uint8}, symbol=[0][1]  # DcmDsdServiceUsed parameter for service DiagnosticRoutineControl in Servicetable DcmDsdServiceTable
            ServiceTable_0_DiagnosticTesterPresent_ServiceId_62: resulting-properties={base-type=uint8, sw-bit-representation={bit-position=1, number-of-bits=1}, sw-calibration-access=READ-WRITE, data-constr=uint8}, symbol=[0][1]  # DcmDsdServiceUsed parameter for service DiagnosticTesterPresent in Servicetable DcmDsdServiceTable
            ServiceTable_0_DiagnosticControlDTCSetting_ServiceId_133: resulting-properties={base-type=uint8, sw-bit-representation={bit-position=2, number-of-bits=1}, sw-calibration-access=READ-WRITE, data-constr=uint8}, symbol=[0][1]  # DcmDsdServiceUsed parameter for service DiagnosticControlDTCSetting in Servicetable DcmDsdServiceTable
            ServiceTable_0_DiagnosticResponseOnEvent_ServiceId_134: resulting-properties={base-type=uint8, sw-bit-representation={bit-position=3, number-of-bits=1}, sw-calibration-access=READ-WRITE, data-constr=uint8}, symbol=[0][1]  # DcmDsdServiceUsed parameter for service DiagnosticResponseOnEvent in Servicetable DcmDsdServiceTable
            ServiceTable_1_ReqCurrentPowerTrainDiag_ServiceId_1: resulting-properties={base-type=uint8, sw-bit-representation={bit-position=0, number-of-bits=1}, sw-calibration-access=READ-WRITE, data-constr=uint8}, symbol=[1][0]  # DcmDsdServiceUsed parameter for service ReqCurrentPowerTrainDiag in Servicetable DcmServiceTable_OBD
            ServiceTable_1_ReqPowerTrainFreezeFrame_ServiceId_2: resulting-properties={base-type=uint8, sw-bit-representation={bit-position=1, number-of-bits=1}, sw-calibration-access=READ-WRITE, data-constr=uint8}, symbol=[1][0]  # DcmDsdServiceUsed parameter for service ReqPowerTrainFreezeFrame in Servicetable DcmServiceTable_OBD
            ServiceTable_1_ReqEmissionRelDTC_ServiceId_3: resulting-properties={base-type=uint8, sw-bit-representation={bit-position=2, number-of-bits=1}, sw-calibration-access=READ-WRITE, data-constr=uint8}, symbol=[1][0]  # DcmDsdServiceUsed parameter for service ReqEmissionRelDTC in Servicetable DcmServiceTable_OBD
            ServiceTable_1_ClrEmissionRelDTC_ServiceId_4: resulting-properties={base-type=uint8, sw-bit-representation={bit-position=3, number-of-bits=1}, sw-calibration-access=READ-WRITE, data-constr=uint8}, symbol=[1][0]  # DcmDsdServiceUsed parameter for service ClrEmissionRelDTC in Servicetable DcmServiceTable_OBD
            ServiceTable_1_ReqExtEmissionRelDTC_ServiceId_7: resulting-properties={base-type=uint8, sw-bit-representation={bit-position=4, number-of-bits=1}, sw-calibration-access=READ-WRITE, data-constr=uint8}, symbol=[1][0]  # DcmDsdServiceUsed parameter for service ReqExtEmissionRelDTC in Servicetable DcmServiceTable_OBD
            ServiceTable_1_RequestVehicleInformation_ServiceId_9: resulting-properties={base-type=uint8, sw-bit-representation={bit-position=5, number-of-bits=1}, sw-calibration-access=READ-WRITE, data-constr=uint8}, symbol=[1][0]  # DcmDsdServiceUsed parameter for service RequestVehicleInformation in Servicetable DcmServiceTable_OBD
            ServiceTable_1_ReqNvmEmissionRelDTC_ServiceId_10: resulting-properties={base-type=uint8, sw-bit-representation={bit-position=6, number-of-bits=1}, sw-calibration-access=READ-WRITE, data-constr=uint8}, symbol=[1][0]  # DcmDsdServiceUsed parameter for service ReqNvmEmissionRelDTC in Servicetable DcmServiceTable_OBD
        Dcm_DspVehInfoUsed: array-size=1
          mc data instance DcmDspVehInfo_0: category=VALUE, resulting-properties={base-type=uint8, sw-bit-representation={bit-position=0, number-of-bits=1}, sw-calibration-access=READ-WRITE, data-constr=uint8}, symbol=[0]  # DcmDspVehInfoUsed parameter
          mc data instance DcmDspVehInfo_1: category=VALUE, resulting-properties={base-type=uint8, sw-bit-representation={bit-position=1, number-of-bits=1}, sw-calibration-access=READ-WRITE, data-constr=uint8}, symbol=[0]  # DcmDspVehInfoUsed parameter
    resource consumption ResourceConsumption
