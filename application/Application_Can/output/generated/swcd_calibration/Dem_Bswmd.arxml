AUTOSAR XML (schema 4-1-3)
package /AUTOSAR_Dem/CompuMethods
  compu method CM_DemUdsDTC: mask 0b00000000111111111111111111111111: 0b00000000000000000000000000000000..0b00000000111111111111111111111111
  compu method CM_DemDTCSeverity: mask 0b00001100000000000000000000000000: 0b00000000000000000000000000000000..0b00001100000000000000000000000000
  compu method CM_FFClassIdx: mask 0b00000000000000000000000000000010: 0b00000000000000000000000000000000..0b00000000000000000000000000000010
  compu method CM_EventClassIndex: mask 0b00000000000000000000011000000000: 0b00000000000000000000000000000000..0b00000000000000000000011000000000
  compu method CM_DemDTCFunctionalUnit: mask 0b00000000000000000000000001000000: 0b00000000000000000000000000000000..0b00000000000000000000000001000000
  compu method CM_DemEventEnabled_0: mask 0b00000001: 0b00000000..0b00000001
  compu method CM_DemEventEnabled_1: mask 0b00000010: 0b00000000..0b00000010
  compu method CM_DemEventEnabled_2: mask 0b00000100: 0b00000000..0b00000100
  compu method CM_DemEventEnabled_3: mask 0b00001000: 0b00000000..0b00001000
  compu method CM_DemEventEnabled_4: mask 0b00010000: 0b00000000..0b00010000
  compu method CM_DemEventEnabled_5: mask 0b00100000: 0b00000000..0b00100000
  compu method CM_DemEventEnabled_6: mask 0b01000000: 0b00000000..0b01000000
  compu method CM_DemEventEnabled_7: mask 0b10000000: 0b00000000..0b10000000
package /AUTOSAR_Dem/DataConstrs
  range CONSTR_DebounceTimeClassIdx: raw 0..-1
package /AUTOSAR_Dem/BswModuleDescriptions
  bsw module description Dem: module-id=54, provided-entrys=Dem_MainFunction
    bsw internal behavior InternalBehavior_0
      bsw schedulable entity Dem_MainFunction: implemented-entry=Dem_MainFunction
      bsw timing event TimingEvent_MainFunction: starts-on-event=Dem_MainFunction, period=0.02
package /AUTOSAR_Dem/BswModuleEntrys
  bsw module entry Dem_MainFunction: service-id=85, is-reentrant=false, is-synchronous=true, call-type=SCHEDULED, execution-context=TASK, sw-service-impl-policy=STANDARD
package /EB_Dem/Implementations
  bsw implementation BswImplementation_0: programming-language=C, sw-version=6.4.5, swc-bsw-mapping=SwcBswMapping_0, vendor-id=1, ar-release-version=4.0.3, behavior=InternalBehavior_0
    code-descriptors:
      code Files
        artifact-descriptors:
          short-label=Autosar::include::Dem.h, category=SWHDR
          short-label=Autosar::include::Dem_BSW_Types.h, category=SWHDR
          short-label=Autosar::include::Dem_Int.h, category=SWHDR
          short-label=Autosar::include::Dem_Int_Stc.h, category=SWHDR
          short-label=Autosar::include::Dem_NvMCbk.h, category=SWHDR
          short-label=Autosar::include::Dem_Stc.h, category=SWHDR
          short-label=Autosar::include::Dem_Trace.h, category=SWHDR
          short-label=Autosar::include::Dem_Types.h, category=SWHDR
          short-label=Autosar::include::Dem_Version.h, category=SWHDR
          short-label=Autosar::src::Dem.c, category=SWSRC
          short-label=Autosar::src::Dem_Core.c, category=SWSRC
          short-label=Autosar::src::Dem_DcmIfAccess.c, category=SWSRC
          short-label=Autosar::src::Dem_DcmIfFFandED.c, category=SWSRC
          short-label=Autosar::src::Dem_DcmIfOBD.c, category=SWSRC
          short-label=Autosar::src::Dem_DcmIfStatusInfo.c, category=SWSRC
          short-label=Autosar::src::Dem_J1939Dcm.c, category=SWSRC
          short-label=Autosar::src::Dem_J1939FF.c, category=SWSRC
          short-label=make::Dem_defs.mak, category=SWMAKE
          short-label=make::Dem_rules.mak, category=SWMAKE
    mc-parameter-instances:
      14 x mc data instance:
        Dem_IndicatorClasses: category=ARRAY, array-size=1
          mc data instance IndicatorClasses_0: category=STRUCTURE, symbol=[0]
            5 x mc data instance, all with category=VALUE, resulting-properties={base-type=uint8, sw-calibration-access=READ-WRITE, data-constr=uint8}:
              Enabled  # Enabled state of the Indicator class (enabled == 1, disabled == 0).
              IndicatorId  # Id of the indicator referenced by Indicator class. Range of accepted values is 0..254, as only 255 indicators are allowed by Autosar. If MIL indicator is referenced then the ObdDTC of the respective event shall be enabled.
              Behaviour  # Behaviour of Indicator class has the range 0..3 corresponding to the indicator modes DEM_INDICATOR_OFF, DEM_INDICATOR_CONTINUOUS, DEM_INDICATOR_BLINKING and DEM_INDICATOR_BLINK_CONT.
              HealingCycleThreshold  # HealingCycleThreshold of Indicator class. Calibration of this value is only allowed before Dem_PreInit() is called. If the threshold will be re-calibrated the effect will be considered at the next processing and not during initialization. Range is 0..255.
              FailureCycleThreshold  # FailureCycleThreshold of Indicator class. Calibration of this value is only allowed before Dem_PreInit() is called. If the threshold will be re-calibrated the effect will be considered at the next processing and not during initialization. Range is limited to 1..255. For rationale see deviation "Fault Confirmation and Warning Indicator behavior".
          mc data instance IndicatorClasses_1: category=STRUCTURE, symbol=[1]
            5 x mc data instance, all with category=VALUE, resulting-properties={base-type=uint8, sw-calibration-access=READ-WRITE, data-constr=uint8}:
              Enabled  # Enabled state of the Indicator class (enabled == 1, disabled == 0).
              IndicatorId  # Id of the indicator referenced by Indicator class. Range of accepted values is 0..254, as only 255 indicators are allowed by Autosar. If MIL indicator is referenced then the ObdDTC of the respective event shall be enabled.
              Behaviour  # Behaviour of Indicator class has the range 0..3 corresponding to the indicator modes DEM_INDICATOR_OFF, DEM_INDICATOR_CONTINUOUS, DEM_INDICATOR_BLINKING and DEM_INDICATOR_BLINK_CONT.
              HealingCycleThreshold  # HealingCycleThreshold of Indicator class. Calibration of this value is only allowed before Dem_PreInit() is called. If the threshold will be re-calibrated the effect will be considered at the next processing and not during initialization. Range is 0..255.
              FailureCycleThreshold  # FailureCycleThreshold of Indicator class. Calibration of this value is only allowed before Dem_PreInit() is called. If the threshold will be re-calibrated the effect will be considered at the next processing and not during initialization. Range is limited to 1..255. For rationale see deviation "Fault Confirmation and Warning Indicator behavior".
        Dem_EventClassDesc: category=ARRAY, array-size=3
          mc data instance EventClass_0: category=STRUCTURE, symbol=[0]
            7 x mc data instance:
              IndicatorClassIdx: category=VALUE, resulting-properties={base-type=uint8, sw-calibration-access=READ-WRITE, data-constr=uint8}  # Index of Indicator class. Range is 0..1. Value 1 is used to disable indicator class. Notes for events assigned to a MIL group: - If the MIL indicator is removed through calibration, the event is no longer considered as member of the MIL group. - If the calibration of the MIL indicator's class causes 'DemIndicatorFailureCycleRef' or 'DemIndicatorFailureCycleCounterThreshold' to be different from 'DemOperationCycleRef' or, respectively, 'DemEventFailureCycleCounterThreshold', the failure counters are not in sync anymore. This could lead to undefined behavior at run-time. - Calibration of the MIL indicator to a class with 'DemIndicatorFailureCycleCounterThreshold' equal to 1 is not allowed. Note for events with 'DemEventKind' set to 'DEM_EVENT_KIND_SEV': No indicator may be assigned via calibration.
              AgingCycleCounterThreshold: category=VALUE, resulting-properties={base-type=uint8, sw-calibration-access=READ-WRITE, data-constr=uint8}  # Value of DemAgingCycleCounterThreshold. Calibration of this value is only allowed before Dem_PreInit() is called. After re-calibration of aging support the stored event related data is not valid. Range is 0..255. Value 0 disables aging. Note that for events with 'DemEventKind' set to 'DEM_EVENT_KIND_SEV' aging must not be enabled via calibration.
              EventFailureCycleCounterThreshold: category=VALUE, resulting-properties={base-type=uint8, sw-calibration-access=READ-WRITE, data-constr=uint8}  # Value of DemEventFailureCycleCounterThreshold. Allowed calibration values are in the range 1..254. Value 0 is invalid. For MIL group events, the calibration of this parameter to value 1 is not allowed. If the 'DemEventFailureCycleCounterThreshold' of a MIL group event is changed to be different from 'DemIndicatorFailureCycleCounterThreshold' configured for its MIL indicator, the MIL counter and the confirmation counter would not be in sync anymore. This could lead to undefined behavior during runtime.
              EventPriority: category=VALUE, resulting-properties={base-type=uint8, sw-calibration-access=READ-WRITE, data-constr=uint8}  # Value of DemEventPriority. Range is 1..255, value 1 representing the highest priority and each value sequentially larger indicating a lower importance. Value 0 is invalid.
              CommonOperationCycle: category=VALUE, resulting-properties={base-type=uint8, sw-calibration-access=READ-WRITE, data-constr=uint8}  # Common operation cycle is used as aging cycle, event failure cycle, indicator failure cycle and indicator healing cycle. It has to reference a configured operation cycle. Range is limited to 0..254. Disabling the common operation cycle may lead to inconsistencies between 'DemOperationCycleRef', 'DemEventFailureCycleRef' and the MIL indicator's 'DemIndicatorFailureCycleRef' for the events assigned to a MIL group. This would cause issues with the synchronization of the MIL counter and the confirmation counter, which could lead to undefined behavior during runtime.
              Bitfield: category=STRUCTURE  # Collection of Boolean parameters per Event Class
                mc data instance MinRatioEvent: category=VALUE, resulting-properties={base-type=uint8, sw-bit-representation={bit-position=0, number-of-bits=1}, sw-calibration-access=READ-WRITE, compu {mask 0b00000001: 0b00000000..0b00000001}, data-constr=uint8}, symbol=Bitfield  # Value 1 means DemMinRatioEvent == 'true' and value 0 implies that DemMinRatioEvent == 'false'. Range is 0..1.
                mc data instance FreezeFrameUpdate: category=VALUE, resulting-properties={base-type=uint8, sw-bit-representation={bit-position=1, number-of-bits=1}, sw-calibration-access=READ-WRITE, compu {mask 0b00000010: 0b00000000..0b00000010}, data-constr=uint8}, symbol=Bitfield  # Value 1 means DemFreezeFrameUpdate == 'true' and value 0 implies that DemFreezeFrameUpdate == 'false'. Range is 0..1.
              EnableConditionGroupRef: category=VALUE, resulting-properties={base-type=uint8, sw-calibration-access=READ-WRITE, data-constr=uint8}  # Reference to a configured enable condition group. If DemEnableConditionGroupRef is disabled for a dedicated event, the number of all configured enable condition groups will be placed at this parameter. Range is 0..254.
          mc data instance EventClass_1: category=STRUCTURE, symbol=[1]
            7 x mc data instance:
              IndicatorClassIdx: category=VALUE, resulting-properties={base-type=uint8, sw-calibration-access=READ-WRITE, data-constr=uint8}  # Index of Indicator class. Range is 0..1. Value 1 is used to disable indicator class. Notes for events assigned to a MIL group: - If the MIL indicator is removed through calibration, the event is no longer considered as member of the MIL group. - If the calibration of the MIL indicator's class causes 'DemIndicatorFailureCycleRef' or 'DemIndicatorFailureCycleCounterThreshold' to be different from 'DemOperationCycleRef' or, respectively, 'DemEventFailureCycleCounterThreshold', the failure counters are not in sync anymore. This could lead to undefined behavior at run-time. - Calibration of the MIL indicator to a class with 'DemIndicatorFailureCycleCounterThreshold' equal to 1 is not allowed. Note for events with 'DemEventKind' set to 'DEM_EVENT_KIND_SEV': No indicator may be assigned via calibration.
              AgingCycleCounterThreshold: category=VALUE, resulting-properties={base-type=uint8, sw-calibration-access=READ-WRITE, data-constr=uint8}  # Value of DemAgingCycleCounterThreshold. Calibration of this value is only allowed before Dem_PreInit() is called. After re-calibration of aging support the stored event related data is not valid. Range is 0..255. Value 0 disables aging. Note that for events with 'DemEventKind' set to 'DEM_EVENT_KIND_SEV' aging must not be enabled via calibration.
              EventFailureCycleCounterThreshold: category=VALUE, resulting-properties={base-type=uint8, sw-calibration-access=READ-WRITE, data-constr=uint8}  # Value of DemEventFailureCycleCounterThreshold. Allowed calibration values are in the range 1..254. Value 0 is invalid. For MIL group events, the calibration of this parameter to value 1 is not allowed. If the 'DemEventFailureCycleCounterThreshold' of a MIL group event is changed to be different from 'DemIndicatorFailureCycleCounterThreshold' configured for its MIL indicator, the MIL counter and the confirmation counter would not be in sync anymore. This could lead to undefined behavior during runtime.
              EventPriority: category=VALUE, resulting-properties={base-type=uint8, sw-calibration-access=READ-WRITE, data-constr=uint8}  # Value of DemEventPriority. Range is 1..255, value 1 representing the highest priority and each value sequentially larger indicating a lower importance. Value 0 is invalid.
              CommonOperationCycle: category=VALUE, resulting-properties={base-type=uint8, sw-calibration-access=READ-WRITE, data-constr=uint8}  # Common operation cycle is used as aging cycle, event failure cycle, indicator failure cycle and indicator healing cycle. It has to reference a configured operation cycle. Range is limited to 0..254. Disabling the common operation cycle may lead to inconsistencies between 'DemOperationCycleRef', 'DemEventFailureCycleRef' and the MIL indicator's 'DemIndicatorFailureCycleRef' for the events assigned to a MIL group. This would cause issues with the synchronization of the MIL counter and the confirmation counter, which could lead to undefined behavior during runtime.
              Bitfield: category=STRUCTURE  # Collection of Boolean parameters per Event Class
                mc data instance MinRatioEvent: category=VALUE, resulting-properties={base-type=uint8, sw-bit-representation={bit-position=0, number-of-bits=1}, sw-calibration-access=READ-WRITE, compu {mask 0b00000001: 0b00000000..0b00000001}, data-constr=uint8}, symbol=Bitfield  # Value 1 means DemMinRatioEvent == 'true' and value 0 implies that DemMinRatioEvent == 'false'. Range is 0..1.
                mc data instance FreezeFrameUpdate: category=VALUE, resulting-properties={base-type=uint8, sw-bit-representation={bit-position=1, number-of-bits=1}, sw-calibration-access=READ-WRITE, compu {mask 0b00000010: 0b00000000..0b00000010}, data-constr=uint8}, symbol=Bitfield  # Value 1 means DemFreezeFrameUpdate == 'true' and value 0 implies that DemFreezeFrameUpdate == 'false'. Range is 0..1.
              EnableConditionGroupRef: category=VALUE, resulting-properties={base-type=uint8, sw-calibration-access=READ-WRITE, data-constr=uint8}  # Reference to a configured enable condition group. If DemEnableConditionGroupRef is disabled for a dedicated event, the number of all configured enable condition groups will be placed at this parameter. Range is 0..254.
          mc data instance EventClass_2: category=STRUCTURE, symbol=[2]
            7 x mc data instance:
              IndicatorClassIdx: category=VALUE, resulting-properties={base-type=uint8, sw-calibration-access=READ-WRITE, data-constr=uint8}  # Index of Indicator class. Range is 0..1. Value 1 is used to disable indicator class. Notes for events assigned to a MIL group: - If the MIL indicator is removed through calibration, the event is no longer considered as member of the MIL group. - If the calibration of the MIL indicator's class causes 'DemIndicatorFailureCycleRef' or 'DemIndicatorFailureCycleCounterThreshold' to be different from 'DemOperationCycleRef' or, respectively, 'DemEventFailureCycleCounterThreshold', the failure counters are not in sync anymore. This could lead to undefined behavior at run-time. - Calibration of the MIL indicator to a class with 'DemIndicatorFailureCycleCounterThreshold' equal to 1 is not allowed. Note for events with 'DemEventKind' set to 'DEM_EVENT_KIND_SEV': No indicator may be assigned via calibration.
              AgingCycleCounterThreshold: category=VALUE, resulting-properties={base-type=uint8, sw-calibration-access=READ-WRITE, data-constr=uint8}  # Value of DemAgingCycleCounterThreshold. Calibration of this value is only allowed before Dem_PreInit() is called. After re-calibration of aging support the stored event related data is not valid. Range is 0..255. Value 0 disables aging. Note that for events with 'DemEventKind' set to 'DEM_EVENT_KIND_SEV' aging must not be enabled via calibration.
              EventFailureCycleCounterThreshold: category=VALUE, resulting-properties={base-type=uint8, sw-calibration-access=READ-WRITE, data-constr=uint8}  # Value of DemEventFailureCycleCounterThreshold. Allowed calibration values are in the range 1..254. Value 0 is invalid. For MIL group events, the calibration of this parameter to value 1 is not allowed. If the 'DemEventFailureCycleCounterThreshold' of a MIL group event is changed to be different from 'DemIndicatorFailureCycleCounterThreshold' configured for its MIL indicator, the MIL counter and the confirmation counter would not be in sync anymore. This could lead to undefined behavior during runtime.
              EventPriority: category=VALUE, resulting-properties={base-type=uint8, sw-calibration-access=READ-WRITE, data-constr=uint8}  # Value of DemEventPriority. Range is 1..255, value 1 representing the highest priority and each value sequentially larger indicating a lower importance. Value 0 is invalid.
              CommonOperationCycle: category=VALUE, resulting-properties={base-type=uint8, sw-calibration-access=READ-WRITE, data-constr=uint8}  # Common operation cycle is used as aging cycle, event failure cycle, indicator failure cycle and indicator healing cycle. It has to reference a configured operation cycle. Range is limited to 0..254. Disabling the common operation cycle may lead to inconsistencies between 'DemOperationCycleRef', 'DemEventFailureCycleRef' and the MIL indicator's 'DemIndicatorFailureCycleRef' for the events assigned to a MIL group. This would cause issues with the synchronization of the MIL counter and the confirmation counter, which could lead to undefined behavior during runtime.
              Bitfield: category=STRUCTURE  # Collection of Boolean parameters per Event Class
                mc data instance MinRatioEvent: category=VALUE, resulting-properties={base-type=uint8, sw-bit-representation={bit-position=0, number-of-bits=1}, sw-calibration-access=READ-WRITE, compu {mask 0b00000001: 0b00000000..0b00000001}, data-constr=uint8}, symbol=Bitfield  # Value 1 means DemMinRatioEvent == 'true' and value 0 implies that DemMinRatioEvent == 'false'. Range is 0..1.
                mc data instance FreezeFrameUpdate: category=VALUE, resulting-properties={base-type=uint8, sw-bit-representation={bit-position=1, number-of-bits=1}, sw-calibration-access=READ-WRITE, compu {mask 0b00000010: 0b00000000..0b00000010}, data-constr=uint8}, symbol=Bitfield  # Value 1 means DemFreezeFrameUpdate == 'true' and value 0 implies that DemFreezeFrameUpdate == 'false'. Range is 0..1.
              EnableConditionGroupRef: category=VALUE, resulting-properties={base-type=uint8, sw-calibration-access=READ-WRITE, data-constr=uint8}  # Reference to a configured enable condition group. If DemEnableConditionGroupRef is disabled for a dedicated event, the number of all configured enable condition groups will be placed at this parameter. Range is 0..254.
        Dem_EventDesc: category=ARRAY, array-size=15
          15 x mc data instance, all with category=STRUCTURE:
            DTC_0x000001_Event: symbol=[1]
              mc data instance EvConf1: category=STRUCTURE
                mc data instance DemUdsDTC: category=VALUE, resulting-properties={base-type=uint32, sw-bit-representation={bit-position=0, number-of-bits=24}, sw-calibration-access=READ-WRITE, compu-method=CM_DemUdsDTC, data-constr=uint32}, symbol=EvConf1  # UDS DTC value of the event (special case DTC 0: means DTC off; it is not allowed to have the same DTC value for more than one event). Valid range of DTC calibration is within the configured DTC group including value 0 to disable the DTC. If re-calibration is performed during Dcm service request processing, the Dem may return still with the DTC, although the DTC is switched off already until a request for a different DTC. For service 0x19, if the DTC is identified by the algorithm the value of the DTC will be returned. In case calibration occurs with DTC off and the service is called again, the DTC being identified by the algorithm, the DTC returned by the service is DEM_NO_DTC. Range is 0..16777214, displayable on 24 bits.
                mc data instance DemDTCSeverity: category=VALUE, resulting-properties={base-type=uint32, sw-bit-representation={bit-position=26, number-of-bits=2}, sw-calibration-access=READ-WRITE, compu-method=CM_DemDTCSeverity, data-constr=uint32}, symbol=EvConf1  # Internal representation: '0' == 'DEM_DTC_SEV_NO_SEVERITY', '1' == 'DEM_DTC_SEV_MAINTENANCE_ONLY', '2' == 'DEM_DTC_SEV_CHECK_AT_NEXT_HALT', '3' == 'DEM_DTC_SEV_IMMEDIATELY'.
              mc data instance EvConf2: category=STRUCTURE
                mc data instance FFClassIdx: category=VALUE, resulting-properties={base-type=uint32, sw-bit-representation={bit-position=1, number-of-bits=1}, sw-calibration-access=READ-WRITE, compu-method=CM_FFClassIdx, data-constr=uint32}, symbol=EvConf2  # Index of used Freeze Frame class. Range is 0..16383 displayable on 14 bits (maximum assignable bits). Note: Freeze frames of events with 'DemEventKind' set to 'DEM_EVENT_KIND_SEV' must not be changed via calibration.
                mc data instance EventClassIndex: category=VALUE, resulting-properties={base-type=uint32, sw-bit-representation={bit-position=9, number-of-bits=2}, sw-calibration-access=READ-WRITE, compu-method=CM_EventClassIndex, data-constr=uint32}, symbol=EvConf2  # Index of Event Class. Ranges from 0 to whichever value is greater between DemMaxNumberEventClasses and the number of different EventClasses. DemMaxNumberEventClasses can be configured to a maximum value of 2048. Notes for events belonging to a MIL group: - If the MIL indicator is removed through calibration, the event is no longer considered as member of the MIL group. - If the change of the event class no longer ensures the consistency of 'DemOperationCycleRef', 'DemEventFailureCycleRef', 'DemEventFailureCycleCounterThreshold' or MIL indicator's 'DemIndicatorFailureCycleRef' and 'DemIndicatorFailureCycleCounterThreshold', between the MIL group events, the MIL counters and the confirmation counters will be out of sync. This could lead to undefined behavior during run-time. - Calibration of the MIL group event to a class with 'DemEventFailureCycleCounterThreshold' equal to 1 is not allowed. Note that it is not recommended to calibrate the EventClassIndex for events with 'DemEventKind' set to 'DEM_EVENT_KIND_SEV', since this could cause violations of configuration constraints with respect to indicators, aging and MultiEventTriggering.
              mc data instance EvConf3: category=STRUCTURE
                mc data instance DemDTCFunctionalUnit: category=VALUE, resulting-properties={base-type=uint32, sw-bit-representation={bit-position=6, number-of-bits=1}, sw-calibration-access=READ-WRITE, compu-method=CM_DemDTCFunctionalUnit, data-constr=uint32}, symbol=EvConf3  # DTCFunctionalUnit identifies the corresponding basic vehicle or system function which reports the DTC. Ranges between 0 and the maximum value which fits the number of bits allocated for this information. The width of this bit-field information can vary depending on the configuration.
            Permanent_DTC: symbol=[2]
              mc data instance EvConf1: category=STRUCTURE
                mc data instance DemUdsDTC: category=VALUE, resulting-properties={base-type=uint32, sw-bit-representation={bit-position=0, number-of-bits=24}, sw-calibration-access=READ-WRITE, compu-method=CM_DemUdsDTC, data-constr=uint32}, symbol=EvConf1  # UDS DTC value of the event (special case DTC 0: means DTC off; it is not allowed to have the same DTC value for more than one event). Valid range of DTC calibration is within the configured DTC group including value 0 to disable the DTC. If re-calibration is performed during Dcm service request processing, the Dem may return still with the DTC, although the DTC is switched off already until a request for a different DTC. For service 0x19, if the DTC is identified by the algorithm the value of the DTC will be returned. In case calibration occurs with DTC off and the service is called again, the DTC being identified by the algorithm, the DTC returned by the service is DEM_NO_DTC. Range is 0..16777214, displayable on 24 bits.
                mc data instance DemDTCSeverity: category=VALUE, resulting-properties={base-type=uint32, sw-bit-representation={bit-position=26, number-of-bits=2}, sw-calibration-access=READ-WRITE, compu-method=CM_DemDTCSeverity, data-constr=uint32}, symbol=EvConf1  # Internal representation: '0' == 'DEM_DTC_SEV_NO_SEVERITY', '1' == 'DEM_DTC_SEV_MAINTENANCE_ONLY', '2' == 'DEM_DTC_SEV_CHECK_AT_NEXT_HALT', '3' == 'DEM_DTC_SEV_IMMEDIATELY'.
              mc data instance EvConf2: category=STRUCTURE
                mc data instance FFClassIdx: category=VALUE, resulting-properties={base-type=uint32, sw-bit-representation={bit-position=1, number-of-bits=1}, sw-calibration-access=READ-WRITE, compu-method=CM_FFClassIdx, data-constr=uint32}, symbol=EvConf2  # Index of used Freeze Frame class. Range is 0..16383 displayable on 14 bits (maximum assignable bits). Note: Freeze frames of events with 'DemEventKind' set to 'DEM_EVENT_KIND_SEV' must not be changed via calibration.
                mc data instance EventClassIndex: category=VALUE, resulting-properties={base-type=uint32, sw-bit-representation={bit-position=9, number-of-bits=2}, sw-calibration-access=READ-WRITE, compu-method=CM_EventClassIndex, data-constr=uint32}, symbol=EvConf2  # Index of Event Class. Ranges from 0 to whichever value is greater between DemMaxNumberEventClasses and the number of different EventClasses. DemMaxNumberEventClasses can be configured to a maximum value of 2048. Notes for events belonging to a MIL group: - If the MIL indicator is removed through calibration, the event is no longer considered as member of the MIL group. - If the change of the event class no longer ensures the consistency of 'DemOperationCycleRef', 'DemEventFailureCycleRef', 'DemEventFailureCycleCounterThreshold' or MIL indicator's 'DemIndicatorFailureCycleRef' and 'DemIndicatorFailureCycleCounterThreshold', between the MIL group events, the MIL counters and the confirmation counters will be out of sync. This could lead to undefined behavior during run-time. - Calibration of the MIL group event to a class with 'DemEventFailureCycleCounterThreshold' equal to 1 is not allowed. Note that it is not recommended to calibrate the EventClassIndex for events with 'DemEventKind' set to 'DEM_EVENT_KIND_SEV', since this could cause violations of configuration constraints with respect to indicators, aging and MultiEventTriggering.
              mc data instance EvConf3: category=STRUCTURE
                mc data instance DemDTCFunctionalUnit: category=VALUE, resulting-properties={base-type=uint32, sw-bit-representation={bit-position=6, number-of-bits=1}, sw-calibration-access=READ-WRITE, compu-method=CM_DemDTCFunctionalUnit, data-constr=uint32}, symbol=EvConf3  # DTCFunctionalUnit identifies the corresponding basic vehicle or system function which reports the DTC. Ranges between 0 and the maximum value which fits the number of bits allocated for this information. The width of this bit-field information can vary depending on the configuration.
            WDGM_E_MONITORING: symbol=[3]
              mc data instance EvConf1: category=STRUCTURE
                mc data instance DemUdsDTC: category=VALUE, resulting-properties={base-type=uint32, sw-bit-representation={bit-position=0, number-of-bits=24}, sw-calibration-access=READ-WRITE, compu-method=CM_DemUdsDTC, data-constr=uint32}, symbol=EvConf1  # UDS DTC value of the event (special case DTC 0: means DTC off; it is not allowed to have the same DTC value for more than one event). Valid range of DTC calibration is within the configured DTC group including value 0 to disable the DTC. If re-calibration is performed during Dcm service request processing, the Dem may return still with the DTC, although the DTC is switched off already until a request for a different DTC. For service 0x19, if the DTC is identified by the algorithm the value of the DTC will be returned. In case calibration occurs with DTC off and the service is called again, the DTC being identified by the algorithm, the DTC returned by the service is DEM_NO_DTC. Range is 0..16777214, displayable on 24 bits.
                mc data instance DemDTCSeverity: category=VALUE, resulting-properties={base-type=uint32, sw-bit-representation={bit-position=26, number-of-bits=2}, sw-calibration-access=READ-WRITE, compu-method=CM_DemDTCSeverity, data-constr=uint32}, symbol=EvConf1  # Internal representation: '0' == 'DEM_DTC_SEV_NO_SEVERITY', '1' == 'DEM_DTC_SEV_MAINTENANCE_ONLY', '2' == 'DEM_DTC_SEV_CHECK_AT_NEXT_HALT', '3' == 'DEM_DTC_SEV_IMMEDIATELY'.
              mc data instance EvConf2: category=STRUCTURE
                mc data instance FFClassIdx: category=VALUE, resulting-properties={base-type=uint32, sw-bit-representation={bit-position=1, number-of-bits=1}, sw-calibration-access=READ-WRITE, compu-method=CM_FFClassIdx, data-constr=uint32}, symbol=EvConf2  # Index of used Freeze Frame class. Range is 0..16383 displayable on 14 bits (maximum assignable bits). Note: Freeze frames of events with 'DemEventKind' set to 'DEM_EVENT_KIND_SEV' must not be changed via calibration.
                mc data instance EventClassIndex: category=VALUE, resulting-properties={base-type=uint32, sw-bit-representation={bit-position=9, number-of-bits=2}, sw-calibration-access=READ-WRITE, compu-method=CM_EventClassIndex, data-constr=uint32}, symbol=EvConf2  # Index of Event Class. Ranges from 0 to whichever value is greater between DemMaxNumberEventClasses and the number of different EventClasses. DemMaxNumberEventClasses can be configured to a maximum value of 2048. Notes for events belonging to a MIL group: - If the MIL indicator is removed through calibration, the event is no longer considered as member of the MIL group. - If the change of the event class no longer ensures the consistency of 'DemOperationCycleRef', 'DemEventFailureCycleRef', 'DemEventFailureCycleCounterThreshold' or MIL indicator's 'DemIndicatorFailureCycleRef' and 'DemIndicatorFailureCycleCounterThreshold', between the MIL group events, the MIL counters and the confirmation counters will be out of sync. This could lead to undefined behavior during run-time. - Calibration of the MIL group event to a class with 'DemEventFailureCycleCounterThreshold' equal to 1 is not allowed. Note that it is not recommended to calibrate the EventClassIndex for events with 'DemEventKind' set to 'DEM_EVENT_KIND_SEV', since this could cause violations of configuration constraints with respect to indicators, aging and MultiEventTriggering.
              mc data instance EvConf3: category=STRUCTURE
                mc data instance DemDTCFunctionalUnit: category=VALUE, resulting-properties={base-type=uint32, sw-bit-representation={bit-position=6, number-of-bits=1}, sw-calibration-access=READ-WRITE, compu-method=CM_DemDTCFunctionalUnit, data-constr=uint32}, symbol=EvConf3  # DTCFunctionalUnit identifies the corresponding basic vehicle or system function which reports the DTC. Ranges between 0 and the maximum value which fits the number of bits allocated for this information. The width of this bit-field information can vary depending on the configuration.
            WDGM_E_SET_MODE: symbol=[4]
              mc data instance EvConf1: category=STRUCTURE
                mc data instance DemUdsDTC: category=VALUE, resulting-properties={base-type=uint32, sw-bit-representation={bit-position=0, number-of-bits=24}, sw-calibration-access=READ-WRITE, compu-method=CM_DemUdsDTC, data-constr=uint32}, symbol=EvConf1  # UDS DTC value of the event (special case DTC 0: means DTC off; it is not allowed to have the same DTC value for more than one event). Valid range of DTC calibration is within the configured DTC group including value 0 to disable the DTC. If re-calibration is performed during Dcm service request processing, the Dem may return still with the DTC, although the DTC is switched off already until a request for a different DTC. For service 0x19, if the DTC is identified by the algorithm the value of the DTC will be returned. In case calibration occurs with DTC off and the service is called again, the DTC being identified by the algorithm, the DTC returned by the service is DEM_NO_DTC. Range is 0..16777214, displayable on 24 bits.
                mc data instance DemDTCSeverity: category=VALUE, resulting-properties={base-type=uint32, sw-bit-representation={bit-position=26, number-of-bits=2}, sw-calibration-access=READ-WRITE, compu-method=CM_DemDTCSeverity, data-constr=uint32}, symbol=EvConf1  # Internal representation: '0' == 'DEM_DTC_SEV_NO_SEVERITY', '1' == 'DEM_DTC_SEV_MAINTENANCE_ONLY', '2' == 'DEM_DTC_SEV_CHECK_AT_NEXT_HALT', '3' == 'DEM_DTC_SEV_IMMEDIATELY'.
              mc data instance EvConf2: category=STRUCTURE
                mc data instance FFClassIdx: category=VALUE, resulting-properties={base-type=uint32, sw-bit-representation={bit-position=1, number-of-bits=1}, sw-calibration-access=READ-WRITE, compu-method=CM_FFClassIdx, data-constr=uint32}, symbol=EvConf2  # Index of used Freeze Frame class. Range is 0..16383 displayable on 14 bits (maximum assignable bits). Note: Freeze frames of events with 'DemEventKind' set to 'DEM_EVENT_KIND_SEV' must not be changed via calibration.
                mc data instance EventClassIndex: category=VALUE, resulting-properties={base-type=uint32, sw-bit-representation={bit-position=9, number-of-bits=2}, sw-calibration-access=READ-WRITE, compu-method=CM_EventClassIndex, data-constr=uint32}, symbol=EvConf2  # Index of Event Class. Ranges from 0 to whichever value is greater between DemMaxNumberEventClasses and the number of different EventClasses. DemMaxNumberEventClasses can be configured to a maximum value of 2048. Notes for events belonging to a MIL group: - If the MIL indicator is removed through calibration, the event is no longer considered as member of the MIL group. - If the change of the event class no longer ensures the consistency of 'DemOperationCycleRef', 'DemEventFailureCycleRef', 'DemEventFailureCycleCounterThreshold' or MIL indicator's 'DemIndicatorFailureCycleRef' and 'DemIndicatorFailureCycleCounterThreshold', between the MIL group events, the MIL counters and the confirmation counters will be out of sync. This could lead to undefined behavior during run-time. - Calibration of the MIL group event to a class with 'DemEventFailureCycleCounterThreshold' equal to 1 is not allowed. Note that it is not recommended to calibrate the EventClassIndex for events with 'DemEventKind' set to 'DEM_EVENT_KIND_SEV', since this could cause violations of configuration constraints with respect to indicators, aging and MultiEventTriggering.
              mc data instance EvConf3: category=STRUCTURE
                mc data instance DemDTCFunctionalUnit: category=VALUE, resulting-properties={base-type=uint32, sw-bit-representation={bit-position=6, number-of-bits=1}, sw-calibration-access=READ-WRITE, compu-method=CM_DemDTCFunctionalUnit, data-constr=uint32}, symbol=EvConf3  # DTCFunctionalUnit identifies the corresponding basic vehicle or system function which reports the DTC. Ranges between 0 and the maximum value which fits the number of bits allocated for this information. The width of this bit-field information can vary depending on the configuration.
            WDGM_E_DATA_CORRUPTION: symbol=[5]
              mc data instance EvConf1: category=STRUCTURE
                mc data instance DemUdsDTC: category=VALUE, resulting-properties={base-type=uint32, sw-bit-representation={bit-position=0, number-of-bits=24}, sw-calibration-access=READ-WRITE, compu-method=CM_DemUdsDTC, data-constr=uint32}, symbol=EvConf1  # UDS DTC value of the event (special case DTC 0: means DTC off; it is not allowed to have the same DTC value for more than one event). Valid range of DTC calibration is within the configured DTC group including value 0 to disable the DTC. If re-calibration is performed during Dcm service request processing, the Dem may return still with the DTC, although the DTC is switched off already until a request for a different DTC. For service 0x19, if the DTC is identified by the algorithm the value of the DTC will be returned. In case calibration occurs with DTC off and the service is called again, the DTC being identified by the algorithm, the DTC returned by the service is DEM_NO_DTC. Range is 0..16777214, displayable on 24 bits.
                mc data instance DemDTCSeverity: category=VALUE, resulting-properties={base-type=uint32, sw-bit-representation={bit-position=26, number-of-bits=2}, sw-calibration-access=READ-WRITE, compu-method=CM_DemDTCSeverity, data-constr=uint32}, symbol=EvConf1  # Internal representation: '0' == 'DEM_DTC_SEV_NO_SEVERITY', '1' == 'DEM_DTC_SEV_MAINTENANCE_ONLY', '2' == 'DEM_DTC_SEV_CHECK_AT_NEXT_HALT', '3' == 'DEM_DTC_SEV_IMMEDIATELY'.
              mc data instance EvConf2: category=STRUCTURE
                mc data instance FFClassIdx: category=VALUE, resulting-properties={base-type=uint32, sw-bit-representation={bit-position=1, number-of-bits=1}, sw-calibration-access=READ-WRITE, compu-method=CM_FFClassIdx, data-constr=uint32}, symbol=EvConf2  # Index of used Freeze Frame class. Range is 0..16383 displayable on 14 bits (maximum assignable bits). Note: Freeze frames of events with 'DemEventKind' set to 'DEM_EVENT_KIND_SEV' must not be changed via calibration.
                mc data instance EventClassIndex: category=VALUE, resulting-properties={base-type=uint32, sw-bit-representation={bit-position=9, number-of-bits=2}, sw-calibration-access=READ-WRITE, compu-method=CM_EventClassIndex, data-constr=uint32}, symbol=EvConf2  # Index of Event Class. Ranges from 0 to whichever value is greater between DemMaxNumberEventClasses and the number of different EventClasses. DemMaxNumberEventClasses can be configured to a maximum value of 2048. Notes for events belonging to a MIL group: - If the MIL indicator is removed through calibration, the event is no longer considered as member of the MIL group. - If the change of the event class no longer ensures the consistency of 'DemOperationCycleRef', 'DemEventFailureCycleRef', 'DemEventFailureCycleCounterThreshold' or MIL indicator's 'DemIndicatorFailureCycleRef' and 'DemIndicatorFailureCycleCounterThreshold', between the MIL group events, the MIL counters and the confirmation counters will be out of sync. This could lead to undefined behavior during run-time. - Calibration of the MIL group event to a class with 'DemEventFailureCycleCounterThreshold' equal to 1 is not allowed. Note that it is not recommended to calibrate the EventClassIndex for events with 'DemEventKind' set to 'DEM_EVENT_KIND_SEV', since this could cause violations of configuration constraints with respect to indicators, aging and MultiEventTriggering.
              mc data instance EvConf3: category=STRUCTURE
                mc data instance DemDTCFunctionalUnit: category=VALUE, resulting-properties={base-type=uint32, sw-bit-representation={bit-position=6, number-of-bits=1}, sw-calibration-access=READ-WRITE, compu-method=CM_DemDTCFunctionalUnit, data-constr=uint32}, symbol=EvConf3  # DTCFunctionalUnit identifies the corresponding basic vehicle or system function which reports the DTC. Ranges between 0 and the maximum value which fits the number of bits allocated for this information. The width of this bit-field information can vary depending on the configuration.
            ECUM_E_RAM_CHECK_FAILED: symbol=[6]
              mc data instance EvConf1: category=STRUCTURE
                mc data instance DemUdsDTC: category=VALUE, resulting-properties={base-type=uint32, sw-bit-representation={bit-position=0, number-of-bits=24}, sw-calibration-access=READ-WRITE, compu-method=CM_DemUdsDTC, data-constr=uint32}, symbol=EvConf1  # UDS DTC value of the event (special case DTC 0: means DTC off; it is not allowed to have the same DTC value for more than one event). Valid range of DTC calibration is within the configured DTC group including value 0 to disable the DTC. If re-calibration is performed during Dcm service request processing, the Dem may return still with the DTC, although the DTC is switched off already until a request for a different DTC. For service 0x19, if the DTC is identified by the algorithm the value of the DTC will be returned. In case calibration occurs with DTC off and the service is called again, the DTC being identified by the algorithm, the DTC returned by the service is DEM_NO_DTC. Range is 0..16777214, displayable on 24 bits.
                mc data instance DemDTCSeverity: category=VALUE, resulting-properties={base-type=uint32, sw-bit-representation={bit-position=26, number-of-bits=2}, sw-calibration-access=READ-WRITE, compu-method=CM_DemDTCSeverity, data-constr=uint32}, symbol=EvConf1  # Internal representation: '0' == 'DEM_DTC_SEV_NO_SEVERITY', '1' == 'DEM_DTC_SEV_MAINTENANCE_ONLY', '2' == 'DEM_DTC_SEV_CHECK_AT_NEXT_HALT', '3' == 'DEM_DTC_SEV_IMMEDIATELY'.
              mc data instance EvConf2: category=STRUCTURE
                mc data instance FFClassIdx: category=VALUE, resulting-properties={base-type=uint32, sw-bit-representation={bit-position=1, number-of-bits=1}, sw-calibration-access=READ-WRITE, compu-method=CM_FFClassIdx, data-constr=uint32}, symbol=EvConf2  # Index of used Freeze Frame class. Range is 0..16383 displayable on 14 bits (maximum assignable bits). Note: Freeze frames of events with 'DemEventKind' set to 'DEM_EVENT_KIND_SEV' must not be changed via calibration.
                mc data instance EventClassIndex: category=VALUE, resulting-properties={base-type=uint32, sw-bit-representation={bit-position=9, number-of-bits=2}, sw-calibration-access=READ-WRITE, compu-method=CM_EventClassIndex, data-constr=uint32}, symbol=EvConf2  # Index of Event Class. Ranges from 0 to whichever value is greater between DemMaxNumberEventClasses and the number of different EventClasses. DemMaxNumberEventClasses can be configured to a maximum value of 2048. Notes for events belonging to a MIL group: - If the MIL indicator is removed through calibration, the event is no longer considered as member of the MIL group. - If the change of the event class no longer ensures the consistency of 'DemOperationCycleRef', 'DemEventFailureCycleRef', 'DemEventFailureCycleCounterThreshold' or MIL indicator's 'DemIndicatorFailureCycleRef' and 'DemIndicatorFailureCycleCounterThreshold', between the MIL group events, the MIL counters and the confirmation counters will be out of sync. This could lead to undefined behavior during run-time. - Calibration of the MIL group event to a class with 'DemEventFailureCycleCounterThreshold' equal to 1 is not allowed. Note that it is not recommended to calibrate the EventClassIndex for events with 'DemEventKind' set to 'DEM_EVENT_KIND_SEV', since this could cause violations of configuration constraints with respect to indicators, aging and MultiEventTriggering.
              mc data instance EvConf3: category=STRUCTURE
                mc data instance DemDTCFunctionalUnit: category=VALUE, resulting-properties={base-type=uint32, sw-bit-representation={bit-position=6, number-of-bits=1}, sw-calibration-access=READ-WRITE, compu-method=CM_DemDTCFunctionalUnit, data-constr=uint32}, symbol=EvConf3  # DTCFunctionalUnit identifies the corresponding basic vehicle or system function which reports the DTC. Ranges between 0 and the maximum value which fits the number of bits allocated for this information. The width of this bit-field information can vary depending on the configuration.
            MCU_E_CLOCK_FAILURE: symbol=[7]
              mc data instance EvConf1: category=STRUCTURE
                mc data instance DemUdsDTC: category=VALUE, resulting-properties={base-type=uint32, sw-bit-representation={bit-position=0, number-of-bits=24}, sw-calibration-access=READ-WRITE, compu-method=CM_DemUdsDTC, data-constr=uint32}, symbol=EvConf1  # UDS DTC value of the event (special case DTC 0: means DTC off; it is not allowed to have the same DTC value for more than one event). Valid range of DTC calibration is within the configured DTC group including value 0 to disable the DTC. If re-calibration is performed during Dcm service request processing, the Dem may return still with the DTC, although the DTC is switched off already until a request for a different DTC. For service 0x19, if the DTC is identified by the algorithm the value of the DTC will be returned. In case calibration occurs with DTC off and the service is called again, the DTC being identified by the algorithm, the DTC returned by the service is DEM_NO_DTC. Range is 0..16777214, displayable on 24 bits.
                mc data instance DemDTCSeverity: category=VALUE, resulting-properties={base-type=uint32, sw-bit-representation={bit-position=26, number-of-bits=2}, sw-calibration-access=READ-WRITE, compu-method=CM_DemDTCSeverity, data-constr=uint32}, symbol=EvConf1  # Internal representation: '0' == 'DEM_DTC_SEV_NO_SEVERITY', '1' == 'DEM_DTC_SEV_MAINTENANCE_ONLY', '2' == 'DEM_DTC_SEV_CHECK_AT_NEXT_HALT', '3' == 'DEM_DTC_SEV_IMMEDIATELY'.
              mc data instance EvConf2: category=STRUCTURE
                mc data instance FFClassIdx: category=VALUE, resulting-properties={base-type=uint32, sw-bit-representation={bit-position=1, number-of-bits=1}, sw-calibration-access=READ-WRITE, compu-method=CM_FFClassIdx, data-constr=uint32}, symbol=EvConf2  # Index of used Freeze Frame class. Range is 0..16383 displayable on 14 bits (maximum assignable bits). Note: Freeze frames of events with 'DemEventKind' set to 'DEM_EVENT_KIND_SEV' must not be changed via calibration.
                mc data instance EventClassIndex: category=VALUE, resulting-properties={base-type=uint32, sw-bit-representation={bit-position=9, number-of-bits=2}, sw-calibration-access=READ-WRITE, compu-method=CM_EventClassIndex, data-constr=uint32}, symbol=EvConf2  # Index of Event Class. Ranges from 0 to whichever value is greater between DemMaxNumberEventClasses and the number of different EventClasses. DemMaxNumberEventClasses can be configured to a maximum value of 2048. Notes for events belonging to a MIL group: - If the MIL indicator is removed through calibration, the event is no longer considered as member of the MIL group. - If the change of the event class no longer ensures the consistency of 'DemOperationCycleRef', 'DemEventFailureCycleRef', 'DemEventFailureCycleCounterThreshold' or MIL indicator's 'DemIndicatorFailureCycleRef' and 'DemIndicatorFailureCycleCounterThreshold', between the MIL group events, the MIL counters and the confirmation counters will be out of sync. This could lead to undefined behavior during run-time. - Calibration of the MIL group event to a class with 'DemEventFailureCycleCounterThreshold' equal to 1 is not allowed. Note that it is not recommended to calibrate the EventClassIndex for events with 'DemEventKind' set to 'DEM_EVENT_KIND_SEV', since this could cause violations of configuration constraints with respect to indicators, aging and MultiEventTriggering.
              mc data instance EvConf3: category=STRUCTURE
                mc data instance DemDTCFunctionalUnit: category=VALUE, resulting-properties={base-type=uint32, sw-bit-representation={bit-position=6, number-of-bits=1}, sw-calibration-access=READ-WRITE, compu-method=CM_DemDTCFunctionalUnit, data-constr=uint32}, symbol=EvConf3  # DTCFunctionalUnit identifies the corresponding basic vehicle or system function which reports the DTC. Ranges between 0 and the maximum value which fits the number of bits allocated for this information. The width of this bit-field information can vary depending on the configuration.
            WDGM_E_MF_TIMINGVIOLATION: symbol=[8]
              mc data instance EvConf1: category=STRUCTURE
                mc data instance DemUdsDTC: category=VALUE, resulting-properties={base-type=uint32, sw-bit-representation={bit-position=0, number-of-bits=24}, sw-calibration-access=READ-WRITE, compu-method=CM_DemUdsDTC, data-constr=uint32}, symbol=EvConf1  # UDS DTC value of the event (special case DTC 0: means DTC off; it is not allowed to have the same DTC value for more than one event). Valid range of DTC calibration is within the configured DTC group including value 0 to disable the DTC. If re-calibration is performed during Dcm service request processing, the Dem may return still with the DTC, although the DTC is switched off already until a request for a different DTC. For service 0x19, if the DTC is identified by the algorithm the value of the DTC will be returned. In case calibration occurs with DTC off and the service is called again, the DTC being identified by the algorithm, the DTC returned by the service is DEM_NO_DTC. Range is 0..16777214, displayable on 24 bits.
                mc data instance DemDTCSeverity: category=VALUE, resulting-properties={base-type=uint32, sw-bit-representation={bit-position=26, number-of-bits=2}, sw-calibration-access=READ-WRITE, compu-method=CM_DemDTCSeverity, data-constr=uint32}, symbol=EvConf1  # Internal representation: '0' == 'DEM_DTC_SEV_NO_SEVERITY', '1' == 'DEM_DTC_SEV_MAINTENANCE_ONLY', '2' == 'DEM_DTC_SEV_CHECK_AT_NEXT_HALT', '3' == 'DEM_DTC_SEV_IMMEDIATELY'.
              mc data instance EvConf2: category=STRUCTURE
                mc data instance FFClassIdx: category=VALUE, resulting-properties={base-type=uint32, sw-bit-representation={bit-position=1, number-of-bits=1}, sw-calibration-access=READ-WRITE, compu-method=CM_FFClassIdx, data-constr=uint32}, symbol=EvConf2  # Index of used Freeze Frame class. Range is 0..16383 displayable on 14 bits (maximum assignable bits). Note: Freeze frames of events with 'DemEventKind' set to 'DEM_EVENT_KIND_SEV' must not be changed via calibration.
                mc data instance EventClassIndex: category=VALUE, resulting-properties={base-type=uint32, sw-bit-representation={bit-position=9, number-of-bits=2}, sw-calibration-access=READ-WRITE, compu-method=CM_EventClassIndex, data-constr=uint32}, symbol=EvConf2  # Index of Event Class. Ranges from 0 to whichever value is greater between DemMaxNumberEventClasses and the number of different EventClasses. DemMaxNumberEventClasses can be configured to a maximum value of 2048. Notes for events belonging to a MIL group: - If the MIL indicator is removed through calibration, the event is no longer considered as member of the MIL group. - If the change of the event class no longer ensures the consistency of 'DemOperationCycleRef', 'DemEventFailureCycleRef', 'DemEventFailureCycleCounterThreshold' or MIL indicator's 'DemIndicatorFailureCycleRef' and 'DemIndicatorFailureCycleCounterThreshold', between the MIL group events, the MIL counters and the confirmation counters will be out of sync. This could lead to undefined behavior during run-time. - Calibration of the MIL group event to a class with 'DemEventFailureCycleCounterThreshold' equal to 1 is not allowed. Note that it is not recommended to calibrate the EventClassIndex for events with 'DemEventKind' set to 'DEM_EVENT_KIND_SEV', since this could cause violations of configuration constraints with respect to indicators, aging and MultiEventTriggering.
              mc data instance EvConf3: category=STRUCTURE
                mc data instance DemDTCFunctionalUnit: category=VALUE, resulting-properties={base-type=uint32, sw-bit-representation={bit-position=6, number-of-bits=1}, sw-calibration-access=READ-WRITE, compu-method=CM_DemDTCFunctionalUnit, data-constr=uint32}, symbol=EvConf3  # DTCFunctionalUnit identifies the corresponding basic vehicle or system function which reports the DTC. Ranges between 0 and the maximum value which fits the number of bits allocated for this information. The width of this bit-field information can vary depending on the configuration.
            DTC_0x000002_Event: symbol=[9]
              mc data instance EvConf1: category=STRUCTURE
                mc data instance DemUdsDTC: category=VALUE, resulting-properties={base-type=uint32, sw-bit-representation={bit-position=0, number-of-bits=24}, sw-calibration-access=READ-WRITE, compu-method=CM_DemUdsDTC, data-constr=uint32}, symbol=EvConf1  # UDS DTC value of the event (special case DTC 0: means DTC off; it is not allowed to have the same DTC value for more than one event). Valid range of DTC calibration is within the configured DTC group including value 0 to disable the DTC. If re-calibration is performed during Dcm service request processing, the Dem may return still with the DTC, although the DTC is switched off already until a request for a different DTC. For service 0x19, if the DTC is identified by the algorithm the value of the DTC will be returned. In case calibration occurs with DTC off and the service is called again, the DTC being identified by the algorithm, the DTC returned by the service is DEM_NO_DTC. Range is 0..16777214, displayable on 24 bits.
                mc data instance DemDTCSeverity: category=VALUE, resulting-properties={base-type=uint32, sw-bit-representation={bit-position=26, number-of-bits=2}, sw-calibration-access=READ-WRITE, compu-method=CM_DemDTCSeverity, data-constr=uint32}, symbol=EvConf1  # Internal representation: '0' == 'DEM_DTC_SEV_NO_SEVERITY', '1' == 'DEM_DTC_SEV_MAINTENANCE_ONLY', '2' == 'DEM_DTC_SEV_CHECK_AT_NEXT_HALT', '3' == 'DEM_DTC_SEV_IMMEDIATELY'.
              mc data instance EvConf2: category=STRUCTURE
                mc data instance FFClassIdx: category=VALUE, resulting-properties={base-type=uint32, sw-bit-representation={bit-position=1, number-of-bits=1}, sw-calibration-access=READ-WRITE, compu-method=CM_FFClassIdx, data-constr=uint32}, symbol=EvConf2  # Index of used Freeze Frame class. Range is 0..16383 displayable on 14 bits (maximum assignable bits). Note: Freeze frames of events with 'DemEventKind' set to 'DEM_EVENT_KIND_SEV' must not be changed via calibration.
                mc data instance EventClassIndex: category=VALUE, resulting-properties={base-type=uint32, sw-bit-representation={bit-position=9, number-of-bits=2}, sw-calibration-access=READ-WRITE, compu-method=CM_EventClassIndex, data-constr=uint32}, symbol=EvConf2  # Index of Event Class. Ranges from 0 to whichever value is greater between DemMaxNumberEventClasses and the number of different EventClasses. DemMaxNumberEventClasses can be configured to a maximum value of 2048. Notes for events belonging to a MIL group: - If the MIL indicator is removed through calibration, the event is no longer considered as member of the MIL group. - If the change of the event class no longer ensures the consistency of 'DemOperationCycleRef', 'DemEventFailureCycleRef', 'DemEventFailureCycleCounterThreshold' or MIL indicator's 'DemIndicatorFailureCycleRef' and 'DemIndicatorFailureCycleCounterThreshold', between the MIL group events, the MIL counters and the confirmation counters will be out of sync. This could lead to undefined behavior during run-time. - Calibration of the MIL group event to a class with 'DemEventFailureCycleCounterThreshold' equal to 1 is not allowed. Note that it is not recommended to calibrate the EventClassIndex for events with 'DemEventKind' set to 'DEM_EVENT_KIND_SEV', since this could cause violations of configuration constraints with respect to indicators, aging and MultiEventTriggering.
              mc data instance EvConf3: category=STRUCTURE
                mc data instance DemDTCFunctionalUnit: category=VALUE, resulting-properties={base-type=uint32, sw-bit-representation={bit-position=6, number-of-bits=1}, sw-calibration-access=READ-WRITE, compu-method=CM_DemDTCFunctionalUnit, data-constr=uint32}, symbol=EvConf3  # DTCFunctionalUnit identifies the corresponding basic vehicle or system function which reports the DTC. Ranges between 0 and the maximum value which fits the number of bits allocated for this information. The width of this bit-field information can vary depending on the configuration.
            USER_DEFINE_MEMORY_Event: symbol=[10]
              mc data instance EvConf1: category=STRUCTURE
                mc data instance DemUdsDTC: category=VALUE, resulting-properties={base-type=uint32, sw-bit-representation={bit-position=0, number-of-bits=24}, sw-calibration-access=READ-WRITE, compu-method=CM_DemUdsDTC, data-constr=uint32}, symbol=EvConf1  # UDS DTC value of the event (special case DTC 0: means DTC off; it is not allowed to have the same DTC value for more than one event). Valid range of DTC calibration is within the configured DTC group including value 0 to disable the DTC. If re-calibration is performed during Dcm service request processing, the Dem may return still with the DTC, although the DTC is switched off already until a request for a different DTC. For service 0x19, if the DTC is identified by the algorithm the value of the DTC will be returned. In case calibration occurs with DTC off and the service is called again, the DTC being identified by the algorithm, the DTC returned by the service is DEM_NO_DTC. Range is 0..16777214, displayable on 24 bits.
                mc data instance DemDTCSeverity: category=VALUE, resulting-properties={base-type=uint32, sw-bit-representation={bit-position=26, number-of-bits=2}, sw-calibration-access=READ-WRITE, compu-method=CM_DemDTCSeverity, data-constr=uint32}, symbol=EvConf1  # Internal representation: '0' == 'DEM_DTC_SEV_NO_SEVERITY', '1' == 'DEM_DTC_SEV_MAINTENANCE_ONLY', '2' == 'DEM_DTC_SEV_CHECK_AT_NEXT_HALT', '3' == 'DEM_DTC_SEV_IMMEDIATELY'.
              mc data instance EvConf2: category=STRUCTURE
                mc data instance FFClassIdx: category=VALUE, resulting-properties={base-type=uint32, sw-bit-representation={bit-position=1, number-of-bits=1}, sw-calibration-access=READ-WRITE, compu-method=CM_FFClassIdx, data-constr=uint32}, symbol=EvConf2  # Index of used Freeze Frame class. Range is 0..16383 displayable on 14 bits (maximum assignable bits). Note: Freeze frames of events with 'DemEventKind' set to 'DEM_EVENT_KIND_SEV' must not be changed via calibration.
                mc data instance EventClassIndex: category=VALUE, resulting-properties={base-type=uint32, sw-bit-representation={bit-position=9, number-of-bits=2}, sw-calibration-access=READ-WRITE, compu-method=CM_EventClassIndex, data-constr=uint32}, symbol=EvConf2  # Index of Event Class. Ranges from 0 to whichever value is greater between DemMaxNumberEventClasses and the number of different EventClasses. DemMaxNumberEventClasses can be configured to a maximum value of 2048. Notes for events belonging to a MIL group: - If the MIL indicator is removed through calibration, the event is no longer considered as member of the MIL group. - If the change of the event class no longer ensures the consistency of 'DemOperationCycleRef', 'DemEventFailureCycleRef', 'DemEventFailureCycleCounterThreshold' or MIL indicator's 'DemIndicatorFailureCycleRef' and 'DemIndicatorFailureCycleCounterThreshold', between the MIL group events, the MIL counters and the confirmation counters will be out of sync. This could lead to undefined behavior during run-time. - Calibration of the MIL group event to a class with 'DemEventFailureCycleCounterThreshold' equal to 1 is not allowed. Note that it is not recommended to calibrate the EventClassIndex for events with 'DemEventKind' set to 'DEM_EVENT_KIND_SEV', since this could cause violations of configuration constraints with respect to indicators, aging and MultiEventTriggering.
              mc data instance EvConf3: category=STRUCTURE
                mc data instance DemDTCFunctionalUnit: category=VALUE, resulting-properties={base-type=uint32, sw-bit-representation={bit-position=6, number-of-bits=1}, sw-calibration-access=READ-WRITE, compu-method=CM_DemDTCFunctionalUnit, data-constr=uint32}, symbol=EvConf3  # DTCFunctionalUnit identifies the corresponding basic vehicle or system function which reports the DTC. Ranges between 0 and the maximum value which fits the number of bits allocated for this information. The width of this bit-field information can vary depending on the configuration.
            MCU_E_TIMEOUT_FAILURE: symbol=[11]
              mc data instance EvConf1: category=STRUCTURE
                mc data instance DemUdsDTC: category=VALUE, resulting-properties={base-type=uint32, sw-bit-representation={bit-position=0, number-of-bits=24}, sw-calibration-access=READ-WRITE, compu-method=CM_DemUdsDTC, data-constr=uint32}, symbol=EvConf1  # UDS DTC value of the event (special case DTC 0: means DTC off; it is not allowed to have the same DTC value for more than one event). Valid range of DTC calibration is within the configured DTC group including value 0 to disable the DTC. If re-calibration is performed during Dcm service request processing, the Dem may return still with the DTC, although the DTC is switched off already until a request for a different DTC. For service 0x19, if the DTC is identified by the algorithm the value of the DTC will be returned. In case calibration occurs with DTC off and the service is called again, the DTC being identified by the algorithm, the DTC returned by the service is DEM_NO_DTC. Range is 0..16777214, displayable on 24 bits.
                mc data instance DemDTCSeverity: category=VALUE, resulting-properties={base-type=uint32, sw-bit-representation={bit-position=26, number-of-bits=2}, sw-calibration-access=READ-WRITE, compu-method=CM_DemDTCSeverity, data-constr=uint32}, symbol=EvConf1  # Internal representation: '0' == 'DEM_DTC_SEV_NO_SEVERITY', '1' == 'DEM_DTC_SEV_MAINTENANCE_ONLY', '2' == 'DEM_DTC_SEV_CHECK_AT_NEXT_HALT', '3' == 'DEM_DTC_SEV_IMMEDIATELY'.
              mc data instance EvConf2: category=STRUCTURE
                mc data instance FFClassIdx: category=VALUE, resulting-properties={base-type=uint32, sw-bit-representation={bit-position=1, number-of-bits=1}, sw-calibration-access=READ-WRITE, compu-method=CM_FFClassIdx, data-constr=uint32}, symbol=EvConf2  # Index of used Freeze Frame class. Range is 0..16383 displayable on 14 bits (maximum assignable bits). Note: Freeze frames of events with 'DemEventKind' set to 'DEM_EVENT_KIND_SEV' must not be changed via calibration.
                mc data instance EventClassIndex: category=VALUE, resulting-properties={base-type=uint32, sw-bit-representation={bit-position=9, number-of-bits=2}, sw-calibration-access=READ-WRITE, compu-method=CM_EventClassIndex, data-constr=uint32}, symbol=EvConf2  # Index of Event Class. Ranges from 0 to whichever value is greater between DemMaxNumberEventClasses and the number of different EventClasses. DemMaxNumberEventClasses can be configured to a maximum value of 2048. Notes for events belonging to a MIL group: - If the MIL indicator is removed through calibration, the event is no longer considered as member of the MIL group. - If the change of the event class no longer ensures the consistency of 'DemOperationCycleRef', 'DemEventFailureCycleRef', 'DemEventFailureCycleCounterThreshold' or MIL indicator's 'DemIndicatorFailureCycleRef' and 'DemIndicatorFailureCycleCounterThreshold', between the MIL group events, the MIL counters and the confirmation counters will be out of sync. This could lead to undefined behavior during run-time. - Calibration of the MIL group event to a class with 'DemEventFailureCycleCounterThreshold' equal to 1 is not allowed. Note that it is not recommended to calibrate the EventClassIndex for events with 'DemEventKind' set to 'DEM_EVENT_KIND_SEV', since this could cause violations of configuration constraints with respect to indicators, aging and MultiEventTriggering.
              mc data instance EvConf3: category=STRUCTURE
                mc data instance DemDTCFunctionalUnit: category=VALUE, resulting-properties={base-type=uint32, sw-bit-representation={bit-position=6, number-of-bits=1}, sw-calibration-access=READ-WRITE, compu-method=CM_DemDTCFunctionalUnit, data-constr=uint32}, symbol=EvConf3  # DTCFunctionalUnit identifies the corresponding basic vehicle or system function which reports the DTC. Ranges between 0 and the maximum value which fits the number of bits allocated for this information. The width of this bit-field information can vary depending on the configuration.
            MCU_E_INVALIDFXOSC_CONFIG: symbol=[12]
              mc data instance EvConf1: category=STRUCTURE
                mc data instance DemUdsDTC: category=VALUE, resulting-properties={base-type=uint32, sw-bit-representation={bit-position=0, number-of-bits=24}, sw-calibration-access=READ-WRITE, compu-method=CM_DemUdsDTC, data-constr=uint32}, symbol=EvConf1  # UDS DTC value of the event (special case DTC 0: means DTC off; it is not allowed to have the same DTC value for more than one event). Valid range of DTC calibration is within the configured DTC group including value 0 to disable the DTC. If re-calibration is performed during Dcm service request processing, the Dem may return still with the DTC, although the DTC is switched off already until a request for a different DTC. For service 0x19, if the DTC is identified by the algorithm the value of the DTC will be returned. In case calibration occurs with DTC off and the service is called again, the DTC being identified by the algorithm, the DTC returned by the service is DEM_NO_DTC. Range is 0..16777214, displayable on 24 bits.
                mc data instance DemDTCSeverity: category=VALUE, resulting-properties={base-type=uint32, sw-bit-representation={bit-position=26, number-of-bits=2}, sw-calibration-access=READ-WRITE, compu-method=CM_DemDTCSeverity, data-constr=uint32}, symbol=EvConf1  # Internal representation: '0' == 'DEM_DTC_SEV_NO_SEVERITY', '1' == 'DEM_DTC_SEV_MAINTENANCE_ONLY', '2' == 'DEM_DTC_SEV_CHECK_AT_NEXT_HALT', '3' == 'DEM_DTC_SEV_IMMEDIATELY'.
              mc data instance EvConf2: category=STRUCTURE
                mc data instance FFClassIdx: category=VALUE, resulting-properties={base-type=uint32, sw-bit-representation={bit-position=1, number-of-bits=1}, sw-calibration-access=READ-WRITE, compu-method=CM_FFClassIdx, data-constr=uint32}, symbol=EvConf2  # Index of used Freeze Frame class. Range is 0..16383 displayable on 14 bits (maximum assignable bits). Note: Freeze frames of events with 'DemEventKind' set to 'DEM_EVENT_KIND_SEV' must not be changed via calibration.
                mc data instance EventClassIndex: category=VALUE, resulting-properties={base-type=uint32, sw-bit-representation={bit-position=9, number-of-bits=2}, sw-calibration-access=READ-WRITE, compu-method=CM_EventClassIndex, data-constr=uint32}, symbol=EvConf2  # Index of Event Class. Ranges from 0 to whichever value is greater between DemMaxNumberEventClasses and the number of different EventClasses. DemMaxNumberEventClasses can be configured to a maximum value of 2048. Notes for events belonging to a MIL group: - If the MIL indicator is removed through calibration, the event is no longer considered as member of the MIL group. - If the change of the event class no longer ensures the consistency of 'DemOperationCycleRef', 'DemEventFailureCycleRef', 'DemEventFailureCycleCounterThreshold' or MIL indicator's 'DemIndicatorFailureCycleRef' and 'DemIndicatorFailureCycleCounterThreshold', between the MIL group events, the MIL counters and the confirmation counters will be out of sync. This could lead to undefined behavior during run-time. - Calibration of the MIL group event to a class with 'DemEventFailureCycleCounterThreshold' equal to 1 is not allowed. Note that it is not recommended to calibrate the EventClassIndex for events with 'DemEventKind' set to 'DEM_EVENT_KIND_SEV', since this could cause violations of configuration constraints with respect to indicators, aging and MultiEventTriggering.
              mc data instance EvConf3: category=STRUCTURE
                mc data instance DemDTCFunctionalUnit: category=VALUE, resulting-properties={base-type=uint32, sw-bit-representation={bit-position=6, number-of-bits=1}, sw-calibration-access=READ-WRITE, compu-method=CM_DemDTCFunctionalUnit, data-constr=uint32}, symbol=EvConf3  # DTCFunctionalUnit identifies the corresponding basic vehicle or system function which reports the DTC. Ranges between 0 and the maximum value which fits the number of bits allocated for this information. The width of this bit-field information can vary depending on the configuration.
            MCU_E_CLOCKMUXSWITCH_FAILURE: symbol=[13]
              mc data instance EvConf1: category=STRUCTURE
                mc data instance DemUdsDTC: category=VALUE, resulting-properties={base-type=uint32, sw-bit-representation={bit-position=0, number-of-bits=24}, sw-calibration-access=READ-WRITE, compu-method=CM_DemUdsDTC, data-constr=uint32}, symbol=EvConf1  # UDS DTC value of the event (special case DTC 0: means DTC off; it is not allowed to have the same DTC value for more than one event). Valid range of DTC calibration is within the configured DTC group including value 0 to disable the DTC. If re-calibration is performed during Dcm service request processing, the Dem may return still with the DTC, although the DTC is switched off already until a request for a different DTC. For service 0x19, if the DTC is identified by the algorithm the value of the DTC will be returned. In case calibration occurs with DTC off and the service is called again, the DTC being identified by the algorithm, the DTC returned by the service is DEM_NO_DTC. Range is 0..16777214, displayable on 24 bits.
                mc data instance DemDTCSeverity: category=VALUE, resulting-properties={base-type=uint32, sw-bit-representation={bit-position=26, number-of-bits=2}, sw-calibration-access=READ-WRITE, compu-method=CM_DemDTCSeverity, data-constr=uint32}, symbol=EvConf1  # Internal representation: '0' == 'DEM_DTC_SEV_NO_SEVERITY', '1' == 'DEM_DTC_SEV_MAINTENANCE_ONLY', '2' == 'DEM_DTC_SEV_CHECK_AT_NEXT_HALT', '3' == 'DEM_DTC_SEV_IMMEDIATELY'.
              mc data instance EvConf2: category=STRUCTURE
                mc data instance FFClassIdx: category=VALUE, resulting-properties={base-type=uint32, sw-bit-representation={bit-position=1, number-of-bits=1}, sw-calibration-access=READ-WRITE, compu-method=CM_FFClassIdx, data-constr=uint32}, symbol=EvConf2  # Index of used Freeze Frame class. Range is 0..16383 displayable on 14 bits (maximum assignable bits). Note: Freeze frames of events with 'DemEventKind' set to 'DEM_EVENT_KIND_SEV' must not be changed via calibration.
                mc data instance EventClassIndex: category=VALUE, resulting-properties={base-type=uint32, sw-bit-representation={bit-position=9, number-of-bits=2}, sw-calibration-access=READ-WRITE, compu-method=CM_EventClassIndex, data-constr=uint32}, symbol=EvConf2  # Index of Event Class. Ranges from 0 to whichever value is greater between DemMaxNumberEventClasses and the number of different EventClasses. DemMaxNumberEventClasses can be configured to a maximum value of 2048. Notes for events belonging to a MIL group: - If the MIL indicator is removed through calibration, the event is no longer considered as member of the MIL group. - If the change of the event class no longer ensures the consistency of 'DemOperationCycleRef', 'DemEventFailureCycleRef', 'DemEventFailureCycleCounterThreshold' or MIL indicator's 'DemIndicatorFailureCycleRef' and 'DemIndicatorFailureCycleCounterThreshold', between the MIL group events, the MIL counters and the confirmation counters will be out of sync. This could lead to undefined behavior during run-time. - Calibration of the MIL group event to a class with 'DemEventFailureCycleCounterThreshold' equal to 1 is not allowed. Note that it is not recommended to calibrate the EventClassIndex for events with 'DemEventKind' set to 'DEM_EVENT_KIND_SEV', since this could cause violations of configuration constraints with respect to indicators, aging and MultiEventTriggering.
              mc data instance EvConf3: category=STRUCTURE
                mc data instance DemDTCFunctionalUnit: category=VALUE, resulting-properties={base-type=uint32, sw-bit-representation={bit-position=6, number-of-bits=1}, sw-calibration-access=READ-WRITE, compu-method=CM_DemDTCFunctionalUnit, data-constr=uint32}, symbol=EvConf3  # DTCFunctionalUnit identifies the corresponding basic vehicle or system function which reports the DTC. Ranges between 0 and the maximum value which fits the number of bits allocated for this information. The width of this bit-field information can vary depending on the configuration.
            SPI_E_HARDWARE_ERROR: symbol=[14]
              mc data instance EvConf1: category=STRUCTURE
                mc data instance DemUdsDTC: category=VALUE, resulting-properties={base-type=uint32, sw-bit-representation={bit-position=0, number-of-bits=24}, sw-calibration-access=READ-WRITE, compu-method=CM_DemUdsDTC, data-constr=uint32}, symbol=EvConf1  # UDS DTC value of the event (special case DTC 0: means DTC off; it is not allowed to have the same DTC value for more than one event). Valid range of DTC calibration is within the configured DTC group including value 0 to disable the DTC. If re-calibration is performed during Dcm service request processing, the Dem may return still with the DTC, although the DTC is switched off already until a request for a different DTC. For service 0x19, if the DTC is identified by the algorithm the value of the DTC will be returned. In case calibration occurs with DTC off and the service is called again, the DTC being identified by the algorithm, the DTC returned by the service is DEM_NO_DTC. Range is 0..16777214, displayable on 24 bits.
                mc data instance DemDTCSeverity: category=VALUE, resulting-properties={base-type=uint32, sw-bit-representation={bit-position=26, number-of-bits=2}, sw-calibration-access=READ-WRITE, compu-method=CM_DemDTCSeverity, data-constr=uint32}, symbol=EvConf1  # Internal representation: '0' == 'DEM_DTC_SEV_NO_SEVERITY', '1' == 'DEM_DTC_SEV_MAINTENANCE_ONLY', '2' == 'DEM_DTC_SEV_CHECK_AT_NEXT_HALT', '3' == 'DEM_DTC_SEV_IMMEDIATELY'.
              mc data instance EvConf2: category=STRUCTURE
                mc data instance FFClassIdx: category=VALUE, resulting-properties={base-type=uint32, sw-bit-representation={bit-position=1, number-of-bits=1}, sw-calibration-access=READ-WRITE, compu-method=CM_FFClassIdx, data-constr=uint32}, symbol=EvConf2  # Index of used Freeze Frame class. Range is 0..16383 displayable on 14 bits (maximum assignable bits). Note: Freeze frames of events with 'DemEventKind' set to 'DEM_EVENT_KIND_SEV' must not be changed via calibration.
                mc data instance EventClassIndex: category=VALUE, resulting-properties={base-type=uint32, sw-bit-representation={bit-position=9, number-of-bits=2}, sw-calibration-access=READ-WRITE, compu-method=CM_EventClassIndex, data-constr=uint32}, symbol=EvConf2  # Index of Event Class. Ranges from 0 to whichever value is greater between DemMaxNumberEventClasses and the number of different EventClasses. DemMaxNumberEventClasses can be configured to a maximum value of 2048. Notes for events belonging to a MIL group: - If the MIL indicator is removed through calibration, the event is no longer considered as member of the MIL group. - If the change of the event class no longer ensures the consistency of 'DemOperationCycleRef', 'DemEventFailureCycleRef', 'DemEventFailureCycleCounterThreshold' or MIL indicator's 'DemIndicatorFailureCycleRef' and 'DemIndicatorFailureCycleCounterThreshold', between the MIL group events, the MIL counters and the confirmation counters will be out of sync. This could lead to undefined behavior during run-time. - Calibration of the MIL group event to a class with 'DemEventFailureCycleCounterThreshold' equal to 1 is not allowed. Note that it is not recommended to calibrate the EventClassIndex for events with 'DemEventKind' set to 'DEM_EVENT_KIND_SEV', since this could cause violations of configuration constraints with respect to indicators, aging and MultiEventTriggering.
              mc data instance EvConf3: category=STRUCTURE
                mc data instance DemDTCFunctionalUnit: category=VALUE, resulting-properties={base-type=uint32, sw-bit-representation={bit-position=6, number-of-bits=1}, sw-calibration-access=READ-WRITE, compu-method=CM_DemDTCFunctionalUnit, data-constr=uint32}, symbol=EvConf3  # DTCFunctionalUnit identifies the corresponding basic vehicle or system function which reports the DTC. Ranges between 0 and the maximum value which fits the number of bits allocated for this information. The width of this bit-field information can vary depending on the configuration.
            CANSM_E_BUS_OFF_0: symbol=[15]
              mc data instance EvConf1: category=STRUCTURE
                mc data instance DemUdsDTC: category=VALUE, resulting-properties={base-type=uint32, sw-bit-representation={bit-position=0, number-of-bits=24}, sw-calibration-access=READ-WRITE, compu-method=CM_DemUdsDTC, data-constr=uint32}, symbol=EvConf1  # UDS DTC value of the event (special case DTC 0: means DTC off; it is not allowed to have the same DTC value for more than one event). Valid range of DTC calibration is within the configured DTC group including value 0 to disable the DTC. If re-calibration is performed during Dcm service request processing, the Dem may return still with the DTC, although the DTC is switched off already until a request for a different DTC. For service 0x19, if the DTC is identified by the algorithm the value of the DTC will be returned. In case calibration occurs with DTC off and the service is called again, the DTC being identified by the algorithm, the DTC returned by the service is DEM_NO_DTC. Range is 0..16777214, displayable on 24 bits.
                mc data instance DemDTCSeverity: category=VALUE, resulting-properties={base-type=uint32, sw-bit-representation={bit-position=26, number-of-bits=2}, sw-calibration-access=READ-WRITE, compu-method=CM_DemDTCSeverity, data-constr=uint32}, symbol=EvConf1  # Internal representation: '0' == 'DEM_DTC_SEV_NO_SEVERITY', '1' == 'DEM_DTC_SEV_MAINTENANCE_ONLY', '2' == 'DEM_DTC_SEV_CHECK_AT_NEXT_HALT', '3' == 'DEM_DTC_SEV_IMMEDIATELY'.
              mc data instance EvConf2: category=STRUCTURE
                mc data instance FFClassIdx: category=VALUE, resulting-properties={base-type=uint32, sw-bit-representation={bit-position=1, number-of-bits=1}, sw-calibration-access=READ-WRITE, compu-method=CM_FFClassIdx, data-constr=uint32}, symbol=EvConf2  # Index of used Freeze Frame class. Range is 0..16383 displayable on 14 bits (maximum assignable bits). Note: Freeze frames of events with 'DemEventKind' set to 'DEM_EVENT_KIND_SEV' must not be changed via calibration.
                mc data instance EventClassIndex: category=VALUE, resulting-properties={base-type=uint32, sw-bit-representation={bit-position=9, number-of-bits=2}, sw-calibration-access=READ-WRITE, compu-method=CM_EventClassIndex, data-constr=uint32}, symbol=EvConf2  # Index of Event Class. Ranges from 0 to whichever value is greater between DemMaxNumberEventClasses and the number of different EventClasses. DemMaxNumberEventClasses can be configured to a maximum value of 2048. Notes for events belonging to a MIL group: - If the MIL indicator is removed through calibration, the event is no longer considered as member of the MIL group. - If the change of the event class no longer ensures the consistency of 'DemOperationCycleRef', 'DemEventFailureCycleRef', 'DemEventFailureCycleCounterThreshold' or MIL indicator's 'DemIndicatorFailureCycleRef' and 'DemIndicatorFailureCycleCounterThreshold', between the MIL group events, the MIL counters and the confirmation counters will be out of sync. This could lead to undefined behavior during run-time. - Calibration of the MIL group event to a class with 'DemEventFailureCycleCounterThreshold' equal to 1 is not allowed. Note that it is not recommended to calibrate the EventClassIndex for events with 'DemEventKind' set to 'DEM_EVENT_KIND_SEV', since this could cause violations of configuration constraints with respect to indicators, aging and MultiEventTriggering.
              mc data instance EvConf3: category=STRUCTURE
                mc data instance DemDTCFunctionalUnit: category=VALUE, resulting-properties={base-type=uint32, sw-bit-representation={bit-position=6, number-of-bits=1}, sw-calibration-access=READ-WRITE, compu-method=CM_DemDTCFunctionalUnit, data-constr=uint32}, symbol=EvConf3  # DTCFunctionalUnit identifies the corresponding basic vehicle or system function which reports the DTC. Ranges between 0 and the maximum value which fits the number of bits allocated for this information. The width of this bit-field information can vary depending on the configuration.
        DiagnosticFreezeFrameClass_0: category=ARRAY, array-size=1, symbol=Dem_FFSegIdxDiagnosticFreezeFrameClass_0
          mc data instance DemDidClass_ActiveDiagnosticInformation: category=VALUE, resulting-properties={base-type=uint16, sw-calibration-access=READ-WRITE, data-constr=uint16}, symbol=[0]  # Index of DID. Range is 0..65534. Value 65535 (0xFFFF) is used for internal processing, not allowed for calibration. Note: The DIDs contained in freeze frames of events with 'DemEventKind' set to 'DEM_EVENT_KIND_SEV' must not be changed via calibration.
        Dem_DebounceCounterClassIdx: category=ARRAY, array-size=4
          4 x mc data instance, all with category=VALUE, resulting-properties={base-type=uint8, sw-bit-representation={bit-position=0, number-of-bits=7}, sw-calibration-access=READ-WRITE, compu {mask 0b01111111: 0b00000000..0b01111111}, range raw 0..1}:
            DTC_0x000001_Event: symbol=[0]  # Debounce counter based class index must be in range of 0 to 1.0. Depending on configuration, a maximum value of 32767, displayable on 15 bits can be referenced.
            DTC_0x000002_Event: symbol=[1]  # Debounce counter based class index must be in range of 0 to 1.0. Depending on configuration, a maximum value of 32767, displayable on 15 bits can be referenced.
            USER_DEFINE_MEMORY_Event: symbol=[2]  # Debounce counter based class index must be in range of 0 to 1.0. Depending on configuration, a maximum value of 32767, displayable on 15 bits can be referenced.
            CANSM_E_BUS_OFF_0: symbol=[3]  # Debounce counter based class index must be in range of 0 to 1.0. Depending on configuration, a maximum value of 32767, displayable on 15 bits can be referenced.
        Dem_DebounceCounterClass: category=ARRAY, array-size=2
          mc data instance DemDebounceCounterBasedClass_0: category=STRUCTURE, symbol=[0]
            8 x mc data instance, all with category=VALUE:
              DemDebounceCounterDecrementStepSize: resulting-properties={base-type=uint16, sw-calibration-access=READ-WRITE, data-constr=uint16}, symbol=CountDecStepSize  # Defines the step size for decrementing the internal fault detection counter (PREPASSED). Range is 1..32768. Value 0 is invalid.
              DemDebounceCounterIncrementStepSize: resulting-properties={base-type=uint16, sw-calibration-access=READ-WRITE, data-constr=uint16}, symbol=CountIncStepSize  # Defines the step size for incrementing the internal fault detection counter (PREFAILED). Range is 1..32767. Value 0 is invalid.
              DemDebounceCounterPassedThreshold: resulting-properties={base-type=sint16, sw-calibration-access=READ-WRITE, data-constr=sint16}, symbol=CounterPassedThreshold  # Defines the value of the internal fault detection counter, which indicates the passed status. Range is -32768..-1. Value 0 is invalid.
              DemDebounceCounterFailedThreshold: resulting-properties={base-type=sint16, sw-calibration-access=READ-WRITE, data-constr=sint16}, symbol=CounterFailedThreshold  # Defines the value of the internal fault detection counter, which indicates the failed status. Range is 1..32767. Value 0 is invalid.
              DemDebounceCounterJumpDownValue: resulting-properties={base-type=sint16, sw-calibration-access=READ-WRITE, data-constr=sint16}, symbol=JumpDownValue  # Jump-Down value of the internal fault detection counter. Range is -32768..32767.
              DemDebounceCounterJumpUpValue: resulting-properties={base-type=sint16, sw-calibration-access=READ-WRITE, data-constr=sint16}, symbol=JumpUpValue  # Jump-Up value of the internal fault detection counter. Range is -32768..32767.
              DemDebounceCounterJumpDown: resulting-properties={base-type=uint8, sw-calibration-access=READ-WRITE, data-constr=uint8}, symbol=JumpDown  # Switch for the activation of Jump-Down. Range is 0..1. Value 0 means Jump-Down is deactivated. Value 1 means Jump-Down is activated.
              DemDebounceCounterJumpUp: resulting-properties={base-type=uint8, sw-calibration-access=READ-WRITE, data-constr=uint8}, symbol=JumpUp  # Switch for the activation of Jump-Up. Range is 0..1. Value 0 means Jump-Up is deactivated. Value 1 means Jump-Up is activated.
          mc data instance DemDebounceCounterBasedClass_1: category=STRUCTURE, symbol=[1]
            8 x mc data instance, all with category=VALUE:
              DemDebounceCounterDecrementStepSize: resulting-properties={base-type=uint16, sw-calibration-access=READ-WRITE, data-constr=uint16}, symbol=CountDecStepSize  # Defines the step size for decrementing the internal fault detection counter (PREPASSED). Range is 1..32768. Value 0 is invalid.
              DemDebounceCounterIncrementStepSize: resulting-properties={base-type=uint16, sw-calibration-access=READ-WRITE, data-constr=uint16}, symbol=CountIncStepSize  # Defines the step size for incrementing the internal fault detection counter (PREFAILED). Range is 1..32767. Value 0 is invalid.
              DemDebounceCounterPassedThreshold: resulting-properties={base-type=sint16, sw-calibration-access=READ-WRITE, data-constr=sint16}, symbol=CounterPassedThreshold  # Defines the value of the internal fault detection counter, which indicates the passed status. Range is -32768..-1. Value 0 is invalid.
              DemDebounceCounterFailedThreshold: resulting-properties={base-type=sint16, sw-calibration-access=READ-WRITE, data-constr=sint16}, symbol=CounterFailedThreshold  # Defines the value of the internal fault detection counter, which indicates the failed status. Range is 1..32767. Value 0 is invalid.
              DemDebounceCounterJumpDownValue: resulting-properties={base-type=sint16, sw-calibration-access=READ-WRITE, data-constr=sint16}, symbol=JumpDownValue  # Jump-Down value of the internal fault detection counter. Range is -32768..32767.
              DemDebounceCounterJumpUpValue: resulting-properties={base-type=sint16, sw-calibration-access=READ-WRITE, data-constr=sint16}, symbol=JumpUpValue  # Jump-Up value of the internal fault detection counter. Range is -32768..32767.
              DemDebounceCounterJumpDown: resulting-properties={base-type=uint8, sw-calibration-access=READ-WRITE, data-constr=uint8}, symbol=JumpDown  # Switch for the activation of Jump-Down. Range is 0..1. Value 0 means Jump-Down is deactivated. Value 1 means Jump-Down is activated.
              DemDebounceCounterJumpUp: resulting-properties={base-type=uint8, sw-calibration-access=READ-WRITE, data-constr=uint8}, symbol=JumpUp  # Switch for the activation of Jump-Up. Range is 0..1. Value 0 means Jump-Up is deactivated. Value 1 means Jump-Up is activated.
        Dem_PidClass: category=ARRAY, array-size=2
          mc data instance PID_1: category=STRUCTURE, symbol=[0]
            mc data instance DemPidIdentifier: category=VALUE, resulting-properties={base-type=uint8, sw-calibration-access=READ-WRITE, data-constr=uint8}  # PID Identifier. The PID identifier must be unique. Range is 0..254. Value 255 is used to disable PIDs in calibration context.
          mc data instance PID_2: category=STRUCTURE, symbol=[1]
            mc data instance DemPidIdentifier: category=VALUE, resulting-properties={base-type=uint8, sw-calibration-access=READ-WRITE, data-constr=uint8}  # PID Identifier. The PID identifier must be unique. Range is 0..254. Value 255 is used to disable PIDs in calibration context.
        Dem_OBDConfig: category=ARRAY, array-size=15
          15 x mc data instance, all with category=STRUCTURE:
            DTC_0x000001_Event: symbol=[1]
              mc data instance DemObdDTC: category=VALUE, resulting-properties={base-type=uint16, sw-calibration-access=READ-WRITE, data-constr=uint16}, symbol=Dem_ObdDTC  # OBD DTC value of the current event. If re-calibration is performed for a stored event (OBD to non-OBD), the related OBD freeze frame (if stored), the related permanent event memory entry (if stored), etc. will not be cleared. The event memory entry will remain occupied and these data will then remain in an orphan state and will be inaccessible, belonging to an event that is no longer an OBD event. Such an OBD freeze frame can only be cleared by a subsequent call of Dem_ClearDTC() on the uds dtc of this event, or with a clear on all UDS DTCs, - however, it is recommended to clear the event before re-calibration and avoid this situation. The user shall take care to calibrate a non-OBD event to OBD only if DemEventDestination of the event is set to DEM_DTC_ORIGIN_PRIMARY_MEMORY. If OBD DTC value re-calibration is performed for an event, DemEventOBDReadinessGroup needs to be re-calibrated consistently. Range is 0..65535. Value 0 means 'no OBD DTC assigned'. For events with 'DemEventKind' set to 'DEM_EVENT_KIND_SEV' only value 0 is allowed. It is possible to configure multiple DTCs with identical OBD DTC value. When more than one DemDTCClass has identical OBD DTC, it is recommended to have same DemEventPriority, DemEventOBDReadinessGroup, DemDTCSeverity and DemDTCFunctionalUnit for events referring these DTCs to avoid inconsistencies in the Dem behavior.
            Permanent_DTC: symbol=[2]
              mc data instance DemObdDTC: category=VALUE, resulting-properties={base-type=uint16, sw-calibration-access=READ-WRITE, data-constr=uint16}, symbol=Dem_ObdDTC  # OBD DTC value of the current event. If re-calibration is performed for a stored event (OBD to non-OBD), the related OBD freeze frame (if stored), the related permanent event memory entry (if stored), etc. will not be cleared. The event memory entry will remain occupied and these data will then remain in an orphan state and will be inaccessible, belonging to an event that is no longer an OBD event. Such an OBD freeze frame can only be cleared by a subsequent call of Dem_ClearDTC() on the uds dtc of this event, or with a clear on all UDS DTCs, - however, it is recommended to clear the event before re-calibration and avoid this situation. The user shall take care to calibrate a non-OBD event to OBD only if DemEventDestination of the event is set to DEM_DTC_ORIGIN_PRIMARY_MEMORY. If OBD DTC value re-calibration is performed for an event, DemEventOBDReadinessGroup needs to be re-calibrated consistently. Range is 0..65535. Value 0 means 'no OBD DTC assigned'. For events with 'DemEventKind' set to 'DEM_EVENT_KIND_SEV' only value 0 is allowed. It is possible to configure multiple DTCs with identical OBD DTC value. When more than one DemDTCClass has identical OBD DTC, it is recommended to have same DemEventPriority, DemEventOBDReadinessGroup, DemDTCSeverity and DemDTCFunctionalUnit for events referring these DTCs to avoid inconsistencies in the Dem behavior.
            WDGM_E_MONITORING: symbol=[3]
              mc data instance DemObdDTC: category=VALUE, resulting-properties={base-type=uint16, sw-calibration-access=READ-WRITE, data-constr=uint16}, symbol=Dem_ObdDTC  # OBD DTC value of the current event. If re-calibration is performed for a stored event (OBD to non-OBD), the related OBD freeze frame (if stored), the related permanent event memory entry (if stored), etc. will not be cleared. The event memory entry will remain occupied and these data will then remain in an orphan state and will be inaccessible, belonging to an event that is no longer an OBD event. Such an OBD freeze frame can only be cleared by a subsequent call of Dem_ClearDTC() on the uds dtc of this event, or with a clear on all UDS DTCs, - however, it is recommended to clear the event before re-calibration and avoid this situation. The user shall take care to calibrate a non-OBD event to OBD only if DemEventDestination of the event is set to DEM_DTC_ORIGIN_PRIMARY_MEMORY. If OBD DTC value re-calibration is performed for an event, DemEventOBDReadinessGroup needs to be re-calibrated consistently. Range is 0..65535. Value 0 means 'no OBD DTC assigned'. For events with 'DemEventKind' set to 'DEM_EVENT_KIND_SEV' only value 0 is allowed. It is possible to configure multiple DTCs with identical OBD DTC value. When more than one DemDTCClass has identical OBD DTC, it is recommended to have same DemEventPriority, DemEventOBDReadinessGroup, DemDTCSeverity and DemDTCFunctionalUnit for events referring these DTCs to avoid inconsistencies in the Dem behavior.
            WDGM_E_SET_MODE: symbol=[4]
              mc data instance DemObdDTC: category=VALUE, resulting-properties={base-type=uint16, sw-calibration-access=READ-WRITE, data-constr=uint16}, symbol=Dem_ObdDTC  # OBD DTC value of the current event. If re-calibration is performed for a stored event (OBD to non-OBD), the related OBD freeze frame (if stored), the related permanent event memory entry (if stored), etc. will not be cleared. The event memory entry will remain occupied and these data will then remain in an orphan state and will be inaccessible, belonging to an event that is no longer an OBD event. Such an OBD freeze frame can only be cleared by a subsequent call of Dem_ClearDTC() on the uds dtc of this event, or with a clear on all UDS DTCs, - however, it is recommended to clear the event before re-calibration and avoid this situation. The user shall take care to calibrate a non-OBD event to OBD only if DemEventDestination of the event is set to DEM_DTC_ORIGIN_PRIMARY_MEMORY. If OBD DTC value re-calibration is performed for an event, DemEventOBDReadinessGroup needs to be re-calibrated consistently. Range is 0..65535. Value 0 means 'no OBD DTC assigned'. For events with 'DemEventKind' set to 'DEM_EVENT_KIND_SEV' only value 0 is allowed. It is possible to configure multiple DTCs with identical OBD DTC value. When more than one DemDTCClass has identical OBD DTC, it is recommended to have same DemEventPriority, DemEventOBDReadinessGroup, DemDTCSeverity and DemDTCFunctionalUnit for events referring these DTCs to avoid inconsistencies in the Dem behavior.
            WDGM_E_DATA_CORRUPTION: symbol=[5]
              mc data instance DemObdDTC: category=VALUE, resulting-properties={base-type=uint16, sw-calibration-access=READ-WRITE, data-constr=uint16}, symbol=Dem_ObdDTC  # OBD DTC value of the current event. If re-calibration is performed for a stored event (OBD to non-OBD), the related OBD freeze frame (if stored), the related permanent event memory entry (if stored), etc. will not be cleared. The event memory entry will remain occupied and these data will then remain in an orphan state and will be inaccessible, belonging to an event that is no longer an OBD event. Such an OBD freeze frame can only be cleared by a subsequent call of Dem_ClearDTC() on the uds dtc of this event, or with a clear on all UDS DTCs, - however, it is recommended to clear the event before re-calibration and avoid this situation. The user shall take care to calibrate a non-OBD event to OBD only if DemEventDestination of the event is set to DEM_DTC_ORIGIN_PRIMARY_MEMORY. If OBD DTC value re-calibration is performed for an event, DemEventOBDReadinessGroup needs to be re-calibrated consistently. Range is 0..65535. Value 0 means 'no OBD DTC assigned'. For events with 'DemEventKind' set to 'DEM_EVENT_KIND_SEV' only value 0 is allowed. It is possible to configure multiple DTCs with identical OBD DTC value. When more than one DemDTCClass has identical OBD DTC, it is recommended to have same DemEventPriority, DemEventOBDReadinessGroup, DemDTCSeverity and DemDTCFunctionalUnit for events referring these DTCs to avoid inconsistencies in the Dem behavior.
            ECUM_E_RAM_CHECK_FAILED: symbol=[6]
              mc data instance DemObdDTC: category=VALUE, resulting-properties={base-type=uint16, sw-calibration-access=READ-WRITE, data-constr=uint16}, symbol=Dem_ObdDTC  # OBD DTC value of the current event. If re-calibration is performed for a stored event (OBD to non-OBD), the related OBD freeze frame (if stored), the related permanent event memory entry (if stored), etc. will not be cleared. The event memory entry will remain occupied and these data will then remain in an orphan state and will be inaccessible, belonging to an event that is no longer an OBD event. Such an OBD freeze frame can only be cleared by a subsequent call of Dem_ClearDTC() on the uds dtc of this event, or with a clear on all UDS DTCs, - however, it is recommended to clear the event before re-calibration and avoid this situation. The user shall take care to calibrate a non-OBD event to OBD only if DemEventDestination of the event is set to DEM_DTC_ORIGIN_PRIMARY_MEMORY. If OBD DTC value re-calibration is performed for an event, DemEventOBDReadinessGroup needs to be re-calibrated consistently. Range is 0..65535. Value 0 means 'no OBD DTC assigned'. For events with 'DemEventKind' set to 'DEM_EVENT_KIND_SEV' only value 0 is allowed. It is possible to configure multiple DTCs with identical OBD DTC value. When more than one DemDTCClass has identical OBD DTC, it is recommended to have same DemEventPriority, DemEventOBDReadinessGroup, DemDTCSeverity and DemDTCFunctionalUnit for events referring these DTCs to avoid inconsistencies in the Dem behavior.
            MCU_E_CLOCK_FAILURE: symbol=[7]
              mc data instance DemObdDTC: category=VALUE, resulting-properties={base-type=uint16, sw-calibration-access=READ-WRITE, data-constr=uint16}, symbol=Dem_ObdDTC  # OBD DTC value of the current event. If re-calibration is performed for a stored event (OBD to non-OBD), the related OBD freeze frame (if stored), the related permanent event memory entry (if stored), etc. will not be cleared. The event memory entry will remain occupied and these data will then remain in an orphan state and will be inaccessible, belonging to an event that is no longer an OBD event. Such an OBD freeze frame can only be cleared by a subsequent call of Dem_ClearDTC() on the uds dtc of this event, or with a clear on all UDS DTCs, - however, it is recommended to clear the event before re-calibration and avoid this situation. The user shall take care to calibrate a non-OBD event to OBD only if DemEventDestination of the event is set to DEM_DTC_ORIGIN_PRIMARY_MEMORY. If OBD DTC value re-calibration is performed for an event, DemEventOBDReadinessGroup needs to be re-calibrated consistently. Range is 0..65535. Value 0 means 'no OBD DTC assigned'. For events with 'DemEventKind' set to 'DEM_EVENT_KIND_SEV' only value 0 is allowed. It is possible to configure multiple DTCs with identical OBD DTC value. When more than one DemDTCClass has identical OBD DTC, it is recommended to have same DemEventPriority, DemEventOBDReadinessGroup, DemDTCSeverity and DemDTCFunctionalUnit for events referring these DTCs to avoid inconsistencies in the Dem behavior.
            WDGM_E_MF_TIMINGVIOLATION: symbol=[8]
              mc data instance DemObdDTC: category=VALUE, resulting-properties={base-type=uint16, sw-calibration-access=READ-WRITE, data-constr=uint16}, symbol=Dem_ObdDTC  # OBD DTC value of the current event. If re-calibration is performed for a stored event (OBD to non-OBD), the related OBD freeze frame (if stored), the related permanent event memory entry (if stored), etc. will not be cleared. The event memory entry will remain occupied and these data will then remain in an orphan state and will be inaccessible, belonging to an event that is no longer an OBD event. Such an OBD freeze frame can only be cleared by a subsequent call of Dem_ClearDTC() on the uds dtc of this event, or with a clear on all UDS DTCs, - however, it is recommended to clear the event before re-calibration and avoid this situation. The user shall take care to calibrate a non-OBD event to OBD only if DemEventDestination of the event is set to DEM_DTC_ORIGIN_PRIMARY_MEMORY. If OBD DTC value re-calibration is performed for an event, DemEventOBDReadinessGroup needs to be re-calibrated consistently. Range is 0..65535. Value 0 means 'no OBD DTC assigned'. For events with 'DemEventKind' set to 'DEM_EVENT_KIND_SEV' only value 0 is allowed. It is possible to configure multiple DTCs with identical OBD DTC value. When more than one DemDTCClass has identical OBD DTC, it is recommended to have same DemEventPriority, DemEventOBDReadinessGroup, DemDTCSeverity and DemDTCFunctionalUnit for events referring these DTCs to avoid inconsistencies in the Dem behavior.
            DTC_0x000002_Event: symbol=[9]
              mc data instance DemObdDTC: category=VALUE, resulting-properties={base-type=uint16, sw-calibration-access=READ-WRITE, data-constr=uint16}, symbol=Dem_ObdDTC  # OBD DTC value of the current event. If re-calibration is performed for a stored event (OBD to non-OBD), the related OBD freeze frame (if stored), the related permanent event memory entry (if stored), etc. will not be cleared. The event memory entry will remain occupied and these data will then remain in an orphan state and will be inaccessible, belonging to an event that is no longer an OBD event. Such an OBD freeze frame can only be cleared by a subsequent call of Dem_ClearDTC() on the uds dtc of this event, or with a clear on all UDS DTCs, - however, it is recommended to clear the event before re-calibration and avoid this situation. The user shall take care to calibrate a non-OBD event to OBD only if DemEventDestination of the event is set to DEM_DTC_ORIGIN_PRIMARY_MEMORY. If OBD DTC value re-calibration is performed for an event, DemEventOBDReadinessGroup needs to be re-calibrated consistently. Range is 0..65535. Value 0 means 'no OBD DTC assigned'. For events with 'DemEventKind' set to 'DEM_EVENT_KIND_SEV' only value 0 is allowed. It is possible to configure multiple DTCs with identical OBD DTC value. When more than one DemDTCClass has identical OBD DTC, it is recommended to have same DemEventPriority, DemEventOBDReadinessGroup, DemDTCSeverity and DemDTCFunctionalUnit for events referring these DTCs to avoid inconsistencies in the Dem behavior.
            USER_DEFINE_MEMORY_Event: symbol=[10]
              mc data instance DemObdDTC: category=VALUE, resulting-properties={base-type=uint16, sw-calibration-access=READ-WRITE, data-constr=uint16}, symbol=Dem_ObdDTC  # OBD DTC value of the current event. If re-calibration is performed for a stored event (OBD to non-OBD), the related OBD freeze frame (if stored), the related permanent event memory entry (if stored), etc. will not be cleared. The event memory entry will remain occupied and these data will then remain in an orphan state and will be inaccessible, belonging to an event that is no longer an OBD event. Such an OBD freeze frame can only be cleared by a subsequent call of Dem_ClearDTC() on the uds dtc of this event, or with a clear on all UDS DTCs, - however, it is recommended to clear the event before re-calibration and avoid this situation. The user shall take care to calibrate a non-OBD event to OBD only if DemEventDestination of the event is set to DEM_DTC_ORIGIN_PRIMARY_MEMORY. If OBD DTC value re-calibration is performed for an event, DemEventOBDReadinessGroup needs to be re-calibrated consistently. Range is 0..65535. Value 0 means 'no OBD DTC assigned'. For events with 'DemEventKind' set to 'DEM_EVENT_KIND_SEV' only value 0 is allowed. It is possible to configure multiple DTCs with identical OBD DTC value. When more than one DemDTCClass has identical OBD DTC, it is recommended to have same DemEventPriority, DemEventOBDReadinessGroup, DemDTCSeverity and DemDTCFunctionalUnit for events referring these DTCs to avoid inconsistencies in the Dem behavior.
            MCU_E_TIMEOUT_FAILURE: symbol=[11]
              mc data instance DemObdDTC: category=VALUE, resulting-properties={base-type=uint16, sw-calibration-access=READ-WRITE, data-constr=uint16}, symbol=Dem_ObdDTC  # OBD DTC value of the current event. If re-calibration is performed for a stored event (OBD to non-OBD), the related OBD freeze frame (if stored), the related permanent event memory entry (if stored), etc. will not be cleared. The event memory entry will remain occupied and these data will then remain in an orphan state and will be inaccessible, belonging to an event that is no longer an OBD event. Such an OBD freeze frame can only be cleared by a subsequent call of Dem_ClearDTC() on the uds dtc of this event, or with a clear on all UDS DTCs, - however, it is recommended to clear the event before re-calibration and avoid this situation. The user shall take care to calibrate a non-OBD event to OBD only if DemEventDestination of the event is set to DEM_DTC_ORIGIN_PRIMARY_MEMORY. If OBD DTC value re-calibration is performed for an event, DemEventOBDReadinessGroup needs to be re-calibrated consistently. Range is 0..65535. Value 0 means 'no OBD DTC assigned'. For events with 'DemEventKind' set to 'DEM_EVENT_KIND_SEV' only value 0 is allowed. It is possible to configure multiple DTCs with identical OBD DTC value. When more than one DemDTCClass has identical OBD DTC, it is recommended to have same DemEventPriority, DemEventOBDReadinessGroup, DemDTCSeverity and DemDTCFunctionalUnit for events referring these DTCs to avoid inconsistencies in the Dem behavior.
            MCU_E_INVALIDFXOSC_CONFIG: symbol=[12]
              mc data instance DemObdDTC: category=VALUE, resulting-properties={base-type=uint16, sw-calibration-access=READ-WRITE, data-constr=uint16}, symbol=Dem_ObdDTC  # OBD DTC value of the current event. If re-calibration is performed for a stored event (OBD to non-OBD), the related OBD freeze frame (if stored), the related permanent event memory entry (if stored), etc. will not be cleared. The event memory entry will remain occupied and these data will then remain in an orphan state and will be inaccessible, belonging to an event that is no longer an OBD event. Such an OBD freeze frame can only be cleared by a subsequent call of Dem_ClearDTC() on the uds dtc of this event, or with a clear on all UDS DTCs, - however, it is recommended to clear the event before re-calibration and avoid this situation. The user shall take care to calibrate a non-OBD event to OBD only if DemEventDestination of the event is set to DEM_DTC_ORIGIN_PRIMARY_MEMORY. If OBD DTC value re-calibration is performed for an event, DemEventOBDReadinessGroup needs to be re-calibrated consistently. Range is 0..65535. Value 0 means 'no OBD DTC assigned'. For events with 'DemEventKind' set to 'DEM_EVENT_KIND_SEV' only value 0 is allowed. It is possible to configure multiple DTCs with identical OBD DTC value. When more than one DemDTCClass has identical OBD DTC, it is recommended to have same DemEventPriority, DemEventOBDReadinessGroup, DemDTCSeverity and DemDTCFunctionalUnit for events referring these DTCs to avoid inconsistencies in the Dem behavior.
            MCU_E_CLOCKMUXSWITCH_FAILURE: symbol=[13]
              mc data instance DemObdDTC: category=VALUE, resulting-properties={base-type=uint16, sw-calibration-access=READ-WRITE, data-constr=uint16}, symbol=Dem_ObdDTC  # OBD DTC value of the current event. If re-calibration is performed for a stored event (OBD to non-OBD), the related OBD freeze frame (if stored), the related permanent event memory entry (if stored), etc. will not be cleared. The event memory entry will remain occupied and these data will then remain in an orphan state and will be inaccessible, belonging to an event that is no longer an OBD event. Such an OBD freeze frame can only be cleared by a subsequent call of Dem_ClearDTC() on the uds dtc of this event, or with a clear on all UDS DTCs, - however, it is recommended to clear the event before re-calibration and avoid this situation. The user shall take care to calibrate a non-OBD event to OBD only if DemEventDestination of the event is set to DEM_DTC_ORIGIN_PRIMARY_MEMORY. If OBD DTC value re-calibration is performed for an event, DemEventOBDReadinessGroup needs to be re-calibrated consistently. Range is 0..65535. Value 0 means 'no OBD DTC assigned'. For events with 'DemEventKind' set to 'DEM_EVENT_KIND_SEV' only value 0 is allowed. It is possible to configure multiple DTCs with identical OBD DTC value. When more than one DemDTCClass has identical OBD DTC, it is recommended to have same DemEventPriority, DemEventOBDReadinessGroup, DemDTCSeverity and DemDTCFunctionalUnit for events referring these DTCs to avoid inconsistencies in the Dem behavior.
            SPI_E_HARDWARE_ERROR: symbol=[14]
              mc data instance DemObdDTC: category=VALUE, resulting-properties={base-type=uint16, sw-calibration-access=READ-WRITE, data-constr=uint16}, symbol=Dem_ObdDTC  # OBD DTC value of the current event. If re-calibration is performed for a stored event (OBD to non-OBD), the related OBD freeze frame (if stored), the related permanent event memory entry (if stored), etc. will not be cleared. The event memory entry will remain occupied and these data will then remain in an orphan state and will be inaccessible, belonging to an event that is no longer an OBD event. Such an OBD freeze frame can only be cleared by a subsequent call of Dem_ClearDTC() on the uds dtc of this event, or with a clear on all UDS DTCs, - however, it is recommended to clear the event before re-calibration and avoid this situation. The user shall take care to calibrate a non-OBD event to OBD only if DemEventDestination of the event is set to DEM_DTC_ORIGIN_PRIMARY_MEMORY. If OBD DTC value re-calibration is performed for an event, DemEventOBDReadinessGroup needs to be re-calibrated consistently. Range is 0..65535. Value 0 means 'no OBD DTC assigned'. For events with 'DemEventKind' set to 'DEM_EVENT_KIND_SEV' only value 0 is allowed. It is possible to configure multiple DTCs with identical OBD DTC value. When more than one DemDTCClass has identical OBD DTC, it is recommended to have same DemEventPriority, DemEventOBDReadinessGroup, DemDTCSeverity and DemDTCFunctionalUnit for events referring these DTCs to avoid inconsistencies in the Dem behavior.
            CANSM_E_BUS_OFF_0: symbol=[15]
              mc data instance DemObdDTC: category=VALUE, resulting-properties={base-type=uint16, sw-calibration-access=READ-WRITE, data-constr=uint16}, symbol=Dem_ObdDTC  # OBD DTC value of the current event. If re-calibration is performed for a stored event (OBD to non-OBD), the related OBD freeze frame (if stored), the related permanent event memory entry (if stored), etc. will not be cleared. The event memory entry will remain occupied and these data will then remain in an orphan state and will be inaccessible, belonging to an event that is no longer an OBD event. Such an OBD freeze frame can only be cleared by a subsequent call of Dem_ClearDTC() on the uds dtc of this event, or with a clear on all UDS DTCs, - however, it is recommended to clear the event before re-calibration and avoid this situation. The user shall take care to calibrate a non-OBD event to OBD only if DemEventDestination of the event is set to DEM_DTC_ORIGIN_PRIMARY_MEMORY. If OBD DTC value re-calibration is performed for an event, DemEventOBDReadinessGroup needs to be re-calibrated consistently. Range is 0..65535. Value 0 means 'no OBD DTC assigned'. For events with 'DemEventKind' set to 'DEM_EVENT_KIND_SEV' only value 0 is allowed. It is possible to configure multiple DTCs with identical OBD DTC value. When more than one DemDTCClass has identical OBD DTC, it is recommended to have same DemEventPriority, DemEventOBDReadinessGroup, DemDTCSeverity and DemDTCFunctionalUnit for events referring these DTCs to avoid inconsistencies in the Dem behavior.
        Dem_OBDReadinessGroup: category=ARRAY, array-size=12
          12 x mc data instance, all with category=ARRAY, array-size=1:
            DEM_OBD_RDY_MISF: symbol=[0]
              mc data instance EventInvalid_0: category=VALUE, resulting-properties={base-type=uint16, sw-calibration-access=READ-WRITE, data-constr=uint16}, symbol=[0]  # Readiness groups will have EventInvalid_<GroupIndex> for each entry till the limit indicated by the vendor specific parameter DemMaxNumEventsPerReadinessGroup which can be configured to a maximum value of 40.
            DEM_OBD_RDY_FLSYS: symbol=[1]
              mc data instance EventInvalid_0: category=VALUE, resulting-properties={base-type=uint16, sw-calibration-access=READ-WRITE, data-constr=uint16}, symbol=[0]  # Readiness groups will have EventInvalid_<GroupIndex> for each entry till the limit indicated by the vendor specific parameter DemMaxNumEventsPerReadinessGroup which can be configured to a maximum value of 40.
            DEM_OBD_RDY_CMPRCMPT: symbol=[2]
              mc data instance EventInvalid_0: category=VALUE, resulting-properties={base-type=uint16, sw-calibration-access=READ-WRITE, data-constr=uint16}, symbol=[0]  # Readiness groups will have EventInvalid_<GroupIndex> for each entry till the limit indicated by the vendor specific parameter DemMaxNumEventsPerReadinessGroup which can be configured to a maximum value of 40.
            DEM_OBD_RDY_EGR: symbol=[3]
              mc data instance EventInvalid_0: category=VALUE, resulting-properties={base-type=uint16, sw-calibration-access=READ-WRITE, data-constr=uint16}, symbol=[0]  # Readiness groups will have EventInvalid_<GroupIndex> for each entry till the limit indicated by the vendor specific parameter DemMaxNumEventsPerReadinessGroup which can be configured to a maximum value of 40.
            DEM_OBD_RDY_FLSYS_NONCONT: symbol=[4]
              mc data instance EventInvalid_0: category=VALUE, resulting-properties={base-type=uint16, sw-calibration-access=READ-WRITE, data-constr=uint16}, symbol=[0]  # Readiness groups will have EventInvalid_<GroupIndex> for each entry till the limit indicated by the vendor specific parameter DemMaxNumEventsPerReadinessGroup which can be configured to a maximum value of 40.
            DEM_OBD_RDY_HCCAT: symbol=[5]
              mc data instance EventInvalid_0: category=VALUE, resulting-properties={base-type=uint16, sw-calibration-access=READ-WRITE, data-constr=uint16}, symbol=[0]  # Readiness groups will have EventInvalid_<GroupIndex> for each entry till the limit indicated by the vendor specific parameter DemMaxNumEventsPerReadinessGroup which can be configured to a maximum value of 40.
            DEM_OBD_RDY_NOXCAT: symbol=[6]
              mc data instance EventInvalid_0: category=VALUE, resulting-properties={base-type=uint16, sw-calibration-access=READ-WRITE, data-constr=uint16}, symbol=[0]  # Readiness groups will have EventInvalid_<GroupIndex> for each entry till the limit indicated by the vendor specific parameter DemMaxNumEventsPerReadinessGroup which can be configured to a maximum value of 40.
            UNUSED_1: symbol=[7]
              mc data instance EventInvalid_0: category=VALUE, resulting-properties={base-type=uint16, sw-calibration-access=READ-WRITE, data-constr=uint16}, symbol=[0]  # Readiness groups will have EventInvalid_<GroupIndex> for each entry till the limit indicated by the vendor specific parameter DemMaxNumEventsPerReadinessGroup which can be configured to a maximum value of 40.
            DEM_OBD_RDY_BOOSTPR: symbol=[8]
              mc data instance EventInvalid_0: category=VALUE, resulting-properties={base-type=uint16, sw-calibration-access=READ-WRITE, data-constr=uint16}, symbol=[0]  # Readiness groups will have EventInvalid_<GroupIndex> for each entry till the limit indicated by the vendor specific parameter DemMaxNumEventsPerReadinessGroup which can be configured to a maximum value of 40.
            DEM_OBD_RDY_EGSENS: symbol=[9]
              mc data instance EventInvalid_0: category=VALUE, resulting-properties={base-type=uint16, sw-calibration-access=READ-WRITE, data-constr=uint16}, symbol=[0]  # Readiness groups will have EventInvalid_<GroupIndex> for each entry till the limit indicated by the vendor specific parameter DemMaxNumEventsPerReadinessGroup which can be configured to a maximum value of 40.
            DEM_OBD_RDY_PMFLT: symbol=[10]
              mc data instance EventInvalid_0: category=VALUE, resulting-properties={base-type=uint16, sw-calibration-access=READ-WRITE, data-constr=uint16}, symbol=[0]  # Readiness groups will have EventInvalid_<GroupIndex> for each entry till the limit indicated by the vendor specific parameter DemMaxNumEventsPerReadinessGroup which can be configured to a maximum value of 40.
            UNUSED_2: symbol=[11]
              mc data instance EventInvalid_0: category=VALUE, resulting-properties={base-type=uint16, sw-calibration-access=READ-WRITE, data-constr=uint16}, symbol=[0]  # Readiness groups will have EventInvalid_<GroupIndex> for each entry till the limit indicated by the vendor specific parameter DemMaxNumEventsPerReadinessGroup which can be configured to a maximum value of 40.
        Dem_ObdReadinessForceCompleteMask: category=STRUCTURE
          4 x mc data instance, all with category=VALUE, symbol=Dem_ObdReadinessForceCompleteMask:
            DemOBDEngineType: resulting-properties={base-type=uint8, sw-bit-representation={bit-position=3, number-of-bits=1}, sw-calibration-access=READ-WRITE, compu {mask 0b00001000: 0b00000000..0b00001000}, data-constr=uint8}  # Range is 0..1. Value 0 means OBDEngineType is set to DEM_IGNITION_SPARK and value 1 means OBDEngineType is set to DEM_IGNITION_COMPRESSION.
            DemOBDForceMisfireMonitoringReady: resulting-properties={base-type=uint8, sw-bit-representation={bit-position=4, number-of-bits=1}, sw-calibration-access=READ-WRITE, compu {mask 0b00010000: 0b00000000..0b00010000}, data-constr=uint8}  # Range is 0..1. Value 0 means DemOBDForceMisfireMonitoringReady is set to FALSE and value 1 means it is set to TRUE.
            DemOBDForceFuelSysMonitoringReady: resulting-properties={base-type=uint8, sw-bit-representation={bit-position=5, number-of-bits=1}, sw-calibration-access=READ-WRITE, compu {mask 0b00100000: 0b00000000..0b00100000}, data-constr=uint8}  # Range is 0..1. Value 0 means DemOBDForceFuelSysMonitoringReady is set to FALSE and value 1 means it is set to TRUE.
            DemOBDForceCCMonitoringReady: resulting-properties={base-type=uint8, sw-bit-representation={bit-position=6, number-of-bits=1}, sw-calibration-access=READ-WRITE, compu {mask 0b01000000: 0b00000000..0b00100000}, data-constr=uint8}  # Range is 0..1. Value 0 means DemOBDForceCCMonitoringReady is set to FALSE and value 1 means it is set to TRUE.
        Dem_ObdReadinessPID41ByteB: category=STRUCTURE
          mc data instance DemOBDSetCCMenabled: category=VALUE, resulting-properties={base-type=uint8, sw-bit-representation={bit-position=2, number-of-bits=1}, sw-calibration-access=READ-WRITE, compu {mask 0b00000100: 0b00000000..0b00000100}, data-constr=uint8}, symbol=Dem_ObdReadinessPID41ByteB  # Comprehensive component monitoring enabled (CCM_ENA 1 == enabled, 0 == disabled).
        Dem_ObdCompliancyPID1CByte: category=VALUE, resulting-properties={base-type=uint8, sw-calibration-access=READ-WRITE, data-constr=uint8}  # Configuration value to define the appropriate value to PID$1C "OBD requirements to which vehicle or engine is certified." according to the respective standards, e.g. OBD, OBDII, JOBD etc. Range is 0..255.
        Dem_EventEnabled: category=ARRAY, array-size=2
          15 x mc data instance, all with category=VALUE:
            EventAvailable_1: resulting-properties={base-type=uint8, sw-bit-representation={bit-position=1, number-of-bits=1}, sw-calibration-access=READ-WRITE, compu-method=CM_DemEventEnabled_1, data-constr=uint8}, symbol=[0]  # Availability of event DTC_0x000001_Event (1 means enabled, 0 means disabled). Calibration of this value is only allowed before Dem_PreInit() is called. If the event which provides the OBD freeze frame is disabled the OBD freeze frame will not be updated and no OBD freeze frame will be provided to the Dcm. If an event which is stored in event memory is disabled the event memory entry is not available anymore. The Dem NvM-blocks has to be invalidated after re-calibration is performed (in order to avoid data inconsistency). If the event stored in event memory is also combined, disabling it could lead to an inconsistent UDS DTC status and shall be avoided at any case. For service 0x19, if the DTC referenced by the event ID is identified by the algorithm, the value of the DTC will be returned. In case calibration occurs with 0 for the event ID and the service is called again, the DTC referenced by the disabled event is identified by the algorithm, the DTC returned by the service is DEM_NO_DTC. If re-calibration is performed during Dem processing or without invalidation of outdated Dem NvM-blocks the Dem behavior is undefined (can lead e.g. to segmentation faults in the worst case).
            EventAvailable_2: resulting-properties={base-type=uint8, sw-bit-representation={bit-position=2, number-of-bits=1}, sw-calibration-access=READ-WRITE, compu-method=CM_DemEventEnabled_2, data-constr=uint8}, symbol=[0]  # Availability of event Permanent_DTC (1 means enabled, 0 means disabled). Calibration of this value is only allowed before Dem_PreInit() is called. If the event which provides the OBD freeze frame is disabled the OBD freeze frame will not be updated and no OBD freeze frame will be provided to the Dcm. If an event which is stored in event memory is disabled the event memory entry is not available anymore. The Dem NvM-blocks has to be invalidated after re-calibration is performed (in order to avoid data inconsistency). If the event stored in event memory is also combined, disabling it could lead to an inconsistent UDS DTC status and shall be avoided at any case. For service 0x19, if the DTC referenced by the event ID is identified by the algorithm, the value of the DTC will be returned. In case calibration occurs with 0 for the event ID and the service is called again, the DTC referenced by the disabled event is identified by the algorithm, the DTC returned by the service is DEM_NO_DTC. If re-calibration is performed during Dem processing or without invalidation of outdated Dem NvM-blocks the Dem behavior is undefined (can lead e.g. to segmentation faults in the worst case).
            EventAvailable_3: resulting-properties={base-type=uint8, sw-bit-representation={bit-position=3, number-of-bits=1}, sw-calibration-access=READ-WRITE, compu-method=CM_DemEventEnabled_3, data-constr=uint8}, symbol=[0]  # Availability of event WDGM_E_MONITORING (1 means enabled, 0 means disabled). Calibration of this value is only allowed before Dem_PreInit() is called. If the event which provides the OBD freeze frame is disabled the OBD freeze frame will not be updated and no OBD freeze frame will be provided to the Dcm. If an event which is stored in event memory is disabled the event memory entry is not available anymore. The Dem NvM-blocks has to be invalidated after re-calibration is performed (in order to avoid data inconsistency). If the event stored in event memory is also combined, disabling it could lead to an inconsistent UDS DTC status and shall be avoided at any case. For service 0x19, if the DTC referenced by the event ID is identified by the algorithm, the value of the DTC will be returned. In case calibration occurs with 0 for the event ID and the service is called again, the DTC referenced by the disabled event is identified by the algorithm, the DTC returned by the service is DEM_NO_DTC. If re-calibration is performed during Dem processing or without invalidation of outdated Dem NvM-blocks the Dem behavior is undefined (can lead e.g. to segmentation faults in the worst case).
            EventAvailable_4: resulting-properties={base-type=uint8, sw-bit-representation={bit-position=4, number-of-bits=1}, sw-calibration-access=READ-WRITE, compu-method=CM_DemEventEnabled_4, data-constr=uint8}, symbol=[0]  # Availability of event WDGM_E_SET_MODE (1 means enabled, 0 means disabled). Calibration of this value is only allowed before Dem_PreInit() is called. If the event which provides the OBD freeze frame is disabled the OBD freeze frame will not be updated and no OBD freeze frame will be provided to the Dcm. If an event which is stored in event memory is disabled the event memory entry is not available anymore. The Dem NvM-blocks has to be invalidated after re-calibration is performed (in order to avoid data inconsistency). If the event stored in event memory is also combined, disabling it could lead to an inconsistent UDS DTC status and shall be avoided at any case. For service 0x19, if the DTC referenced by the event ID is identified by the algorithm, the value of the DTC will be returned. In case calibration occurs with 0 for the event ID and the service is called again, the DTC referenced by the disabled event is identified by the algorithm, the DTC returned by the service is DEM_NO_DTC. If re-calibration is performed during Dem processing or without invalidation of outdated Dem NvM-blocks the Dem behavior is undefined (can lead e.g. to segmentation faults in the worst case).
            EventAvailable_5: resulting-properties={base-type=uint8, sw-bit-representation={bit-position=5, number-of-bits=1}, sw-calibration-access=READ-WRITE, compu-method=CM_DemEventEnabled_5, data-constr=uint8}, symbol=[0]  # Availability of event WDGM_E_DATA_CORRUPTION (1 means enabled, 0 means disabled). Calibration of this value is only allowed before Dem_PreInit() is called. If the event which provides the OBD freeze frame is disabled the OBD freeze frame will not be updated and no OBD freeze frame will be provided to the Dcm. If an event which is stored in event memory is disabled the event memory entry is not available anymore. The Dem NvM-blocks has to be invalidated after re-calibration is performed (in order to avoid data inconsistency). If the event stored in event memory is also combined, disabling it could lead to an inconsistent UDS DTC status and shall be avoided at any case. For service 0x19, if the DTC referenced by the event ID is identified by the algorithm, the value of the DTC will be returned. In case calibration occurs with 0 for the event ID and the service is called again, the DTC referenced by the disabled event is identified by the algorithm, the DTC returned by the service is DEM_NO_DTC. If re-calibration is performed during Dem processing or without invalidation of outdated Dem NvM-blocks the Dem behavior is undefined (can lead e.g. to segmentation faults in the worst case).
            EventAvailable_6: resulting-properties={base-type=uint8, sw-bit-representation={bit-position=6, number-of-bits=1}, sw-calibration-access=READ-WRITE, compu-method=CM_DemEventEnabled_6, data-constr=uint8}, symbol=[0]  # Availability of event ECUM_E_RAM_CHECK_FAILED (1 means enabled, 0 means disabled). Calibration of this value is only allowed before Dem_PreInit() is called. If the event which provides the OBD freeze frame is disabled the OBD freeze frame will not be updated and no OBD freeze frame will be provided to the Dcm. If an event which is stored in event memory is disabled the event memory entry is not available anymore. The Dem NvM-blocks has to be invalidated after re-calibration is performed (in order to avoid data inconsistency). If the event stored in event memory is also combined, disabling it could lead to an inconsistent UDS DTC status and shall be avoided at any case. For service 0x19, if the DTC referenced by the event ID is identified by the algorithm, the value of the DTC will be returned. In case calibration occurs with 0 for the event ID and the service is called again, the DTC referenced by the disabled event is identified by the algorithm, the DTC returned by the service is DEM_NO_DTC. If re-calibration is performed during Dem processing or without invalidation of outdated Dem NvM-blocks the Dem behavior is undefined (can lead e.g. to segmentation faults in the worst case).
            EventAvailable_7: resulting-properties={base-type=uint8, sw-bit-representation={bit-position=7, number-of-bits=1}, sw-calibration-access=READ-WRITE, compu-method=CM_DemEventEnabled_7, data-constr=uint8}, symbol=[0]  # Availability of event MCU_E_CLOCK_FAILURE (1 means enabled, 0 means disabled). Calibration of this value is only allowed before Dem_PreInit() is called. If the event which provides the OBD freeze frame is disabled the OBD freeze frame will not be updated and no OBD freeze frame will be provided to the Dcm. If an event which is stored in event memory is disabled the event memory entry is not available anymore. The Dem NvM-blocks has to be invalidated after re-calibration is performed (in order to avoid data inconsistency). If the event stored in event memory is also combined, disabling it could lead to an inconsistent UDS DTC status and shall be avoided at any case. For service 0x19, if the DTC referenced by the event ID is identified by the algorithm, the value of the DTC will be returned. In case calibration occurs with 0 for the event ID and the service is called again, the DTC referenced by the disabled event is identified by the algorithm, the DTC returned by the service is DEM_NO_DTC. If re-calibration is performed during Dem processing or without invalidation of outdated Dem NvM-blocks the Dem behavior is undefined (can lead e.g. to segmentation faults in the worst case).
            EventAvailable_8: resulting-properties={base-type=uint8, sw-bit-representation={bit-position=0, number-of-bits=1}, sw-calibration-access=READ-WRITE, compu-method=CM_DemEventEnabled_0, data-constr=uint8}, symbol=[1]  # Availability of event WDGM_E_MF_TIMINGVIOLATION (1 means enabled, 0 means disabled). Calibration of this value is only allowed before Dem_PreInit() is called. If the event which provides the OBD freeze frame is disabled the OBD freeze frame will not be updated and no OBD freeze frame will be provided to the Dcm. If an event which is stored in event memory is disabled the event memory entry is not available anymore. The Dem NvM-blocks has to be invalidated after re-calibration is performed (in order to avoid data inconsistency). If the event stored in event memory is also combined, disabling it could lead to an inconsistent UDS DTC status and shall be avoided at any case. For service 0x19, if the DTC referenced by the event ID is identified by the algorithm, the value of the DTC will be returned. In case calibration occurs with 0 for the event ID and the service is called again, the DTC referenced by the disabled event is identified by the algorithm, the DTC returned by the service is DEM_NO_DTC. If re-calibration is performed during Dem processing or without invalidation of outdated Dem NvM-blocks the Dem behavior is undefined (can lead e.g. to segmentation faults in the worst case).
            EventAvailable_9: resulting-properties={base-type=uint8, sw-bit-representation={bit-position=1, number-of-bits=1}, sw-calibration-access=READ-WRITE, compu-method=CM_DemEventEnabled_1, data-constr=uint8}, symbol=[1]  # Availability of event DTC_0x000002_Event (1 means enabled, 0 means disabled). Calibration of this value is only allowed before Dem_PreInit() is called. If the event which provides the OBD freeze frame is disabled the OBD freeze frame will not be updated and no OBD freeze frame will be provided to the Dcm. If an event which is stored in event memory is disabled the event memory entry is not available anymore. The Dem NvM-blocks has to be invalidated after re-calibration is performed (in order to avoid data inconsistency). If the event stored in event memory is also combined, disabling it could lead to an inconsistent UDS DTC status and shall be avoided at any case. For service 0x19, if the DTC referenced by the event ID is identified by the algorithm, the value of the DTC will be returned. In case calibration occurs with 0 for the event ID and the service is called again, the DTC referenced by the disabled event is identified by the algorithm, the DTC returned by the service is DEM_NO_DTC. If re-calibration is performed during Dem processing or without invalidation of outdated Dem NvM-blocks the Dem behavior is undefined (can lead e.g. to segmentation faults in the worst case).
            EventAvailable_10: resulting-properties={base-type=uint8, sw-bit-representation={bit-position=2, number-of-bits=1}, sw-calibration-access=READ-WRITE, compu-method=CM_DemEventEnabled_2, data-constr=uint8}, symbol=[1]  # Availability of event USER_DEFINE_MEMORY_Event (1 means enabled, 0 means disabled). Calibration of this value is only allowed before Dem_PreInit() is called. If the event which provides the OBD freeze frame is disabled the OBD freeze frame will not be updated and no OBD freeze frame will be provided to the Dcm. If an event which is stored in event memory is disabled the event memory entry is not available anymore. The Dem NvM-blocks has to be invalidated after re-calibration is performed (in order to avoid data inconsistency). If the event stored in event memory is also combined, disabling it could lead to an inconsistent UDS DTC status and shall be avoided at any case. For service 0x19, if the DTC referenced by the event ID is identified by the algorithm, the value of the DTC will be returned. In case calibration occurs with 0 for the event ID and the service is called again, the DTC referenced by the disabled event is identified by the algorithm, the DTC returned by the service is DEM_NO_DTC. If re-calibration is performed during Dem processing or without invalidation of outdated Dem NvM-blocks the Dem behavior is undefined (can lead e.g. to segmentation faults in the worst case).
            EventAvailable_11: resulting-properties={base-type=uint8, sw-bit-representation={bit-position=3, number-of-bits=1}, sw-calibration-access=READ-WRITE, compu-method=CM_DemEventEnabled_3, data-constr=uint8}, symbol=[1]  # Availability of event MCU_E_TIMEOUT_FAILURE (1 means enabled, 0 means disabled). Calibration of this value is only allowed before Dem_PreInit() is called. If the event which provides the OBD freeze frame is disabled the OBD freeze frame will not be updated and no OBD freeze frame will be provided to the Dcm. If an event which is stored in event memory is disabled the event memory entry is not available anymore. The Dem NvM-blocks has to be invalidated after re-calibration is performed (in order to avoid data inconsistency). If the event stored in event memory is also combined, disabling it could lead to an inconsistent UDS DTC status and shall be avoided at any case. For service 0x19, if the DTC referenced by the event ID is identified by the algorithm, the value of the DTC will be returned. In case calibration occurs with 0 for the event ID and the service is called again, the DTC referenced by the disabled event is identified by the algorithm, the DTC returned by the service is DEM_NO_DTC. If re-calibration is performed during Dem processing or without invalidation of outdated Dem NvM-blocks the Dem behavior is undefined (can lead e.g. to segmentation faults in the worst case).
            EventAvailable_12: resulting-properties={base-type=uint8, sw-bit-representation={bit-position=4, number-of-bits=1}, sw-calibration-access=READ-WRITE, compu-method=CM_DemEventEnabled_4, data-constr=uint8}, symbol=[1]  # Availability of event MCU_E_INVALIDFXOSC_CONFIG (1 means enabled, 0 means disabled). Calibration of this value is only allowed before Dem_PreInit() is called. If the event which provides the OBD freeze frame is disabled the OBD freeze frame will not be updated and no OBD freeze frame will be provided to the Dcm. If an event which is stored in event memory is disabled the event memory entry is not available anymore. The Dem NvM-blocks has to be invalidated after re-calibration is performed (in order to avoid data inconsistency). If the event stored in event memory is also combined, disabling it could lead to an inconsistent UDS DTC status and shall be avoided at any case. For service 0x19, if the DTC referenced by the event ID is identified by the algorithm, the value of the DTC will be returned. In case calibration occurs with 0 for the event ID and the service is called again, the DTC referenced by the disabled event is identified by the algorithm, the DTC returned by the service is DEM_NO_DTC. If re-calibration is performed during Dem processing or without invalidation of outdated Dem NvM-blocks the Dem behavior is undefined (can lead e.g. to segmentation faults in the worst case).
            EventAvailable_13: resulting-properties={base-type=uint8, sw-bit-representation={bit-position=5, number-of-bits=1}, sw-calibration-access=READ-WRITE, compu-method=CM_DemEventEnabled_5, data-constr=uint8}, symbol=[1]  # Availability of event MCU_E_CLOCKMUXSWITCH_FAILURE (1 means enabled, 0 means disabled). Calibration of this value is only allowed before Dem_PreInit() is called. If the event which provides the OBD freeze frame is disabled the OBD freeze frame will not be updated and no OBD freeze frame will be provided to the Dcm. If an event which is stored in event memory is disabled the event memory entry is not available anymore. The Dem NvM-blocks has to be invalidated after re-calibration is performed (in order to avoid data inconsistency). If the event stored in event memory is also combined, disabling it could lead to an inconsistent UDS DTC status and shall be avoided at any case. For service 0x19, if the DTC referenced by the event ID is identified by the algorithm, the value of the DTC will be returned. In case calibration occurs with 0 for the event ID and the service is called again, the DTC referenced by the disabled event is identified by the algorithm, the DTC returned by the service is DEM_NO_DTC. If re-calibration is performed during Dem processing or without invalidation of outdated Dem NvM-blocks the Dem behavior is undefined (can lead e.g. to segmentation faults in the worst case).
            EventAvailable_14: resulting-properties={base-type=uint8, sw-bit-representation={bit-position=6, number-of-bits=1}, sw-calibration-access=READ-WRITE, compu-method=CM_DemEventEnabled_6, data-constr=uint8}, symbol=[1]  # Availability of event SPI_E_HARDWARE_ERROR (1 means enabled, 0 means disabled). Calibration of this value is only allowed before Dem_PreInit() is called. If the event which provides the OBD freeze frame is disabled the OBD freeze frame will not be updated and no OBD freeze frame will be provided to the Dcm. If an event which is stored in event memory is disabled the event memory entry is not available anymore. The Dem NvM-blocks has to be invalidated after re-calibration is performed (in order to avoid data inconsistency). If the event stored in event memory is also combined, disabling it could lead to an inconsistent UDS DTC status and shall be avoided at any case. For service 0x19, if the DTC referenced by the event ID is identified by the algorithm, the value of the DTC will be returned. In case calibration occurs with 0 for the event ID and the service is called again, the DTC referenced by the disabled event is identified by the algorithm, the DTC returned by the service is DEM_NO_DTC. If re-calibration is performed during Dem processing or without invalidation of outdated Dem NvM-blocks the Dem behavior is undefined (can lead e.g. to segmentation faults in the worst case).
            EventAvailable_15: resulting-properties={base-type=uint8, sw-bit-representation={bit-position=7, number-of-bits=1}, sw-calibration-access=READ-WRITE, compu-method=CM_DemEventEnabled_7, data-constr=uint8}, symbol=[1]  # Availability of event CANSM_E_BUS_OFF_0 (1 means enabled, 0 means disabled). Calibration of this value is only allowed before Dem_PreInit() is called. If the event which provides the OBD freeze frame is disabled the OBD freeze frame will not be updated and no OBD freeze frame will be provided to the Dcm. If an event which is stored in event memory is disabled the event memory entry is not available anymore. The Dem NvM-blocks has to be invalidated after re-calibration is performed (in order to avoid data inconsistency). If the event stored in event memory is also combined, disabling it could lead to an inconsistent UDS DTC status and shall be avoided at any case. For service 0x19, if the DTC referenced by the event ID is identified by the algorithm, the value of the DTC will be returned. In case calibration occurs with 0 for the event ID and the service is called again, the DTC referenced by the disabled event is identified by the algorithm, the DTC returned by the service is DEM_NO_DTC. If re-calibration is performed during Dem processing or without invalidation of outdated Dem NvM-blocks the Dem behavior is undefined (can lead e.g. to segmentation faults in the worst case).
        Dem_OBDConfig: category=ARRAY, array-size=15
          15 x mc data instance, all with category=STRUCTURE:
            DTC_0x000001: symbol=[0]
              mc data instance Dem_ObdDTC: category=VALUE, resulting-properties={base-type=uint16, sw-calibration-access=READ-WRITE, data-constr=uint16}  # DemObdDTC for each Combined DTC
            DTC_0x000002: symbol=[1]
              mc data instance Dem_ObdDTC: category=VALUE, resulting-properties={base-type=uint16, sw-calibration-access=READ-WRITE, data-constr=uint16}  # DemObdDTC for each Combined DTC
            User_Memory: symbol=[2]
              mc data instance Dem_ObdDTC: category=VALUE, resulting-properties={base-type=uint16, sw-calibration-access=READ-WRITE, data-constr=uint16}  # DemObdDTC for each Combined DTC
            DemDTCClass_0: symbol=[3]
              mc data instance Dem_ObdDTC: category=VALUE, resulting-properties={base-type=uint16, sw-calibration-access=READ-WRITE, data-constr=uint16}  # DemObdDTC for each Combined DTC
            WDGM_E_MONITORING: symbol=[4]
              mc data instance Dem_ObdDTC: category=VALUE, resulting-properties={base-type=uint16, sw-calibration-access=READ-WRITE, data-constr=uint16}  # DemObdDTC for each Combined DTC
            WDGM_E_SET_MODE: symbol=[5]
              mc data instance Dem_ObdDTC: category=VALUE, resulting-properties={base-type=uint16, sw-calibration-access=READ-WRITE, data-constr=uint16}  # DemObdDTC for each Combined DTC
            WDGM_E_DATA_CORRUPTION: symbol=[6]
              mc data instance Dem_ObdDTC: category=VALUE, resulting-properties={base-type=uint16, sw-calibration-access=READ-WRITE, data-constr=uint16}  # DemObdDTC for each Combined DTC
            ECUM_E_RAM_CHECK_FAILED: symbol=[7]
              mc data instance Dem_ObdDTC: category=VALUE, resulting-properties={base-type=uint16, sw-calibration-access=READ-WRITE, data-constr=uint16}  # DemObdDTC for each Combined DTC
            MCU_E_CLOCK_FAILURE: symbol=[8]
              mc data instance Dem_ObdDTC: category=VALUE, resulting-properties={base-type=uint16, sw-calibration-access=READ-WRITE, data-constr=uint16}  # DemObdDTC for each Combined DTC
            WDGM_E_MF_TIMINGVIOLATION: symbol=[9]
              mc data instance Dem_ObdDTC: category=VALUE, resulting-properties={base-type=uint16, sw-calibration-access=READ-WRITE, data-constr=uint16}  # DemObdDTC for each Combined DTC
            MCU_E_TIMEOUT_FAILURE: symbol=[10]
              mc data instance Dem_ObdDTC: category=VALUE, resulting-properties={base-type=uint16, sw-calibration-access=READ-WRITE, data-constr=uint16}  # DemObdDTC for each Combined DTC
            MCU_E_INVALIDFXOSC_CONFIG: symbol=[11]
              mc data instance Dem_ObdDTC: category=VALUE, resulting-properties={base-type=uint16, sw-calibration-access=READ-WRITE, data-constr=uint16}  # DemObdDTC for each Combined DTC
            MCU_E_CLOCKMUXSWITCH_FAILURE: symbol=[12]
              mc data instance Dem_ObdDTC: category=VALUE, resulting-properties={base-type=uint16, sw-calibration-access=READ-WRITE, data-constr=uint16}  # DemObdDTC for each Combined DTC
            SPI_E_HARDWARE_ERROR: symbol=[13]
              mc data instance Dem_ObdDTC: category=VALUE, resulting-properties={base-type=uint16, sw-calibration-access=READ-WRITE, data-constr=uint16}  # DemObdDTC for each Combined DTC
            CANSM_E_BUS_OFF_0: symbol=[14]
              mc data instance Dem_ObdDTC: category=VALUE, resulting-properties={base-type=uint16, sw-calibration-access=READ-WRITE, data-constr=uint16}  # DemObdDTC for each Combined DTC
    resource consumption ResourceConsumption
      21 x memory section:
        VAR_CLEARED_UNSPECIFIED: alignment=UNSPECIFIED, sw-addrmethod=VAR_CLEARED
        VAR_CLEARED_32: alignment=32, sw-addrmethod=VAR_CLEARED
        VAR_CLEARED_16: alignment=16, sw-addrmethod=VAR_CLEARED
        VAR_CLEARED_8: alignment=8, sw-addrmethod=VAR_CLEARED
        VAR_INIT_UNSPECIFIED: alignment=UNSPECIFIED, sw-addrmethod=VAR
        VAR_INIT_32: alignment=32, sw-addrmethod=VAR
        VAR_INIT_16: alignment=16, sw-addrmethod=VAR
        VAR_INIT_8: alignment=8, sw-addrmethod=VAR
        VAR_SAVED_ZONE_UNSPECIFIED: alignment=UNSPECIFIED, sw-addrmethod=VAR_CLEARED
        VAR_SAVED_ZONE_16: alignment=16, sw-addrmethod=VAR_CLEARED
        VAR_SAVED_ZONE_8: alignment=8, sw-addrmethod=VAR_CLEARED
        CONST_UNSPECIFIED: alignment=UNSPECIFIED, sw-addrmethod=CONST
        CONST_32: alignment=32, sw-addrmethod=CONST
        CONST_16: alignment=16, sw-addrmethod=CONST
        CONST_8: alignment=8, sw-addrmethod=CONST
        CALIB_UNSPECIFIED: alignment=UNSPECIFIED, sw-addrmethod=CALIB
        CALIB_32: alignment=32, sw-addrmethod=CALIB
        CALIB_16: alignment=16, sw-addrmethod=CALIB
        CALIB_8: alignment=8, sw-addrmethod=CALIB
        CODE: sw-addrmethod=CODE
        EB_INTGR_BSWM_TRIGGERMEMORYSTACK_CODE: sw-addrmethod=CALLOUT_CODE
