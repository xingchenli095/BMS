AUTOSAR XML (schema 4-3-0)
package /BswM
  module config BswM
    BswMConfig
      BswMModeControl
        5 x BswMAction:
          BswM_Act_QualifyDemOpCycle_OBD_DCY
            BswMAvailableActions
              BswMAvailableActions (BswMUserCallout): BswMUserCalloutFunction=Dem_SetCycleQualified(DEM_OPCYC_OBD_DCY)
          BswM_Act_StartDemOpCycleState_IGNITION
            BswMAvailableActions
              BswMAvailableActions (BswMUserCallout): BswMUserCalloutFunction=Dem_SetOperationCycleState(DEM_OPCYC_IGNITION, DEM_CYCLE_STATE_START)
          BswM_Act_StartDemOpCycleState_OBD_DCY
            BswMAvailableActions
              BswMAvailableActions (BswMUserCallout): BswMUserCalloutFunction=Dem_SetOperationCycleState(DEM_OPCYC_OBD_DCY, DEM_CYCLE_STATE_START)
          BswM_Act_StopDemOpCycleState_IGNITION
            BswMAvailableActions
              BswMAvailableActions (BswMUserCallout): BswMUserCalloutFunction=Dem_SetOperationCycleState(DEM_OPCYC_IGNITION, DEM_CYCLE_STATE_END)
          BswM_Act_StopDemOpCycleState_OBD_DCY
            BswMAvailableActions
              BswMAvailableActions (BswMUserCallout): BswMUserCalloutFunction=Dem_SetOperationCycleState(DEM_OPCYC_OBD_DCY, DEM_CYCLE_STATE_END)
        BswM_ActLst_PrpShutdown (BswMActionList)
          BswMActionListItem_5 (BswMActionListItem): BswMActionListItemIndex=3, BswMActionListItemRef=BswM_Act_StopDemOpCycleState_IGNITION
          BswMActionListItem_6 (BswMActionListItem): BswMActionListItemIndex=4, BswMActionListItemRef=BswM_Act_StopDemOpCycleState_OBD_DCY
        BswM_ActLst_StartupTwoB (BswMActionList)
          3 x BswMActionListItem:
            BswMActionListItem_7: BswMActionListItemIndex=5, BswMActionListItemRef=BswM_Act_StartDemOpCycleState_IGNITION
            BswMActionListItem_8: BswMActionListItemIndex=6, BswMActionListItemRef=BswM_Act_StartDemOpCycleState_OBD_DCY
            BswMActionListItem_9: BswMActionListItemRef=BswM_Act_QualifyDemOpCycle_OBD_DCY
