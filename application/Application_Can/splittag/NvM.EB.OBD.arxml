AUTOSAR XML (schema 4-3-0)
package /NvM
  module config NvM
    NVM_BLOCK_DEM_PERMANENT (NvMBlockDescriptor): NvMSelectBlockForReadAll=1
      NvMTargetBlockReference
        NvMTargetBlockReference (NvMFeeRef): NvMNameOfFeeBlock=Fee_NVM_BLOCK_DEM_PERMANENT
