AUTOSAR XML (schema 00046)
package /EcuExtract
  composition sw component type TopLevelComposition
    9 x component:
      BswM_Prototype: type=BswM
      ComM_Prototype: type=ComM
      Dem_Prototype: type=Dem
      DevelopmentErrorTracer_Prototype2: type=DevelopmentErrorTracer
      NvM_Prototype: type=NvM
      SWC_AppStateHandler_Prototype: type=SWC_AppStateHandler
      SWC_IoHwAbs_Prototype: type=SWC_IoHwAbs
      SWC_SPI_Prototype: type=SWC_SPI
      ServiceSwComponentDem: type=ServiceSwComponentDem
    connect BswM_Prototype.BswM_ModeRequestPort_BswMRteModeRequestPort_AppStateMode -> SWC_AppStateHandler_Prototype.AppStateRequest
    connect SWC_AppStateHandler_Prototype.AppState -> BswM_Prototype.ModeNotificationPort_BswM_ModeReqPort_AppState
    connect ServiceSwComponentDem.CBReadData_DemExternalCSDataElementClass_Session -> Dem_Prototype.CBReadData_DemExternalCSDataElementClass_Session
    connect ServiceSwComponentDem.CBReadData_DemExternalCSDataElementClass_ExtDataRec_0x01 -> Dem_Prototype.CBReadData_DemExternalCSDataElementClass_ExtDataRec_0x01
    connect ServiceSwComponentDem.SetClearDTC_master -> Dem_Prototype.SetClearDTC_master
    connect NvM_Prototype.PS_NvM_BLOCK_voltage -> SWC_SPI_Prototype.PS_NvM_Block_voltage
    connect SWC_IoHwAbs_Prototype.Pp_AdcValue -> SWC_SPI_Prototype.Rp_AdcValue
  system ECU: category=ECU_EXTRACT, system-version=1.0.0
    system mapping DummyEcuExtractSysMapping
    root-software-compositions:
      root sw composition prototype TopLevelCompositionPrototype: flat-map=FlatMap, software-composition=TopLevelComposition
  flat map FlatMap
    69 x flat instance descriptor:
      BswM_Prototype_0: upstream-reference=TopLevelComposition.BswM_Prototype, ecu-extract-reference=TopLevelCompositionPrototype.BswM_Prototype
      BswM_ModeSwitchPort_BswM_SwitchPort_Rte_1: upstream-reference=TopLevelComposition.BswM_Prototype.BswM_ModeSwitchPort_BswM_SwitchPort_Rte, ecu-extract-reference=TopLevelCompositionPrototype.BswM_Prototype.BswM_ModeSwitchPort_BswM_SwitchPort_Rte
      BswM_ModeRequestPort_BswMRteModeRequestPort_AppStateMode_2: upstream-reference=TopLevelComposition.BswM_Prototype.BswM_ModeRequestPort_BswMRteModeRequestPort_AppStateMode, ecu-extract-reference=TopLevelCompositionPrototype.BswM_Prototype.BswM_ModeRequestPort_BswMRteModeRequestPort_AppStateMode
      If_AppStateRequestMode_3: upstream-reference=TopLevelComposition.BswM_Prototype.BswM_ModeRequestPort_BswMRteModeRequestPort_AppStateMode.If_AppStateRequestMode, ecu-extract-reference=TopLevelCompositionPrototype.BswM_Prototype.BswM_ModeRequestPort_BswMRteModeRequestPort_AppStateMode.If_AppStateRequestMode
      ModeNotificationPort_BswM_ModeReqPort_AppState_4: upstream-reference=TopLevelComposition.BswM_Prototype.ModeNotificationPort_BswM_ModeReqPort_AppState, ecu-extract-reference=TopLevelCompositionPrototype.BswM_Prototype.ModeNotificationPort_BswM_ModeReqPort_AppState
      ComM_Prototype_5: upstream-reference=TopLevelComposition.ComM_Prototype, ecu-extract-reference=TopLevelCompositionPrototype.ComM_Prototype
      UM_ComMUser_0_6: upstream-reference=TopLevelComposition.ComM_Prototype.UM_ComMUser_0, ecu-extract-reference=TopLevelCompositionPrototype.ComM_Prototype.UM_ComMUser_0
      UR_ComMUser_0_7: upstream-reference=TopLevelComposition.ComM_Prototype.UR_ComMUser_0, ecu-extract-reference=TopLevelCompositionPrototype.ComM_Prototype.UR_ComMUser_0
      Dem_Prototype_8: upstream-reference=TopLevelComposition.Dem_Prototype, ecu-extract-reference=TopLevelCompositionPrototype.Dem_Prototype
      Event_DTC_0x000001_Event_9: upstream-reference=TopLevelComposition.Dem_Prototype.Event_DTC_0x000001_Event, ecu-extract-reference=TopLevelCompositionPrototype.Dem_Prototype.Event_DTC_0x000001_Event
      EvtInfo_DTC_0x000001_Event_10: upstream-reference=TopLevelComposition.Dem_Prototype.EvtInfo_DTC_0x000001_Event, ecu-extract-reference=TopLevelCompositionPrototype.Dem_Prototype.EvtInfo_DTC_0x000001_Event
      Event_Permanent_DTC_11: upstream-reference=TopLevelComposition.Dem_Prototype.Event_Permanent_DTC, ecu-extract-reference=TopLevelCompositionPrototype.Dem_Prototype.Event_Permanent_DTC
      EvtInfo_Permanent_DTC_12: upstream-reference=TopLevelComposition.Dem_Prototype.EvtInfo_Permanent_DTC, ecu-extract-reference=TopLevelCompositionPrototype.Dem_Prototype.EvtInfo_Permanent_DTC
      EvtInfo_WDGM_E_MONITORING_13: upstream-reference=TopLevelComposition.Dem_Prototype.EvtInfo_WDGM_E_MONITORING, ecu-extract-reference=TopLevelCompositionPrototype.Dem_Prototype.EvtInfo_WDGM_E_MONITORING
      EvtInfo_WDGM_E_SET_MODE_14: upstream-reference=TopLevelComposition.Dem_Prototype.EvtInfo_WDGM_E_SET_MODE, ecu-extract-reference=TopLevelCompositionPrototype.Dem_Prototype.EvtInfo_WDGM_E_SET_MODE
      EvtInfo_WDGM_E_DATA_CORRUPTION_15: upstream-reference=TopLevelComposition.Dem_Prototype.EvtInfo_WDGM_E_DATA_CORRUPTION, ecu-extract-reference=TopLevelCompositionPrototype.Dem_Prototype.EvtInfo_WDGM_E_DATA_CORRUPTION
      EvtInfo_ECUM_E_RAM_CHECK_FAILED_16: upstream-reference=TopLevelComposition.Dem_Prototype.EvtInfo_ECUM_E_RAM_CHECK_FAILED, ecu-extract-reference=TopLevelCompositionPrototype.Dem_Prototype.EvtInfo_ECUM_E_RAM_CHECK_FAILED
      EvtInfo_MCU_E_CLOCK_FAILURE_17: upstream-reference=TopLevelComposition.Dem_Prototype.EvtInfo_MCU_E_CLOCK_FAILURE, ecu-extract-reference=TopLevelCompositionPrototype.Dem_Prototype.EvtInfo_MCU_E_CLOCK_FAILURE
      EvtInfo_WDGM_E_MF_TIMINGVIOLATION_18: upstream-reference=TopLevelComposition.Dem_Prototype.EvtInfo_WDGM_E_MF_TIMINGVIOLATION, ecu-extract-reference=TopLevelCompositionPrototype.Dem_Prototype.EvtInfo_WDGM_E_MF_TIMINGVIOLATION
      Event_DTC_0x000002_Event_19: upstream-reference=TopLevelComposition.Dem_Prototype.Event_DTC_0x000002_Event, ecu-extract-reference=TopLevelCompositionPrototype.Dem_Prototype.Event_DTC_0x000002_Event
      EvtInfo_DTC_0x000002_Event_20: upstream-reference=TopLevelComposition.Dem_Prototype.EvtInfo_DTC_0x000002_Event, ecu-extract-reference=TopLevelCompositionPrototype.Dem_Prototype.EvtInfo_DTC_0x000002_Event
      Event_USER_DEFINE_MEMORY_Event_21: upstream-reference=TopLevelComposition.Dem_Prototype.Event_USER_DEFINE_MEMORY_Event, ecu-extract-reference=TopLevelCompositionPrototype.Dem_Prototype.Event_USER_DEFINE_MEMORY_Event
      EvtInfo_USER_DEFINE_MEMORY_Event_22: upstream-reference=TopLevelComposition.Dem_Prototype.EvtInfo_USER_DEFINE_MEMORY_Event, ecu-extract-reference=TopLevelCompositionPrototype.Dem_Prototype.EvtInfo_USER_DEFINE_MEMORY_Event
      EvtInfo_MCU_E_TIMEOUT_FAILURE_23: upstream-reference=TopLevelComposition.Dem_Prototype.EvtInfo_MCU_E_TIMEOUT_FAILURE, ecu-extract-reference=TopLevelCompositionPrototype.Dem_Prototype.EvtInfo_MCU_E_TIMEOUT_FAILURE
      EvtInfo_MCU_E_INVALIDFXOSC_CONFIG_24: upstream-reference=TopLevelComposition.Dem_Prototype.EvtInfo_MCU_E_INVALIDFXOSC_CONFIG, ecu-extract-reference=TopLevelCompositionPrototype.Dem_Prototype.EvtInfo_MCU_E_INVALIDFXOSC_CONFIG
      EvtInfo_MCU_E_CLOCKMUXSWITCH_FAILURE_25: upstream-reference=TopLevelComposition.Dem_Prototype.EvtInfo_MCU_E_CLOCKMUXSWITCH_FAILURE, ecu-extract-reference=TopLevelCompositionPrototype.Dem_Prototype.EvtInfo_MCU_E_CLOCKMUXSWITCH_FAILURE
      EvtInfo_SPI_E_HARDWARE_ERROR_26: upstream-reference=TopLevelComposition.Dem_Prototype.EvtInfo_SPI_E_HARDWARE_ERROR, ecu-extract-reference=TopLevelCompositionPrototype.Dem_Prototype.EvtInfo_SPI_E_HARDWARE_ERROR
      EvtInfo_CANSM_E_BUS_OFF_0_27: upstream-reference=TopLevelComposition.Dem_Prototype.EvtInfo_CANSM_E_BUS_OFF_0, ecu-extract-reference=TopLevelCompositionPrototype.Dem_Prototype.EvtInfo_CANSM_E_BUS_OFF_0
      GeneralEvtInfo_28: upstream-reference=TopLevelComposition.Dem_Prototype.GeneralEvtInfo, ecu-extract-reference=TopLevelCompositionPrototype.Dem_Prototype.GeneralEvtInfo
      OpCycle_DEM_OPCYC_IGNITION_29: upstream-reference=TopLevelComposition.Dem_Prototype.OpCycle_DEM_OPCYC_IGNITION, ecu-extract-reference=TopLevelCompositionPrototype.Dem_Prototype.OpCycle_DEM_OPCYC_IGNITION
      OpCycle_DEM_OPCYC_OBD_DCY_30: upstream-reference=TopLevelComposition.Dem_Prototype.OpCycle_DEM_OPCYC_OBD_DCY, ecu-extract-reference=TopLevelCompositionPrototype.Dem_Prototype.OpCycle_DEM_OPCYC_OBD_DCY
      OpCycle_DEM_OPCYC_POWER_31: upstream-reference=TopLevelComposition.Dem_Prototype.OpCycle_DEM_OPCYC_POWER, ecu-extract-reference=TopLevelCompositionPrototype.Dem_Prototype.OpCycle_DEM_OPCYC_POWER
      EnableCond_DEM_SL_ECU_LEVEL_32: upstream-reference=TopLevelComposition.Dem_Prototype.EnableCond_DEM_SL_ECU_LEVEL, ecu-extract-reference=TopLevelCompositionPrototype.Dem_Prototype.EnableCond_DEM_SL_ECU_LEVEL
      IndStatus_DEM_INDICATOR_0_33: upstream-reference=TopLevelComposition.Dem_Prototype.IndStatus_DEM_INDICATOR_0, ecu-extract-reference=TopLevelCompositionPrototype.Dem_Prototype.IndStatus_DEM_INDICATOR_0
      OverflowIndPrimaryMemory_34: upstream-reference=TopLevelComposition.Dem_Prototype.OverflowIndPrimaryMemory, ecu-extract-reference=TopLevelCompositionPrototype.Dem_Prototype.OverflowIndPrimaryMemory
      OverflowIndSecondaryMemory_35: upstream-reference=TopLevelComposition.Dem_Prototype.OverflowIndSecondaryMemory, ecu-extract-reference=TopLevelCompositionPrototype.Dem_Prototype.OverflowIndSecondaryMemory
      OverflowIndPermanentMemory_36: upstream-reference=TopLevelComposition.Dem_Prototype.OverflowIndPermanentMemory, ecu-extract-reference=TopLevelCompositionPrototype.Dem_Prototype.OverflowIndPermanentMemory
      ControlDTCSuppression_37: upstream-reference=TopLevelComposition.Dem_Prototype.ControlDTCSuppression, ecu-extract-reference=TopLevelCompositionPrototype.Dem_Prototype.ControlDTCSuppression
      CddIf_38: upstream-reference=TopLevelComposition.Dem_Prototype.CddIf, ecu-extract-reference=TopLevelCompositionPrototype.Dem_Prototype.CddIf
      PfcCycleQualified_39: upstream-reference=TopLevelComposition.Dem_Prototype.PfcCycleQualified, ecu-extract-reference=TopLevelCompositionPrototype.Dem_Prototype.PfcCycleQualified
      ResetReadiness_40: upstream-reference=TopLevelComposition.Dem_Prototype.ResetReadiness, ecu-extract-reference=TopLevelCompositionPrototype.Dem_Prototype.ResetReadiness
      PowerTakeOffStatus_41: upstream-reference=TopLevelComposition.Dem_Prototype.PowerTakeOffStatus, ecu-extract-reference=TopLevelCompositionPrototype.Dem_Prototype.PowerTakeOffStatus
      CBReadData_DemExternalCSDataElementClass_Session_42: upstream-reference=TopLevelComposition.Dem_Prototype.CBReadData_DemExternalCSDataElementClass_Session, ecu-extract-reference=TopLevelCompositionPrototype.Dem_Prototype.CBReadData_DemExternalCSDataElementClass_Session
      CBReadData_DemExternalCSDataElementClass_ExtDataRec_0x01_43: upstream-reference=TopLevelComposition.Dem_Prototype.CBReadData_DemExternalCSDataElementClass_ExtDataRec_0x01, ecu-extract-reference=TopLevelCompositionPrototype.Dem_Prototype.CBReadData_DemExternalCSDataElementClass_ExtDataRec_0x01
      SetClearDTC_master_44: upstream-reference=TopLevelComposition.Dem_Prototype.SetClearDTC_master, ecu-extract-reference=TopLevelCompositionPrototype.Dem_Prototype.SetClearDTC_master
      DevelopmentErrorTracer_Prototype2_45: upstream-reference=TopLevelComposition.DevelopmentErrorTracer_Prototype2, ecu-extract-reference=TopLevelCompositionPrototype.DevelopmentErrorTracer_Prototype2
      DS_SWC_0_46: upstream-reference=TopLevelComposition.DevelopmentErrorTracer_Prototype2.DS_SWC_0, ecu-extract-reference=TopLevelCompositionPrototype.DevelopmentErrorTracer_Prototype2.DS_SWC_0
      NvM_Prototype_47: upstream-reference=TopLevelComposition.NvM_Prototype, ecu-extract-reference=TopLevelCompositionPrototype.NvM_Prototype
      PS_NvM_BLOCK_voltage_48: upstream-reference=TopLevelComposition.NvM_Prototype.PS_NvM_BLOCK_voltage, ecu-extract-reference=TopLevelCompositionPrototype.NvM_Prototype.PS_NvM_BLOCK_voltage
      SWC_AppStateHandler_Prototype_49: upstream-reference=TopLevelComposition.SWC_AppStateHandler_Prototype, ecu-extract-reference=TopLevelCompositionPrototype.SWC_AppStateHandler_Prototype
      AppState_50: upstream-reference=TopLevelComposition.SWC_AppStateHandler_Prototype.AppState, ecu-extract-reference=TopLevelCompositionPrototype.SWC_AppStateHandler_Prototype.AppState
      AppStateRequest_51: upstream-reference=TopLevelComposition.SWC_AppStateHandler_Prototype.AppStateRequest, ecu-extract-reference=TopLevelCompositionPrototype.SWC_AppStateHandler_Prototype.AppStateRequest
      If_AppStateRequestMode_52: upstream-reference=TopLevelComposition.SWC_AppStateHandler_Prototype.AppStateRequest.If_AppStateRequestMode, ecu-extract-reference=TopLevelCompositionPrototype.SWC_AppStateHandler_Prototype.AppStateRequest.If_AppStateRequestMode
      SWC_IoHwAbs_Prototype_53: upstream-reference=TopLevelComposition.SWC_IoHwAbs_Prototype, ecu-extract-reference=TopLevelCompositionPrototype.SWC_IoHwAbs_Prototype
      P_MyLED_54: upstream-reference=TopLevelComposition.SWC_IoHwAbs_Prototype.P_MyLED, ecu-extract-reference=TopLevelCompositionPrototype.SWC_IoHwAbs_Prototype.P_MyLED
      Pp_AdcValue_55: upstream-reference=TopLevelComposition.SWC_IoHwAbs_Prototype.Pp_AdcValue, ecu-extract-reference=TopLevelCompositionPrototype.SWC_IoHwAbs_Prototype.Pp_AdcValue
      ArgData_56: upstream-reference=TopLevelComposition.SWC_IoHwAbs_Prototype.Pp_AdcValue.ArgData, ecu-extract-reference=TopLevelCompositionPrototype.SWC_IoHwAbs_Prototype.Pp_AdcValue.ArgData
      Pp_Can_Send_57: upstream-reference=TopLevelComposition.SWC_IoHwAbs_Prototype.Pp_Can_Send, ecu-extract-reference=TopLevelCompositionPrototype.SWC_IoHwAbs_Prototype.Pp_Can_Send
      Can_58: upstream-reference=TopLevelComposition.SWC_IoHwAbs_Prototype.Pp_Can_Send.Can, ecu-extract-reference=TopLevelCompositionPrototype.SWC_IoHwAbs_Prototype.Pp_Can_Send.Can
      Rp_Can_Receive_59: upstream-reference=TopLevelComposition.SWC_IoHwAbs_Prototype.Rp_Can_Receive, ecu-extract-reference=TopLevelCompositionPrototype.SWC_IoHwAbs_Prototype.Rp_Can_Receive
      Can_60: upstream-reference=TopLevelComposition.SWC_IoHwAbs_Prototype.Rp_Can_Receive.Can, ecu-extract-reference=TopLevelCompositionPrototype.SWC_IoHwAbs_Prototype.Rp_Can_Receive.Can
      SWC_SPI_Prototype_61: upstream-reference=TopLevelComposition.SWC_SPI_Prototype, ecu-extract-reference=TopLevelCompositionPrototype.SWC_SPI_Prototype
      PS_NvM_Block_voltage_62: upstream-reference=TopLevelComposition.SWC_SPI_Prototype.PS_NvM_Block_voltage, ecu-extract-reference=TopLevelCompositionPrototype.SWC_SPI_Prototype.PS_NvM_Block_voltage
      Rp_AdcValue_63: upstream-reference=TopLevelComposition.SWC_SPI_Prototype.Rp_AdcValue, ecu-extract-reference=TopLevelCompositionPrototype.SWC_SPI_Prototype.Rp_AdcValue
      ArgData_64: upstream-reference=TopLevelComposition.SWC_SPI_Prototype.Rp_AdcValue.ArgData, ecu-extract-reference=TopLevelCompositionPrototype.SWC_SPI_Prototype.Rp_AdcValue.ArgData
      ServiceSwComponentDem_65: upstream-reference=TopLevelComposition.ServiceSwComponentDem, ecu-extract-reference=TopLevelCompositionPrototype.ServiceSwComponentDem
      CBReadData_DemExternalCSDataElementClass_Session_66: upstream-reference=TopLevelComposition.ServiceSwComponentDem.CBReadData_DemExternalCSDataElementClass_Session, ecu-extract-reference=TopLevelCompositionPrototype.ServiceSwComponentDem.CBReadData_DemExternalCSDataElementClass_Session
      CBReadData_DemExternalCSDataElementClass_ExtDataRec_0x01_67: upstream-reference=TopLevelComposition.ServiceSwComponentDem.CBReadData_DemExternalCSDataElementClass_ExtDataRec_0x01, ecu-extract-reference=TopLevelCompositionPrototype.ServiceSwComponentDem.CBReadData_DemExternalCSDataElementClass_ExtDataRec_0x01
      SetClearDTC_master_68: upstream-reference=TopLevelComposition.ServiceSwComponentDem.SetClearDTC_master, ecu-extract-reference=TopLevelCompositionPrototype.ServiceSwComponentDem.SetClearDTC_master
