AUTOSAR XML (schema 4-2-1)
package /CanSystem
  system CanSystem
    system mapping EBConnectionEditorMappings
      sw-mappings:
        swc to ecu mapping EBConnectionEditorSwcMappings: ecu-instance=PBU
          component:
            TopLevelComposition.NvM_Prototype
            TopLevelComposition.Dem_Prototype
            TopLevelComposition.BswM_Prototype
            TopLevelComposition.ComM_Prototype
            TopLevelComposition.SWC_IoHwAbs_Prototype
            TopLevelComposition.SWC_AppStateHandler_Prototype
            TopLevelComposition.SWC_SPI_Prototype
            TopLevelComposition.DevelopmentErrorTracer_Prototype2
package /DemoApplication/SwComponentTypes
  composition sw component type TopLevelComposition
    9 x component:
      BswM_Prototype: type=BswM
      ComM_Prototype: type=ComM
      Dem_Prototype: type=Dem
      DevelopmentErrorTracer_Prototype: type=DevelopmentErrorTracer
      DevelopmentErrorTracer_Prototype2: type=DevelopmentErrorTracer
      NvM_Prototype: type=NvM
      SWC_AppStateHandler_Prototype: type=SWC_AppStateHandler
      SWC_IoHwAbs_Prototype: type=SWC_IoHwAbs
      SWC_SPI_Prototype: type=SWC_SPI
    connect BswM_Prototype.BswM_ModeRequestPort_BswMRteModeRequestPort_AppStateMode -> SWC_AppStateHandler_Prototype.AppStateRequest
    connect SWC_AppStateHandler_Prototype.AppState -> BswM_Prototype.ModeNotificationPort_BswM_ModeReqPort_AppState
    connect NvM_Prototype.PS_NvM_BLOCK_voltage -> SWC_SPI_Prototype.PS_NvM_Block_voltage
    connect SWC_IoHwAbs_Prototype.Pp_AdcValue -> SWC_SPI_Prototype.Rp_AdcValue
