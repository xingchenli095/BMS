AUTOSAR XML (schema 00047)
package /CanSystem
  system CanSystem: pnc-vector-length=6, pnc-vector-offset=2, system-version=1.0.0
    system mapping SystemMapping
      data-mappings:
        data-element=SWC_CyclicCounter.TopLevelComposition.P_CounterOut.CounterValue, system-signal=CounterOut
        data-element=SWC_ModifyEcho.TopLevelComposition.R_CounterIn.CounterValue, system-signal=CounterIn
        data-element=SWC_ModifyEcho.TopLevelComposition.R_CounterIn_FD.CounterValue_FD, system-signal=CounterIn_CAN_FD
        data-element=SWC_CyclicCounter.TopLevelComposition.P_CounterOut_FD.CounterValue_FD, system-signal=CounterOut_CAN_FD
        data-element=SWC_Secured.TopLevelComposition.P_SecuredData.CounterValue, system-signal=SecuredDataIn
        data-element=SWC_Secured.TopLevelComposition.R_SecuredData.CounterValue, system-signal=SecuredDataOut
      pnc-mappings:
        pnc-group=[PN_CAN_IN, PN_CAN_OUT], pnc-identifier=16
        pnc-group=[PN_CANFD_IN, PN_CANFD_OUT], pnc-identifier=17
      sw-mappings:
        swc to ecu mapping EcuTestNodeMapping: ecu-instance=EcuTestNode
          component:
            TopLevelComposition.SWC_ModifyEcho
            TopLevelComposition.SWC_CyclicCounter
            TopLevelComposition.SWC_IoHwAbs
            TopLevelComposition.SWC_AppStateHandler
            TopLevelComposition.SWC_Secured
    root-software-compositions:
      root sw composition prototype TopLevelComposition: software-composition=TopLevelComposition
package /CanSystem/CLUSTERS
  can cluster CanNetwork: baudrate=500000, protocol-name=CAN, protocol-version=2.0, speed=100, can-fd-baudrate=500000
    can physical channel CanChannel: comm-connectors=[Conn_DebugNode, Conn_EcuTestNode]
      frame Pdu_CounterIn: id 0x100, from DebugNode, to EcuTestNode, frame-length=1, can-addressing-mode=STANDARD
        pdu Pdu_CounterIn: length=1, transmission-mode-condition{data-filter=data-filter-type=ALWAYS, i-signal-in-i-pdu=CounterIn}, transmission-mode-true-timing=event-controlled-timing={number-of-repetitions=1, repetition-period=1.0}, unused-bit-pattern=0
          signal CounterIn: start 0, 8 bit, little-endian, data-type-policy=PORT-INTERFACE-DEFINITION, implementation-data-type=uint8, to EcuTestNode
      frame Pdu_CounterOut: id 0x110, from EcuTestNode, to DebugNode, frame-length=1, can-addressing-mode=STANDARD
        pdu Pdu_CounterOut: length=1, transmission-mode-condition{data-filter=data-filter-type=ALWAYS, i-signal-in-i-pdu=CounterOut}, transmission-mode-true-timing=cyclic-timing=time-period=1.0, unused-bit-pattern=0
          signal CounterOut: start 0, 8 bit, little-endian, data-type-policy=PORT-INTERFACE-DEFINITION, implementation-data-type=uint8, to DebugNode
      frame USDT_CAN_Rx_Func: id 0x18DBFEF1, to EcuTestNode, frame-length=8, can-addressing-mode=EXTENDED
        carries pdu N_Pdu_USDT_CAN_Rx_Func_Tp: packing-byte-order=big-endian, start-position=7
        n pdu N_Pdu_USDT_CAN_Rx_Func_Tp: length=8
      frame USDT_CAN_Rx_Phys: id 0x18DAEBF1, to EcuTestNode, frame-length=8, can-addressing-mode=EXTENDED
        carries pdu N_Pdu_USDT_CAN_Rx_Phys_Tp: packing-byte-order=big-endian, start-position=7
        n pdu N_Pdu_USDT_CAN_Rx_Phys_Tp: length=8
      frame USDT_CAN_Tx: id 0x18DAF1EB, from EcuTestNode, frame-length=8, can-addressing-mode=EXTENDED
        carries pdu N_Pdu_USDT_CAN_Tx_Tp: packing-byte-order=big-endian, start-position=7
        n pdu N_Pdu_USDT_CAN_Tx_Tp: length=8
      frame UUDT_CAN_Tx: id 0x18DCF1EB, from EcuTestNode, frame-length=8, can-addressing-mode=EXTENDED
        carries pdu Dcm_Pdu_UUDT_CAN_Tx: packing-byte-order=big-endian, start-position=7
        dcm i pdu Dcm_Pdu_UUDT_CAN_Tx: length=8, diag-pdu-type=DIAG-RESPONSE
      frame USDT_CAN_FD_Rx_Func: id 0x18DBFEF2, to EcuTestNode, frame-length=64, can-addressing-mode=EXTENDED, can-frame-rx-behavior=CAN-FD
        carries pdu N_Pdu_USDT_CAN_FD_Rx_Func_Tp: packing-byte-order=big-endian, start-position=63
        n pdu N_Pdu_USDT_CAN_FD_Rx_Func_Tp: length=64
      frame USDT_CAN_FD_Rx_Phys: id 0x18DAEBF2, to EcuTestNode, frame-length=64, can-addressing-mode=EXTENDED, can-fd-frame-support=true, can-frame-rx-behavior=CAN-FD
        carries pdu N_Pdu_USDT_CAN_FD_Rx_Phys_Tp: packing-byte-order=big-endian, start-position=63
        n pdu N_Pdu_USDT_CAN_FD_Rx_Phys_Tp: length=64
      frame USDT_CAN_FD_Tx: id 0x18DAF2EB, from EcuTestNode, frame-length=64, can-addressing-mode=EXTENDED, can-fd-frame-support=true, can-frame-tx-behavior=CAN-FD
        carries pdu N_Pdu_USDT_CAN_FD_Tx_Tp: packing-byte-order=big-endian, start-position=63
        n pdu N_Pdu_USDT_CAN_FD_Tx_Tp: length=64
      frame UUDT_CAN_FD_Tx: id 0x18DCF2EB, from EcuTestNode, frame-length=64, can-addressing-mode=EXTENDED, can-fd-frame-support=true, can-frame-tx-behavior=CAN-FD
        carries pdu Dcm_Pdu_UUDT_CAN_FD_Tx: packing-byte-order=big-endian, start-position=63
        dcm i pdu Dcm_Pdu_UUDT_CAN_FD_Tx: length=64, diag-pdu-type=DIAG-RESPONSE
      frame Pdu_CounterIn_CAN_FD: id 0x101, to EcuTestNode, frame-length=64, can-addressing-mode=EXTENDED, can-fd-frame-support=true, can-frame-rx-behavior=CAN-FD
        pdu Pdu_CounterIn_CAN_FD: length=64, transmission-mode-condition{data-filter=data-filter-type=ALWAYS, i-signal-in-i-pdu=CounterIn_CAN_FD}, transmission-mode-true-timing=event-controlled-timing={number-of-repetitions=1, repetition-period=1.0}, unused-bit-pattern=55
          signal CounterIn_CAN_FD: start 0, 8 bit, little-endian, data-type-policy=PORT-INTERFACE-DEFINITION, implementation-data-type=uint8, to EcuTestNode
      frame Pdu_CounterOut_CAN_FD: id 0x111, from EcuTestNode, frame-length=64, can-addressing-mode=EXTENDED, can-fd-frame-support=true, can-frame-tx-behavior=CAN-FD
        pdu Pdu_CounterOut_CAN_FD: length=64, transmission-mode-condition{data-filter=data-filter-type=ALWAYS, i-signal-in-i-pdu=CounterOut_CAN_FD}, transmission-mode-true-timing=cyclic-timing=time-period=1.0, unused-bit-pattern=55
          signal CounterOut_CAN_FD: start 0, 8 bit, little-endian, data-type-policy=PORT-INTERFACE-DEFINITION, implementation-data-type=uint8
      frame Nm_Can_Rx: id 0x250, to EcuTestNode, frame-length=8, can-addressing-mode=STANDARD, can-fd-frame-support=false
        carries pdu Nm_Pdu_CanIn: packing-byte-order=big-endian, start-position=7
        nm pdu Nm_Pdu_CanIn: length=8, nm-data-information=true, nm-vote-information=true
          signal Nm_SignalIn: start 16, 8 bit, opaque, implementation-data-type=uint8, transfer-property=PENDING, to EcuTestNode
      frame Nm_Can_Tx: id 0x251, from EcuTestNode, frame-length=8, can-addressing-mode=STANDARD, can-fd-frame-support=false
        carries pdu Nm_Pdu_CanOut: packing-byte-order=big-endian, start-position=7
        nm pdu Nm_Pdu_CanOut: length=8, nm-data-information=true, nm-vote-information=true
          signal Nm_SignalOut: start 16, 8 bit, opaque, implementation-data-type=uint8
      frame Pdu_SecuredDataIn: id 0x105, to DebugNode EcuTestNode, can-addressing-mode=EXTENDED, can-fd-frame-support=true, can-frame-rx-behavior=CAN-FD
      frame Pdu_SecuredDataOut: id 0x115, from DebugNode EcuTestNode, can-addressing-mode=EXTENDED, can-fd-frame-support=true, can-frame-tx-behavior=CAN-FD
      frame CF_E2EProt_DataIn: id 0x118, to DebugNode EcuTestNode, can-addressing-mode=STANDARD, can-fd-frame-support=true
      frame CF_E2EProt_DataOut: id 0x11C, from DebugNode EcuTestNode, can-addressing-mode=STANDARD, can-fd-frame-support=true
      frame USDT_CAN_Rx_Func_OBD: id 0x7DF, to EcuTestNode, frame-length=8, can-addressing-mode=STANDARD, can-fd-frame-support=false
        carries pdu N_Pdu_USDT_CAN_Rx_Func_Tp_OBD: packing-byte-order=big-endian, start-position=7
        n pdu N_Pdu_USDT_CAN_Rx_Func_Tp_OBD: length=8
      frame USDT_CAN_Rx_Phys_OBD: id 0x7E0, to EcuTestNode, frame-length=8, can-addressing-mode=STANDARD
        carries pdu N_Pdu_USDT_CAN_Rx_Phys_Tp_OBD: packing-byte-order=big-endian, start-position=7
        n pdu N_Pdu_USDT_CAN_Rx_Phys_Tp_OBD: length=8
      frame USDT_CAN_Tx_OBD: id 0x7E8, from EcuTestNode, frame-length=8, can-addressing-mode=STANDARD, can-fd-frame-support=false
        carries pdu N_Pdu_USDT_CAN_Tx_Tp_OBD: packing-byte-order=big-endian, start-position=7
        n pdu N_Pdu_USDT_CAN_Tx_Tp_OBD: length=8
      frame UUDT_CAN_Tx_OBD: id 0x7E8, from EcuTestNode, frame-length=8, can-addressing-mode=STANDARD, can-fd-frame-support=false
        carries pdu Dcm_Pdu_UUDT_CAN_Tx_OBD: packing-byte-order=big-endian, start-position=7
        dcm i pdu Dcm_Pdu_UUDT_CAN_Tx_OBD: length=8, diag-pdu-type=DIAG-RESPONSE
      pdu triggering PT_USDT_CAN_Rx_Func: pdu=Dcm_Pdu_USDT_CAN_Rx_Func, to EcuTestNode
      pdu triggering PT_USDT_CAN_Rx_Phys: pdu=Dcm_Pdu_USDT_CAN_Rx_Phys, to EcuTestNode
      pdu triggering PT_USDT_CAN_Tx: pdu=Dcm_Pdu_USDT_CAN_Tx, from EcuTestNode
      pdu triggering PT_USDT_CAN_FD_Rx_Func: pdu=Dcm_Pdu_USDT_CAN_FD_Rx_Func, to EcuTestNode
      pdu triggering PT_USDT_CAN_FD_Rx_Phys: pdu=Dcm_Pdu_USDT_CAN_FD_Rx_Phys, to EcuTestNode
      pdu triggering PT_USDT_CAN_FD_Tx: pdu=Dcm_Pdu_USDT_CAN_FD_Tx, from EcuTestNode
      pdu triggering PT_Pdu_SecuredPayloadDataIn: pdu=Pdu_SecuredPayloadIn, to DebugNode EcuTestNode
      pdu triggering PT_Pdu_SecuredPayloadDataOut: pdu=Pdu_SecuredPayloadOut, from DebugNode EcuTestNode
      pdu triggering PT_Pdu_SecuredDataIn: pdu=Pdu_SecuredIn, from DebugNode, to EcuTestNode
      pdu triggering PT_Pdu_SecuredDataOut: pdu=Pdu_SecuredOut, from EcuTestNode, to DebugNode
      pdu triggering PT_Pdu_E2EProt_DataIn: pdu=ISIP_E2EProt_DataIn, to DebugNode EcuTestNode
      pdu triggering PT_Pdu_E2EProt_DataOut: pdu=ISIP_E2EProt_DataOut, from DebugNode EcuTestNode
      pdu triggering PT_USDT_CAN_Rx_Func_OBD: pdu=Dcm_Pdu_USDT_CAN_Rx_Func_OBD, to EcuTestNode
      pdu triggering PT_USDT_CAN_Rx_Phys_OBD: pdu=Dcm_Pdu_USDT_CAN_Rx_Phys_OBD, to EcuTestNode
      pdu triggering PT_USDT_CAN_Tx_OBD: pdu=Dcm_Pdu_USDT_CAN_Tx_OBD, from EcuTestNode
package /CanSystem/ECUINSTANCES
  ecu instance DebugNode: com-configuration-gw-time-base=0.005, com-configuration-rx-time-base=0.005, com-configuration-tx-time-base=0.005, com-enable-mdt-for-cyclic-transmission=false, sleep-mode-supported=false, wake-up-over-bus-supported=false
    can communication controller DebugNode
    can communication connector Conn_DebugNode: comm-controller=DebugNode
  ecu instance EcuTestNode: associated-com-i-pdu-group=[PN_CAN_OUT, PN_CAN_IN, PN_CANFD_IN, PN_CANFD_OUT], com-configuration-gw-time-base=0.005, com-configuration-rx-time-base=0.005, com-configuration-tx-time-base=0.005, com-enable-mdt-for-cyclic-transmission=true, sleep-mode-supported=false, wake-up-over-bus-supported=false
    can communication controller EcuTestNode
    can communication connector Conn_EcuTestNode: comm-controller=EcuTestNode, pnc-gateway-type=NONE, pnc-wakeup-can-id=512, pnc-wakeup-can-id-extended=false, pnc-wakeup-can-id-mask=0, pnc-wakeup-data-mask=196608, pnc-wakeup-dlc=0
package /CanSystem/PDUS/DCM_PDU_Package
  dcm i pdu Dcm_Pdu_USDT_CAN_Rx_Func: length=7, diag-pdu-type=DIAG-REQUEST
  dcm i pdu Dcm_Pdu_USDT_CAN_Rx_Phys: length=8, diag-pdu-type=DIAG-REQUEST
  dcm i pdu Dcm_Pdu_USDT_CAN_Tx: length=8, diag-pdu-type=DIAG-RESPONSE
  dcm i pdu Dcm_Pdu_USDT_CAN_FD_Rx_Func: length=63, diag-pdu-type=DIAG-REQUEST
  dcm i pdu Dcm_Pdu_USDT_CAN_FD_Rx_Phys: length=64, diag-pdu-type=DIAG-REQUEST
  dcm i pdu Dcm_Pdu_USDT_CAN_FD_Tx: length=64, diag-pdu-type=DIAG-RESPONSE
  dcm i pdu Dcm_Pdu_USDT_CAN_Rx_Func_OBD: length=7, diag-pdu-type=DIAG-REQUEST
  dcm i pdu Dcm_Pdu_USDT_CAN_Rx_Phys_OBD: length=8, diag-pdu-type=DIAG-REQUEST
  dcm i pdu Dcm_Pdu_USDT_CAN_Tx_OBD: length=8, diag-pdu-type=DIAG-RESPONSE
package /CanSystem/TP
  can tp config CanTpConfig: communication-cluster=CanNetwork, can-tp-ecu{cycle-time-main-function=0.005, ecu-instance=EcuTestNode}
    can tp address CAN_Tp_Addr_Tester: tp-address=241, tp-address-extension-value=0
    can tp address CAN_Tp_Addr_EcuTestNode: tp-address=235, tp-address-extension-value=0
    can tp channel CanTpChannel_0: channel-id=0, channel-mode=FULL-DUPLEX-MODE
    can-tp-connection addressing-format=STANDARD, can-tp-channel=CanTpChannel_0, data-pdu=N_Pdu_USDT_CAN_Rx_Func_Tp, max-block-size=0, padding-activation=true, receiver=CAN_Tp_Node_EcuTestNode, ta-type=FUNCTIONAL, timeout-br=0.1, timeout-bs=0.25, timeout-cr=0.25, timeout-cs=0.1, tp-sdu=Dcm_Pdu_USDT_CAN_Rx_Func, transmit-cancellation=false, transmitter=CAN_Tp_Node_Tester:
      ident CAN_FunctionalRx
    can-tp-connection addressing-format=STANDARD, can-tp-channel=CanTpChannel_0, data-pdu=N_Pdu_USDT_CAN_Rx_Phys_Tp, flow-control-pdu=N_Pdu_USDT_CAN_Tx_Tp, max-block-size=0, padding-activation=true, receiver=CAN_Tp_Node_EcuTestNode, ta-type=PHYSICAL, timeout-br=0.1, timeout-bs=0.25, timeout-cr=0.25, timeout-cs=0.1, tp-sdu=Dcm_Pdu_USDT_CAN_Rx_Phys, transmit-cancellation=false, transmitter=CAN_Tp_Node_Tester:
      ident CAN_PhysicalTx
    can-tp-connection addressing-format=STANDARD, can-tp-channel=CanTpChannel_0, data-pdu=N_Pdu_USDT_CAN_Tx_Tp, flow-control-pdu=N_Pdu_USDT_CAN_Rx_Phys_Tp, max-block-size=0, padding-activation=true, receiver=CAN_Tp_Node_Tester, ta-type=PHYSICAL, timeout-br=0.1, timeout-bs=0.25, timeout-cr=0.25, timeout-cs=0.1, tp-sdu=Dcm_Pdu_USDT_CAN_Tx, transmit-cancellation=false, transmitter=CAN_Tp_Node_EcuTestNode:
      ident CAN_PhysicalRes
    can-tp-connection addressing-format=STANDARD, can-tp-channel=CanTpChannel_0, data-pdu=N_Pdu_USDT_CAN_FD_Rx_Func_Tp, max-block-size=0, padding-activation=true, receiver=CAN_Tp_Node_EcuTestNode, ta-type=FUNCTIONAL, timeout-br=0.1, timeout-bs=0.25, timeout-cr=0.25, timeout-cs=0.1, tp-sdu=Dcm_Pdu_USDT_CAN_FD_Rx_Func, transmit-cancellation=false, transmitter=CAN_Tp_Node_Tester:
      ident CAN_FD_FunctionalRx
    can-tp-connection addressing-format=STANDARD, can-tp-channel=CanTpChannel_0, data-pdu=N_Pdu_USDT_CAN_FD_Rx_Phys_Tp, flow-control-pdu=N_Pdu_USDT_CAN_FD_Tx_Tp, max-block-size=0, padding-activation=true, receiver=CAN_Tp_Node_EcuTestNode, ta-type=PHYSICAL, timeout-br=0.1, timeout-bs=0.25, timeout-cr=0.25, timeout-cs=0.1, tp-sdu=Dcm_Pdu_USDT_CAN_FD_Rx_Phys, transmit-cancellation=false, transmitter=CAN_Tp_Node_Tester:
      ident CAN_FD_PhysicalTx
    can-tp-connection addressing-format=STANDARD, can-tp-channel=CanTpChannel_0, data-pdu=N_Pdu_USDT_CAN_FD_Tx_Tp, flow-control-pdu=N_Pdu_USDT_CAN_FD_Rx_Phys_Tp, max-block-size=0, padding-activation=true, receiver=CAN_Tp_Node_Tester, ta-type=PHYSICAL, timeout-br=0.1, timeout-bs=0.25, timeout-cr=0.25, timeout-cs=0.1, tp-sdu=Dcm_Pdu_USDT_CAN_FD_Tx, transmit-cancellation=false, transmitter=CAN_Tp_Node_EcuTestNode:
      ident CAN_FD_PhysicalRes
    can-tp-connection addressing-format=STANDARD, can-tp-channel=CanTpChannel_0, data-pdu=N_Pdu_USDT_CAN_Rx_Func_Tp_OBD, max-block-size=0, padding-activation=true, receiver=CAN_Tp_Node_EcuTestNode, ta-type=FUNCTIONAL, timeout-br=0.1, timeout-bs=0.25, timeout-cr=0.25, timeout-cs=0.1, tp-sdu=Dcm_Pdu_USDT_CAN_Rx_Func_OBD, transmit-cancellation=false, transmitter=CAN_Tp_Node_Tester:
      ident CAN_FunctionalRx_OBD
    can-tp-connection addressing-format=STANDARD, can-tp-channel=CanTpChannel_0, data-pdu=N_Pdu_USDT_CAN_Rx_Phys_Tp_OBD, flow-control-pdu=N_Pdu_USDT_CAN_Tx_Tp_OBD, max-block-size=0, padding-activation=true, receiver=CAN_Tp_Node_EcuTestNode, ta-type=PHYSICAL, timeout-br=0.1, timeout-bs=0.25, timeout-cr=0.25, timeout-cs=0.1, tp-sdu=Dcm_Pdu_USDT_CAN_Rx_Phys_OBD, transmit-cancellation=false, transmitter=CAN_Tp_Node_Tester:
      ident CAN_PhysicalTx_OBD
    can-tp-connection addressing-format=STANDARD, can-tp-channel=CanTpChannel_0, data-pdu=N_Pdu_USDT_CAN_Tx_Tp_OBD, flow-control-pdu=N_Pdu_USDT_CAN_Rx_Phys_Tp_OBD, max-block-size=0, padding-activation=true, receiver=CAN_Tp_Node_Tester, ta-type=PHYSICAL, timeout-br=0.1, timeout-bs=0.25, timeout-cr=0.25, timeout-cs=0.1, tp-sdu=Dcm_Pdu_USDT_CAN_Tx_OBD, transmit-cancellation=false, transmitter=CAN_Tp_Node_EcuTestNode:
      ident CAN_PhysicalRes_OBD
    can tp node CAN_Tp_Node_Tester: st-min=0.0, timeout-ar=0.25, timeout-as=0.25, tp-address=CAN_Tp_Addr_Tester
    can tp node CAN_Tp_Node_EcuTestNode: connector=Conn_EcuTestNode, max-fc-wait=0, st-min=0.0, timeout-ar=0.25, timeout-as=0.25, tp-address=CAN_Tp_Addr_EcuTestNode
package /CanSystem/NM
  nm config NmConfig: can-nm-cluster-coupling{coupled-cluster=CanNmCluster, nm-busload-reduction-enabled=false, nm-immediate-restart-enabled=false}
    can nm cluster CanNmCluster:
      communication-cluster=CanNetwork
      nm-channel-id=0
      nm-channel-sleep-master=false
      nm-synchronizing-network=false
      nm-busload-reduction-active=false
      nm-car-wake-up-filter-enabled=false
      nm-car-wake-up-rx-enabled=false
      nm-cbv-position=1
      nm-channel-active=false
      nm-immediate-nm-cycle-time=0.1
      nm-immediate-nm-transmissions=3
      nm-msg-cycle-time=0.64
      nm-network-timeout=2.0
      nm-nid-position=0
      nm-repeat-message-time=3.2
      nm-user-data-length=4
      nm-wait-bus-sleep-time=1.5
      can nm node EcuTestNode: controller=EcuTestNode, nm-if-ecu=EcuTestNode, nm-node-id=235, nm-passive-mode-enabled=false, rx-nm-pdu=Nm_Pdu_CanIn, tx-nm-pdu=Nm_Pdu_CanOut, nm-msg-cycle-offset=0.62, nm-msg-reduced-time=0.05, nm-range-config={lower-can-id=512, upper-can-id=767}
    nm-if-ecus:
      nm ecu EcuTestNode:
        bus-specific-nm-ecu=can-nm-ecu=nm-repeat-msg-indication-enabled=true
        ecu-instance=EcuTestNode
        nm-bus-synchronization-enabled=false
        nm-com-control-enabled=true
        nm-cycletime-main-function=0.02
        nm-node-detection-enabled=false
        nm-node-id-enabled=true
        nm-passive-mode-enabled=false
        nm-pdu-rx-indication-enabled=false
        nm-remote-sleep-ind-enabled=false
        nm-repeat-msg-ind-enabled=false
        nm-state-change-ind-enabled=false
        nm-user-data-enabled=true
package /CanSystem/PDU_GROUP
  4 x i signal i pdu group:
    PN_CAN_IN: communication-direction=IN, i-signal-i-pdus=[Pdu_CounterIn, ISIP_E2EProt_DataIn]
    PN_CAN_OUT: communication-direction=OUT, i-signal-i-pdus=[Pdu_CounterOut, ISIP_E2EProt_DataOut]
    PN_CANFD_IN: communication-direction=IN, i-signal-i-pdus=[Pdu_CounterIn_CAN_FD, Pdu_SecuredPayloadIn]
    PN_CANFD_OUT: communication-direction=OUT, i-signal-i-pdus=[Pdu_CounterOut_CAN_FD, Pdu_SecuredPayloadOut]
