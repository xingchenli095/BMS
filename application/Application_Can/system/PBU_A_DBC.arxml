AUTOSAR XML (schema 00050)
standard types defined: Boolean, Double, Double_dataConstr, Double_with_NaN, Float, Float_dataConstr, Float_with_NaN, SInt16, SInt16_dataConstr, SInt32, SInt32_dataConstr, SInt8, SInt8_dataConstr, UInt16, UInt16_dataConstr, UInt32, UInt32_dataConstr, UInt8, UInt8_dataConstr, float32, float64, sint16, sint32, sint8, uint16, uint32, uint8, boolean
package /AUTOSAR/DataTypes
  impl type CarMode_datatype: compu-method=CarMode_coding, range raw 0..255, implementation-data-type=uint8
  impl type CcfDD00GlobalRealTime_datatype: compu {phys=raw for raw 0..4294967295}, range raw 0..4294967295, implementation-data-type=uint32
  impl type CcfDD01TotalDistance_datatype: compu {phys=raw for raw 0..16777215}, range raw 0..4294967295, implementation-data-type=uint32
  impl type CcfDD02MainECUSupVolts_datatype: compu {phys=raw*0.25 for raw 0..255; unit Volts}, range raw 0..255, implementation-data-type=uint8
  impl type CcfDD04InCarTemp_datatype: compu {phys=raw-40 for raw 0..255; unit Deg C}, range raw 0..255, implementation-data-type=uint8
  impl type CcfDD05OutdoorTemp_datatype: compu {phys=raw-40 for raw 0..255; unit Deg C}, range raw 0..255, implementation-data-type=uint8
  impl type CcfDD06PowerModePKT_datatype: compu {phys=raw for raw 0..31}, range raw 0..255, implementation-data-type=uint8
  impl type Char16: implementation-data-type=uint8
  impl type Char8: implementation-data-type=uint8
  range Double_with_NaN_dataConstr: raw -INF..INF
  range Float_with_NaN_dataConstr: raw -INF..INF
  impl type GWMEL2Threshold_datatype: compu {phys=raw for raw 0..127}, range raw 0..255, implementation-data-type=uint8
  impl type GWMEL3Threshold_datatype: compu {phys=raw for raw 0..127}, range raw 0..255, implementation-data-type=uint8
  impl type GWMWakeUpToChargeThr_datatype: compu {phys=raw for raw 0..127}, range raw 0..255, implementation-data-type=uint8
  impl type OdometerMasterValue_UB_datatype: compu {phys=raw for raw 0..1}, implementation-data-type=boolean
  impl type OdometerMasterValue_datatype: compu {phys=raw for raw 0..16777215}, range raw 0..4294967295, implementation-data-type=uint32
  impl type PB1FETStatus_datatype: compu-method=PB1FETStatus_coding, range raw 0..255, implementation-data-type=uint8
  impl type PB2Degradation_datatype: compu-method=PB2Degradation_coding, range raw 0..255, implementation-data-type=uint8
  impl type PB2FETStatus_datatype: compu-method=PB2FETStatus_coding, range raw 0..255, implementation-data-type=uint8
  impl type PBAgeing_datatype: compu-method=PBAgeing_coding, implementation-data-type=boolean
  impl type PBAhChange_datatype: compu {phys=raw*0.01-100 for raw 0..32767; unit Ah}, range raw 0..65535, implementation-data-type=uint16
  impl type PBAliveCounter_datatype: compu {phys=raw for raw 0..15; unit sec}, range raw 0..255, implementation-data-type=uint8
  6 x impl type, all with category=TYPE_REFERENCE:
    PBBalActvCell1_datatype: compu {0=FALSE, 1=TRUE, phys=raw for raw 0..1}, implementation-data-type=boolean
    PBBalActvCell{2..4}_datatype: compu-method=PBBalActvCell{2..4}_coding, implementation-data-type=boolean
    PBBatCurrFlt_datatype: compu {0=Sensor_OK, 1=Sensor_fault, phys=raw for raw 0..1}, implementation-data-type=boolean
    PBBatCurr_datatype: compu {phys=raw*0.0625-511 for raw 0..16383; unit A}, range raw 0..65535, implementation-data-type=uint16
  impl type PBBatVoltFlt_datatype: compu-method=PBBatVoltFlt_coding, implementation-data-type=boolean
  impl type PBBatVolt_datatype: compu {phys=raw*0.1 for raw 0..255; unit V}, range raw 0..255, implementation-data-type=uint8
  impl type PBBattQd_datatype: compu {phys=raw*100 for raw 0..255; unit uA}, range raw 0..255, implementation-data-type=uint8
  impl type PBCell1VoltFlt_datatype: compu-method=PBCell1VoltFlt_coding, implementation-data-type=boolean
  impl type PBCell1Volt_datatype: compu {phys=raw*0.05 for raw 0..127; unit V}, range raw 0..255, implementation-data-type=uint8
  impl type PBCell2VoltFlt_datatype: compu-method=PBCell2VoltFlt_coding, implementation-data-type=boolean
  impl type PBCell2Volt_datatype: compu {phys=raw*0.05 for raw 0..127; unit V}, range raw 0..255, implementation-data-type=uint8
  impl type PBCell3VoltFlt_datatype: compu-method=PBCell3VoltFlt_coding, implementation-data-type=boolean
  impl type PBCell3Volt_datatype: compu {phys=raw*0.05 for raw 0..127; unit V}, range raw 0..255, implementation-data-type=uint8
  impl type PBCell4VoltFlt_datatype: compu-method=PBCell4VoltFlt_coding, implementation-data-type=boolean
  impl type PBCell4Volt_datatype: compu {phys=raw*0.05 for raw 0..127; unit V}, range raw 0..255, implementation-data-type=uint8
  impl type PBCpctyAbsolute_datatype: compu {phys=raw for raw 0..127; unit Ah}, range raw 0..255, implementation-data-type=uint8
  impl type PBCpctyRelative_datatype: compu {phys=raw for raw 0..127; unit Ah}, range raw 0..255, implementation-data-type=uint8
  impl type PBCriticErrGpAC_datatype: compu {phys=raw for raw 0..15; unit Counter value}, range raw 0..255, implementation-data-type=uint8
  impl type PBCriticErrGpCS_datatype: compu {phys=raw for raw 0..255; unit checksum}, range raw 0..255, implementation-data-type=uint8
  impl type PBCriticErrProtd_datatype: compu-method=PBCriticErrProtd_coding, range raw 0..255, implementation-data-type=uint8
  impl type PBCriticErr_datatype: compu-method=PBCriticErr_coding, range raw 0..255, implementation-data-type=uint8
  impl type PBDegradationGpAC_datatype: compu {phys=raw for raw 0..15; unit Counter value}, range raw 0..255, implementation-data-type=uint8
  impl type PBDegradationGpCS_datatype: compu {phys=raw for raw 0..255; unit checksum}, range raw 0..255, implementation-data-type=uint8
  impl type PBDegradation_datatype: compu-method=PBDegradation_coding, range raw 0..255, implementation-data-type=uint8
  4 x impl type:
    PBECUFlt_datatype: compu-method=PBECUFlt_coding, implementation-data-type=boolean
    PBECUSerial_datatype: category=ARRAY, compu {phys=raw for raw 0..1099511627775}
      element PBECUSerial_datatype: array-size=8, array-size-semantics=FIXED-SIZE, implementation-data-type=uint8
    PBErsoStatus_datatype: compu-method=PBErsoStatus_coding, implementation-data-type=boolean
    PBMaxChrgCurrLmt_datatype: compu {phys=raw for raw 0..511; unit A}, range raw 0..65535, implementation-data-type=uint16
  impl type PBMaxChrgVoltLmt_datatype: compu {phys=raw*0.1 for raw 0..255; unit V}, range raw 0..255, implementation-data-type=uint8
  impl type PBMaxDchgCurrLmt_datatype: compu {phys=raw for raw 0..511; unit A}, range raw 0..65535, implementation-data-type=uint16
  impl type PBMinBatCurr_datatype: compu {phys=raw*8 for raw 0..255; unit A}, range raw 0..255, implementation-data-type=uint8
  impl type PBMinBatVolt_datatype: compu {phys=raw*0.1 for raw 0..255; unit V}, range raw 0..255, implementation-data-type=uint8
  impl type PBMinCrnkSOCLmt_datatype: compu {phys=raw for raw 0..100; unit %}, range raw 0..255, implementation-data-type=uint8
  impl type PBPackVoltFlt_datatype: compu-method=PBPackVoltFlt_coding, implementation-data-type=boolean
  impl type PBPackVolt_datatype: compu {phys=raw*0.1 for raw 0..255; unit V}, range raw 0..255, implementation-data-type=uint8
  impl type PBParkingTime_datatype: compu {phys=raw for raw 0..127; unit days}, range raw 0..255, implementation-data-type=uint8
  impl type PBPos1TempFlt_datatype: compu-method=PBPos1TempFlt_coding, implementation-data-type=boolean
  impl type PBPos1Temp_datatype: compu {phys=raw-40 for raw 0..255; unit degC}, range raw 0..255, implementation-data-type=uint8
  impl type PBPos2TempFlt_datatype: compu-method=PBPos2TempFlt_coding, implementation-data-type=boolean
  impl type PBPos2Temp_datatype: compu {phys=raw-40 for raw 0..255; unit degC}, range raw 0..255, implementation-data-type=uint8
  impl type PBQChaRideCn_datatype: compu {phys=raw*0.0625 for raw 0..32767; unit Cn}, range raw 0..65535, implementation-data-type=uint16
  impl type PBQChaRunCn_datatype: compu {phys=raw*0.0625 for raw 0..32767; unit Cn}, range raw 0..65535, implementation-data-type=uint16
  impl type PBQDchActCn_datatype: compu {phys=raw*0.0625 for raw 0..32767; unit Cn}, range raw 0..65535, implementation-data-type=uint16
  impl type PBQDchActHiCn_datatype: compu {phys=raw*0.0625 for raw 0..32767; unit Cn}, range raw 0..65535, implementation-data-type=uint16
  impl type PBQDchEcoStpCn_datatype: compu {phys=raw*0.0625 for raw 0..32767; unit Cn}, range raw 0..65535, implementation-data-type=uint16
  impl type PBQDchQdCn_datatype: compu {phys=raw*0.01 for raw 0..32767; unit Cn}, range raw 0..65535, implementation-data-type=uint16
  impl type PBQDchaRideCn_datatype: compu {phys=raw*0.0625 for raw 0..32767; unit Cn}, range raw 0..65535, implementation-data-type=uint16
  impl type PBQDchaRunCn_datatype: compu {phys=raw*0.0625 for raw 0..32767; unit Cn}, range raw 0..65535, implementation-data-type=uint16
  impl type PBRelayClsFlt_datatype: compu {0=Not_failed, 1=Failed_closed, phys=raw for raw 0..1}, implementation-data-type=boolean
  impl type PBRelayOpenFlt_datatype: compu-method=PBRelayOpenFlt_coding, implementation-data-type=boolean
  impl type PBRelayStatus_datatype: compu {0=INIT, 1=CLOSE, 2=PRE_OPEN, 3=OPEN, phys=raw for raw 0..3}, range raw 0..255, implementation-data-type=uint8
  impl type PBSOHCapFade_datatype: compu {phys=raw for raw 0..100; unit %}, range raw 0..255, implementation-data-type=uint8
  impl type PBSOHImpGrowth_datatype: compu {phys=raw for raw 0..100; unit %}, range raw 0..255, implementation-data-type=uint8
  impl type PBSOHImpedanceAbs_datatype: compu {phys=raw for raw 0..63; unit mOhm}, range raw 0..255, implementation-data-type=uint8
  impl type PBSWVer_datatype: compu {phys=raw for raw 0..255}, range raw 0..255, implementation-data-type=uint8
  impl type PBSoCAbsolute_datatype: compu {phys=raw for raw 0..100; unit %}, range raw 0..255, implementation-data-type=uint8
  impl type PBSoCRelative_datatype: compu {phys=raw for raw 0..100; unit %}, range raw 0..255, implementation-data-type=uint8
  impl type PBTIS_datatype: compu {phys=raw for raw 0..8191; unit days}, range raw 0..65535, implementation-data-type=uint16
  impl type PBTOCReq_datatype: compu {0=PBTOCReq_coding_FALSE, 1=PBTOCReq_coding_TRUE, phys=raw for raw 0..1}, implementation-data-type=boolean
  impl type PBVehCount_datatype: compu {phys=raw for raw 0..31; unit Battery Count}, range raw 0..255, implementation-data-type=uint8
  impl type PBVehQd_datatype: compu {phys=raw for raw 0..255; unit mA}, range raw 0..255, implementation-data-type=uint8
  5 x impl type, all with category=TYPE_REFERENCE:
    PBWURLowChargeLmt_datatype: compu-method=PBWURLowChargeLmt_coding, implementation-data-type=boolean
    PBWURMinChargeLmt_datatype: compu-method=PBWURMinChargeLmt_coding, implementation-data-type=boolean
    PBWakeUpToChgReq_datatype: compu-method=PBWakeUpToChgReq_coding, implementation-data-type=boolean
    PBWakeupStat_datatype: compu-method=PBWakeupStat_coding, implementation-data-type=boolean
    PowerMode_datatype: compu-method=PowerMode_coding, range raw 0..255, implementation-data-type=uint8
  impl type PowerPackStatus_UB_datatype: compu {phys=raw for raw 0..1}, implementation-data-type=boolean
  impl type PowerPackStatus_datatype: compu-method=PowerPackStatus_coding, range raw 0..255, implementation-data-type=uint8
  impl type SBShortVehID_datatype: category=ARRAY, compu {phys=raw for raw 0..281474976710655}
    element SBShortVehID_datatype: array-size=8, array-size-semantics=FIXED-SIZE, implementation-data-type=uint8
  impl type SF_VEHCONFIG_400RIO_MUX_PDU_176_datatype: compu {phys=raw for raw 0..255}, range raw 0..255, implementation-data-type=uint8
  impl type SF_VEHCONFIG_400RIO_MUX_PDU_177_datatype: compu {phys=raw for raw 0..255}, range raw 0..255, implementation-data-type=uint8
  impl type SInt4: range raw -8..7, implementation-data-type=sint8
  impl type SOTAPrepRequest_datatype: compu-method=SOTAPrepRequest_coding, range raw 0..255, implementation-data-type=uint8
  impl type TST_FunctionalReq_RIO_PDU_datatype: category=ARRAY, compu {phys=raw for raw 0}
    element TST_FunctionalReq_RIO_PDU_datatype: array-size=8, array-size-semantics=FIXED-SIZE, implementation-data-type=uint8
  impl type TST_PhysicalReqPBU_RIO_PDU_datatype: category=ARRAY, compu {phys=raw for raw 0}
    element TST_PhysicalReqPBU_RIO_PDU_datatype: array-size=8, array-size-semantics=FIXED-SIZE, implementation-data-type=uint8
  impl type TST_PhysicalRespPBU_RIO_PDU_datatype: category=ARRAY, compu {phys=raw for raw 0}
    element TST_PhysicalRespPBU_RIO_PDU_datatype: array-size=8, array-size-semantics=FIXED-SIZE, implementation-data-type=uint8
  impl type UInt4: range raw 0..15, implementation-data-type=uint8
  impl type UInt8_n: category=ARRAY
    element UInt8_n: array-size=8, array-size-semantics=FIXED-SIZE, implementation-data-type=uint8
  impl type VehMovementChecksum_datatype: compu {phys=raw for raw 0..255; unit checksum}, range raw 0..255, implementation-data-type=uint8
  impl type VehMovementCounter_datatype: compu {phys=raw for raw 0..15; unit Counter value}, range raw 0..255, implementation-data-type=uint8
  impl type VehMovementDirection_datatype: compu-method=VehMovementDirection_coding, range raw 0..255, implementation-data-type=uint8
  impl type VehMovementStatus_datatype: compu {0=Vehicle_stationary, 1=Vehicle_moving, phys=raw for raw 0..1}, implementation-data-type=boolean
  impl type WheelDirectionFL_datatype: compu-method=WheelDirectionFL_coding, range raw 0..255, implementation-data-type=uint8
  impl type WheelDirectionFR_datatype: compu-method=WheelDirectionFR_coding, range raw 0..255, implementation-data-type=uint8
  impl type WheelDirectionRL_datatype: compu-method=WheelDirectionRL_coding, range raw 0..255, implementation-data-type=uint8
  impl type WheelDirectionRR_datatype: compu-method=WheelDirectionRR_coding, range raw 0..255, implementation-data-type=uint8
package /CanSystem
  system CanSystem
    root-software-compositions:
      root sw composition prototype TopLevelComposition: software-composition=TopLevelComposition
  nm config CanSystem_NmConfig: can-nm-cluster-coupling=coupled-cluster=CanNetwork_NmCluster
    can nm cluster CanNetwork_NmCluster: communication-cluster=CanNetwork
      can nm node PBU_NmNode: controller=PBU, nm-if-ecu=PBU_NmEcu
    nm-if-ecus:
      nm ecu PBU_NmEcu: ecu-instance=PBU
package /CanSystem/CLUSTERS
  can cluster CanNetwork
    can physical channel CanChannel: comm-connectors=Conn_PBU
      frame EVC_BCMA_PR1_Rio_10ms: id 0x4E, to PBU, frame-length=64, can-addressing-mode=STANDARD, can-fd-frame-support=false
        pdu EVC_BCMA_PR1_Rio_10ms: length=64, unused-bit-pattern=255
          mapping VehMovement: i-signal-group=VehMovement
          signal VehMovementChecksum: start 151, 8 bit, big-endian, base-type=uint8, compu {phys=raw for raw 0..255; unit checksum}, implementation-data-type=VehMovementChecksum_datatype, to PBU
          signal VehMovementCounter: start 155, 4 bit, big-endian, base-type=uint8, compu {phys=raw for raw 0..15; unit Counter value}, implementation-data-type=VehMovementCounter_datatype, to PBU
          signal VehMovementDirection: start 157, 2 bit, big-endian, base-type=uint8, compu-method=VehMovementDirection_coding, implementation-data-type=VehMovementDirection_datatype, to PBU
          signal VehMovementStatus: start 161, 1 bit, big-endian, base-type=uint8, compu {0=Vehicle_stationary, 1=Vehicle_moving, phys=raw for raw 0..1}, implementation-data-type=VehMovementStatus_datatype, to PBU
          signal WheelDirectionFL: start 163, 2 bit, big-endian, base-type=uint8, compu-method=WheelDirectionFL_coding, implementation-data-type=WheelDirectionFL_datatype, to PBU
          signal WheelDirectionFR: start 165, 2 bit, big-endian, base-type=uint8, compu-method=WheelDirectionFR_coding, implementation-data-type=WheelDirectionFR_datatype, to PBU
          signal WheelDirectionRL: start 167, 2 bit, big-endian, base-type=uint8, compu-method=WheelDirectionRL_coding, implementation-data-type=WheelDirectionRL_datatype, to PBU
          signal WheelDirectionRR: start 159, 2 bit, big-endian, base-type=uint8, compu-method=WheelDirectionRR_coding, implementation-data-type=WheelDirectionRR_datatype, to PBU
      frame EVC_BCMA_PR1_Rio_20ms: id 0x7A, to PBU, frame-length=64, can-addressing-mode=STANDARD, can-fd-frame-support=false
        pdu EVC_BCMA_PR1_Rio_20ms: length=64, unused-bit-pattern=255
          signal PowerPackStatus: start 39, 4 bit, big-endian, base-type=uint8, compu-method=PowerPackStatus_coding, implementation-data-type=PowerPackStatus_datatype, to PBU
          signal PowerPackStatus_UB: start 49, 1 bit, big-endian, base-type=uint8, compu {phys=raw for raw 0..1}, implementation-data-type=PowerPackStatus_UB_datatype, to PBU
      frame EVC_BCMA_PR1_Rio_40ms: id 0xA5, to PBU, frame-length=64, can-addressing-mode=STANDARD, can-fd-frame-support=false
        pdu EVC_BCMA_PR1_Rio_40ms: length=64, unused-bit-pattern=255
          signal CarMode: start 27, 4 bit, big-endian, base-type=uint8, compu-method=CarMode_coding, implementation-data-type=CarMode_datatype, to PBU
          signal PowerMode: start 20, 5 bit, big-endian, base-type=uint8, compu-method=PowerMode_coding, implementation-data-type=PowerMode_datatype, to PBU
      frame EVC_BCMA_PR1_Rio_80ms: id 0x106, to PBU, frame-length=64, can-addressing-mode=STANDARD, can-fd-frame-support=false
        pdu EVC_BCMA_PR1_Rio_80ms: length=64, unused-bit-pattern=255
          signal GWMEL2Threshold: start 86, 7 bit, big-endian, base-type=uint8, compu {phys=raw for raw 0..127}, implementation-data-type=GWMEL2Threshold_datatype, to PBU
          signal GWMEL3Threshold: start 94, 7 bit, big-endian, base-type=uint8, compu {phys=raw for raw 0..127}, implementation-data-type=GWMEL3Threshold_datatype, to PBU
          signal GWMWakeUpToChargeThr: start 102, 7 bit, big-endian, base-type=uint8, compu {phys=raw for raw 0..127}, implementation-data-type=GWMWakeUpToChargeThr_datatype, to PBU
          signal OdometerMasterValue: start 159, 24 bit, big-endian, base-type=uint32, compu {phys=raw for raw 0..16777215}, implementation-data-type=OdometerMasterValue_datatype, to PBU
          signal OdometerMasterValue_UB: start 151, 1 bit, big-endian, base-type=uint8, compu {phys=raw for raw 0..1}, implementation-data-type=OdometerMasterValue_UB_datatype, to PBU
          signal SBShortVehID: start 32, 48 bit, little-endian, compu {phys=raw for raw 0..281474976710655}, implementation-data-type=SBShortVehID_datatype, to PBU
      frame EVC_BCMA_PR2_Rio_80ms: id 0x10B, to PBU, frame-length=64, can-addressing-mode=STANDARD, can-fd-frame-support=false
        pdu EVC_BCMA_PR2_Rio_80ms: length=64, unused-bit-pattern=255
          signal SOTAPrepRequest: start 81, 2 bit, big-endian, base-type=uint8, compu-method=SOTAPrepRequest_coding, implementation-data-type=SOTAPrepRequest_datatype, to PBU
      frame EVC_PBU_PR1_Rio_40ms: id 0xAC, from PBU, frame-length=64, can-addressing-mode=STANDARD, can-fd-frame-support=false
        pdu EVC_PBU_PR1_Rio_40ms: length=64, unused-bit-pattern=255
          signal PB1FETStatus: start 31, 3 bit, big-endian, base-type=uint8, compu-method=PB1FETStatus_coding, implementation-data-type=PB1FETStatus_datatype
          signal PB2Degradation: start 28, 3 bit, big-endian, base-type=uint8, compu-method=PB2Degradation_coding, implementation-data-type=PB2Degradation_datatype
          signal PB2FETStatus: start 20, 3 bit, big-endian, base-type=uint8, compu-method=PB2FETStatus_coding, implementation-data-type=PB2FETStatus_datatype
          signal PBBatCurr: start 71, 14 bit, big-endian, base-type=uint16, compu {phys=raw*0.0625-511 for raw 0..16383; unit A}, implementation-data-type=PBBatCurr_datatype
          signal PBBatCurrFlt: start 73, 1 bit, big-endian, base-type=uint8, compu {0=Sensor_OK, 1=Sensor_fault, phys=raw for raw 0..1}, implementation-data-type=PBBatCurrFlt_datatype
          signal PBBatVolt: start 87, 8 bit, big-endian, base-type=uint8, compu {phys=raw*0.1 for raw 0..255; unit V}, implementation-data-type=PBBatVolt_datatype
          signal PBBatVoltFlt: start 72, 1 bit, big-endian, base-type=uint8, compu-method=PBBatVoltFlt_coding, implementation-data-type=PBBatVoltFlt_datatype
          signal PBCriticErr: start 63, 8 bit, big-endian, base-type=uint8, compu-method=PBCriticErr_coding, implementation-data-type=PBCriticErr_datatype
          mapping PBCriticErrGp: i-signal-group=PBCriticErrGp
          signal PBCriticErrGpAC: start 43, 4 bit, big-endian, base-type=uint8, compu {phys=raw for raw 0..15; unit Counter value}, implementation-data-type=PBCriticErrGpAC_datatype
          signal PBCriticErrGpCS: start 39, 8 bit, big-endian, base-type=uint8, compu {phys=raw for raw 0..255; unit checksum}, implementation-data-type=PBCriticErrGpCS_datatype
          signal PBCriticErrProtd: start 55, 8 bit, big-endian, base-type=uint8, compu-method=PBCriticErrProtd_coding, implementation-data-type=PBCriticErrProtd_datatype
          signal PBDegradation: start 23, 3 bit, big-endian, base-type=uint8, compu-method=PBDegradation_coding, implementation-data-type=PBDegradation_datatype
          mapping PBDegradationGp: i-signal-group=PBDegradationGp
          signal PBDegradationGpAC: start 11, 4 bit, big-endian, base-type=uint8, compu {phys=raw for raw 0..15; unit Counter value}, implementation-data-type=PBDegradationGpAC_datatype
          signal PBDegradationGpCS: start 7, 8 bit, big-endian, base-type=uint8, compu {phys=raw for raw 0..255; unit checksum}, implementation-data-type=PBDegradationGpCS_datatype
          signal PBMaxChrgCurrLmt: start 103, 9 bit, big-endian, base-type=uint16, compu {phys=raw for raw 0..511; unit A}, implementation-data-type=PBMaxChrgCurrLmt_datatype
          signal PBMaxChrgVoltLmt: start 95, 8 bit, big-endian, base-type=uint8, compu {phys=raw*0.1 for raw 0..255; unit V}, implementation-data-type=PBMaxChrgVoltLmt_datatype
          signal PBMaxDchgCurrLmt: start 110, 9 bit, big-endian, base-type=uint16, compu {phys=raw for raw 0..511; unit A}, implementation-data-type=PBMaxDchgCurrLmt_datatype
      frame EVC_PBU_PR1_Rio_Pdu_100ms: id 0x143, from PBU, frame-length=64, can-addressing-mode=STANDARD, can-fd-frame-support=false
        pdu EVC_PBU_PR1_Rio_Pdu_100ms: length=64, unused-bit-pattern=255
          signal PBAgeing: start 8, 1 bit, big-endian, base-type=uint8, compu-method=PBAgeing_coding, implementation-data-type=PBAgeing_datatype
          signal PBAhChange: start 7, 15 bit, big-endian, base-type=uint16, compu {phys=raw*0.01-100 for raw 0..32767; unit Ah}, implementation-data-type=PBAhChange_datatype
          signal PBAliveCounter: start 59, 4 bit, big-endian, base-type=uint8, compu {phys=raw for raw 0..15; unit sec}, implementation-data-type=PBAliveCounter_datatype
          signal PBBalActvCell1: start 60, 1 bit, big-endian, base-type=uint8, compu {0=FALSE, 1=TRUE, phys=raw for raw 0..1}, implementation-data-type=PBBalActvCell1_datatype
          signal PBBalActvCell2: start 61, 1 bit, big-endian, base-type=uint8, compu-method=PBBalActvCell2_coding, implementation-data-type=PBBalActvCell2_datatype
          signal PBBalActvCell3: start 62, 1 bit, big-endian, base-type=uint8, compu-method=PBBalActvCell3_coding, implementation-data-type=PBBalActvCell3_datatype
          signal PBBalActvCell4: start 63, 1 bit, big-endian, base-type=uint8, compu-method=PBBalActvCell4_coding, implementation-data-type=PBBalActvCell4_datatype
          signal PBBattQd: start 55, 8 bit, big-endian, base-type=uint8, compu {phys=raw*100 for raw 0..255; unit uA}, implementation-data-type=PBBattQd_datatype
          signal PBCell1Volt: start 22, 7 bit, big-endian, base-type=uint8, compu {phys=raw*0.05 for raw 0..127; unit V}, implementation-data-type=PBCell1Volt_datatype
          signal PBCell1VoltFlt: start 23, 1 bit, big-endian, base-type=uint8, compu-method=PBCell1VoltFlt_coding, implementation-data-type=PBCell1VoltFlt_datatype
          signal PBCell2Volt: start 30, 7 bit, big-endian, base-type=uint8, compu {phys=raw*0.05 for raw 0..127; unit V}, implementation-data-type=PBCell2Volt_datatype
          signal PBCell2VoltFlt: start 31, 1 bit, big-endian, base-type=uint8, compu-method=PBCell2VoltFlt_coding, implementation-data-type=PBCell2VoltFlt_datatype
          signal PBCell3Volt: start 38, 7 bit, big-endian, base-type=uint8, compu {phys=raw*0.05 for raw 0..127; unit V}, implementation-data-type=PBCell3Volt_datatype
          signal PBCell3VoltFlt: start 39, 1 bit, big-endian, base-type=uint8, compu-method=PBCell3VoltFlt_coding, implementation-data-type=PBCell3VoltFlt_datatype
          signal PBCell4Volt: start 46, 7 bit, big-endian, base-type=uint8, compu {phys=raw*0.05 for raw 0..127; unit V}, implementation-data-type=PBCell4Volt_datatype
          signal PBCell4VoltFlt: start 47, 1 bit, big-endian, base-type=uint8, compu-method=PBCell4VoltFlt_coding, implementation-data-type=PBCell4VoltFlt_datatype
          signal PBCpctyAbsolute: start 70, 7 bit, big-endian, base-type=uint8, compu {phys=raw for raw 0..127; unit Ah}, implementation-data-type=PBCpctyAbsolute_datatype
          signal PBCpctyRelative: start 78, 7 bit, big-endian, base-type=uint8, compu {phys=raw for raw 0..127; unit Ah}, implementation-data-type=PBCpctyRelative_datatype
          signal PBECUFlt: start 79, 1 bit, big-endian, base-type=uint8, compu-method=PBECUFlt_coding, implementation-data-type=PBECUFlt_datatype
          signal PBECUSerial: start 336, 40 bit, little-endian, compu {phys=raw for raw 0..1099511627775}, implementation-data-type=PBECUSerial_datatype
          signal PBErsoStatus: start 71, 1 bit, big-endian, base-type=uint8, compu-method=PBErsoStatus_coding, implementation-data-type=PBErsoStatus_datatype
          signal PBMinBatCurr: start 87, 8 bit, big-endian, base-type=uint8, compu {phys=raw*8 for raw 0..255; unit A}, implementation-data-type=PBMinBatCurr_datatype
          signal PBMinBatVolt: start 95, 8 bit, big-endian, base-type=uint8, compu {phys=raw*0.1 for raw 0..255; unit V}, implementation-data-type=PBMinBatVolt_datatype
          signal PBMinCrnkSOCLmt: start 110, 7 bit, big-endian, base-type=uint8, compu {phys=raw for raw 0..100; unit %}, implementation-data-type=PBMinCrnkSOCLmt_datatype
          signal PBPackVolt: start 103, 8 bit, big-endian, base-type=uint8, compu {phys=raw*0.1 for raw 0..255; unit V}, implementation-data-type=PBPackVolt_datatype
          signal PBPackVoltFlt: start 111, 1 bit, big-endian, base-type=uint8, compu-method=PBPackVoltFlt_coding, implementation-data-type=PBPackVoltFlt_datatype
          signal PBParkingTime: start 118, 7 bit, big-endian, base-type=uint8, compu {phys=raw for raw 0..127; unit days}, implementation-data-type=PBParkingTime_datatype
          signal PBPos1Temp: start 127, 8 bit, big-endian, base-type=uint8, compu {phys=raw-40 for raw 0..255; unit degC}, implementation-data-type=PBPos1Temp_datatype
          signal PBPos1TempFlt: start 119, 1 bit, big-endian, base-type=uint8, compu-method=PBPos1TempFlt_coding, implementation-data-type=PBPos1TempFlt_datatype
          signal PBPos2Temp: start 135, 8 bit, big-endian, base-type=uint8, compu {phys=raw-40 for raw 0..255; unit degC}, implementation-data-type=PBPos2Temp_datatype
          signal PBPos2TempFlt: start 143, 1 bit, big-endian, base-type=uint8, compu-method=PBPos2TempFlt_coding, implementation-data-type=PBPos2TempFlt_datatype
          signal PBQChaRideCn: start 142, 15 bit, big-endian, base-type=uint16, compu {phys=raw*0.0625 for raw 0..32767; unit Cn}, implementation-data-type=PBQChaRideCn_datatype
          signal PBQChaRunCn: start 159, 15 bit, big-endian, base-type=uint16, compu {phys=raw*0.0625 for raw 0..32767; unit Cn}, implementation-data-type=PBQChaRunCn_datatype
          signal PBQDchActCn: start 160, 15 bit, big-endian, base-type=uint16, compu {phys=raw*0.0625 for raw 0..32767; unit Cn}, implementation-data-type=PBQDchActCn_datatype
          signal PBQDchActHiCn: start 177, 15 bit, big-endian, base-type=uint16, compu {phys=raw*0.0625 for raw 0..32767; unit Cn}, implementation-data-type=PBQDchActHiCn_datatype
          signal PBQDchEcoStpCn: start 228, 15 bit, big-endian, base-type=uint16, compu {phys=raw*0.0625 for raw 0..32767; unit Cn}, implementation-data-type=PBQDchEcoStpCn_datatype
          signal PBQDchQdCn: start 245, 15 bit, big-endian, base-type=uint16, compu {phys=raw*0.01 for raw 0..32767; unit Cn}, implementation-data-type=PBQDchQdCn_datatype
          signal PBQDchaRideCn: start 194, 15 bit, big-endian, base-type=uint16, compu {phys=raw*0.0625 for raw 0..32767; unit Cn}, implementation-data-type=PBQDchaRideCn_datatype
          signal PBQDchaRunCn: start 211, 15 bit, big-endian, base-type=uint16, compu {phys=raw*0.0625 for raw 0..32767; unit Cn}, implementation-data-type=PBQDchaRunCn_datatype
          signal PBRelayClsFlt: start 279, 1 bit, big-endian, base-type=uint8, compu {0=Not_failed, 1=Failed_closed, phys=raw for raw 0..1}, implementation-data-type=PBRelayClsFlt_datatype
          signal PBRelayOpenFlt: start 287, 1 bit, big-endian, base-type=uint8, compu-method=PBRelayOpenFlt_coding, implementation-data-type=PBRelayOpenFlt_datatype
          signal PBRelayStatus: start 265, 2 bit, big-endian, base-type=uint8, compu {0=INIT, 1=CLOSE, 2=PRE_OPEN, 3=OPEN, phys=raw for raw 0..3}, implementation-data-type=PBRelayStatus_datatype
          signal PBSOHCapFade: start 294, 7 bit, big-endian, base-type=uint8, compu {phys=raw for raw 0..100; unit %}, implementation-data-type=PBSOHCapFade_datatype
          signal PBSOHImpGrowth: start 318, 7 bit, big-endian, base-type=uint8, compu {phys=raw for raw 0..100; unit %}, implementation-data-type=PBSOHImpGrowth_datatype
          signal PBSOHImpedanceAbs: start 325, 6 bit, big-endian, base-type=uint8, compu {phys=raw for raw 0..63; unit mOhm}, implementation-data-type=PBSOHImpedanceAbs_datatype
          signal PBSWVer: start 303, 8 bit, big-endian, base-type=uint8, compu {phys=raw for raw 0..255}, implementation-data-type=PBSWVer_datatype
          signal PBSoCAbsolute: start 278, 7 bit, big-endian, base-type=uint8, compu {phys=raw for raw 0..100; unit %}, implementation-data-type=PBSoCAbsolute_datatype
          signal PBSoCRelative: start 286, 7 bit, big-endian, base-type=uint8, compu {phys=raw for raw 0..100; unit %}, implementation-data-type=PBSoCRelative_datatype
          signal PBTIS: start 262, 13 bit, big-endian, base-type=uint16, compu {phys=raw for raw 0..8191; unit days}, implementation-data-type=PBTIS_datatype
          signal PBTOCReq: start 295, 1 bit, big-endian, base-type=uint8, compu {0=PBTOCReq_coding_FALSE, 1=PBTOCReq_coding_TRUE, phys=raw for raw 0..1}, implementation-data-type=PBTOCReq_datatype
          signal PBVehCount: start 332, 5 bit, big-endian, base-type=uint8, compu {phys=raw for raw 0..31; unit Battery Count}, implementation-data-type=PBVehCount_datatype
          signal PBVehQd: start 311, 8 bit, big-endian, base-type=uint8, compu {phys=raw for raw 0..255; unit mA}, implementation-data-type=PBVehQd_datatype
          signal PBWURLowChargeLmt: start 327, 1 bit, big-endian, base-type=uint8, compu-method=PBWURLowChargeLmt_coding, implementation-data-type=PBWURLowChargeLmt_datatype
          signal PBWURMinChargeLmt: start 333, 1 bit, big-endian, base-type=uint8, compu-method=PBWURMinChargeLmt_coding, implementation-data-type=PBWURMinChargeLmt_datatype
          signal PBWakeUpToChgReq: start 326, 1 bit, big-endian, base-type=uint8, compu-method=PBWakeUpToChgReq_coding, implementation-data-type=PBWakeUpToChgReq_datatype
          signal PBWakeupStat: start 319, 1 bit, big-endian, base-type=uint8, compu-method=PBWakeupStat_coding, implementation-data-type=PBWakeupStat_datatype
      frame TST_FunctionalReq_RIOBus: id 0x7DF, to PBU, frame-length=8, can-addressing-mode=STANDARD, can-fd-frame-support=false
        pdu TST_FunctionalReq_RIOBus: length=8, unused-bit-pattern=255
          signal TST_FunctionalReq_RIO_PDU: start 7, 64 bit, big-endian, compu {phys=raw for raw 0}, implementation-data-type=TST_FunctionalReq_RIO_PDU_datatype, to PBU
      frame TST_PhysicalReqPBU_RIO: id 0x777, to PBU, frame-length=64, can-addressing-mode=STANDARD, can-fd-frame-support=false
        pdu TST_PhysicalReqPBU_RIO: length=64, unused-bit-pattern=255
          signal TST_PhysicalReqPBU_RIO_PDU: start 7, 512 bit, big-endian, compu {phys=raw for raw 0}, implementation-data-type=TST_PhysicalReqPBU_RIO_PDU_datatype, to PBU
      frame TST_PhysicalRespPBU_RIO: id 0x77F, from PBU, frame-length=64, can-addressing-mode=STANDARD, can-fd-frame-support=false
        pdu TST_PhysicalRespPBU_RIO: length=64, unused-bit-pattern=255
          signal TST_PhysicalRespPBU_RIO_PDU: start 7, 512 bit, big-endian, compu {phys=raw for raw 0}, implementation-data-type=TST_PhysicalRespPBU_RIO_PDU_datatype
      frame VEHCONFIG_400RIO_MUX: id 0x400, to PBU, frame-length=8, can-addressing-mode=STANDARD, can-fd-frame-support=false
        multiplexed i pdu VEHCONFIG_400RIO_MUX: length=8, dynamic-part{segment-position{segment-byte-order=little-endian, segment-length=53, segment-position=0}, dynamic-part-alternatives=[{i-pdu=VEHCONFIG_400RIO_MUX_176, selector-field-code=176}, {i-pdu=VEHCONFIG_400RIO_MUX_177, selector-field-code=177}]}, selector-field-byte-order=little-endian, selector-field-length=8, selector-field-start-position=0
      pdu triggering PT_VEHCONFIG_400RIO_MUX_176: pdu=VEHCONFIG_400RIO_MUX_176, to PBU
      pdu triggering PT_VEHCONFIG_400RIO_MUX_177: pdu=VEHCONFIG_400RIO_MUX_177, to PBU
package /CanSystem/COMPUMETHODS
  compu method CarMode_coding: 0=Normal, 1=Factory, 2=Unused2, 3=Transport, 4=Unused4, phys=raw for raw 0..15
  compu method PB1FETStatus_coding: 0=All_gates_closed, 1=Discharge_Gate_Pre_Open, 2=Discharge_Gate_Open, 3=Charge_Gate_Pre_Open, 4=Charge_Gate_Open, phys=raw for raw 0..7
  compu method PB2Degradation_coding: 0=No_Fault, 1=Temporary_battery_Fault, 2=Permanenet_battery_Fault, 3=Low_SOC_Warning_Level_1, 4=Critical_SOC_Warning_Level_2, 5=Critical_Low_temperature_Level_2, phys=raw for raw 0..7
  compu method PB2FETStatus_coding: 0=PB2FETStatus_coding_All_gates_closed, 1=PB2FETStatus_coding_Discharge_Gate_Pre_Open, 2=PB2FETStatus_coding_Discharge_Gate_Open, 3=PB2FETStatus_coding_Charge_Gate_Pre_Open, 4=PB2FETStatus_coding_Charge_Gate_Open, phys=raw for raw 0..7
  compu method PBAgeing_coding: 0=Battery_has_NOT_reached_any_of_the_4_defined_milestones, 1=Battery_has_reached_the_point_where___1__capacity_fade_is_greater_than_34___it_s_been__2__10_years_or__3__150_000_miles_in_service_or__4__the_relay_counter_damage_has_exceeded_60, phys=raw for raw 0..1
  compu method PBBalActvCell{2..4}_coding: 0=PBBalActvCell{2..4}_coding_FALSE, 1=PBBalActvCell{2..4}_coding_TRUE, phys=raw for raw 0..1
  compu method PBBatVoltFlt_coding: 0=PBBatVoltFlt_coding_Sensor_OK, 1=PBBatVoltFlt_coding_Sensor_fault, phys=raw for raw 0..1
  compu method PBCell{1..4}VoltFlt_coding: 0=PBCell{1..4}VoltFlt_coding_Sensor_OK, 1=PBCell{1..4}VoltFlt_coding_Sensor_fault, phys=raw for raw 0..1
  compu method PBCriticErrProtd_coding: 0=PBCriticErrProtd_coding_No_Fault, 1=PBCriticErrProtd_coding_Over_Voltage_Error_Level_1, 2=PBCriticErrProtd_coding_Over_Voltage_Error_Level_2, 3=PBCriticErrProtd_coding_Over_Voltage_Error_Level_3, 4=PBCriticErrProtd_coding_Low_Voltage_Error_Level_1, 5=PBCriticErrProtd_coding_Low_Voltage_Error_Level_2, 6=PBCriticErrProtd_coding_Low_Voltage_Error_Level_3, 7=PBCriticErrProtd_coding_High_Temperature_Error_Level, 8=PBCriticErrProtd_coding_Over_Charge_Current_Error_Level_2, 9=PBCriticErrProtd_coding_Over_Discharge_Current_Error_Level_2, 10=PBCriticErrProtd_coding_Over_Discharge_Current_Error_Level_3, 11=PBCriticErrProtd_coding_Relay_Open__External_Short_Circuit_, phys=raw for raw 0..255
  compu method PBCriticErr_coding: 0=PBCriticErr_coding_No_Fault, 1=PBCriticErr_coding_Over_Voltage_Error_Level_1, 2=PBCriticErr_coding_Over_Voltage_Error_Level_2, 3=PBCriticErr_coding_Over_Voltage_Error_Level_3, 4=PBCriticErr_coding_Low_Voltage_Error_Level_1, 5=PBCriticErr_coding_Low_Voltage_Error_Level_2, 6=PBCriticErr_coding_Low_Voltage_Error_Level_3, 7=PBCriticErr_coding_High_Temperature_Error_Level, 8=PBCriticErr_coding_Over_Charge_Current_Error_Level_2, 9=PBCriticErr_coding_Over_Discharge_Current_Error_Level_2, 10=PBCriticErr_coding_Over_Discharge_Current_Error_Level_3, 11=PBCriticErr_coding_Relay_Open__External_Short_Circuit_, phys=raw for raw 0..255
  compu method PBDegradation_coding: 0=PBDegradation_coding_No_Fault, 1=PBDegradation_coding_Temporary_battery_Fault, 2=PBDegradation_coding_Permanenet_battery_Fault, 3=PBDegradation_coding_Low_SOC_Warning_Level_1, 4=PBDegradation_coding_Critical_SOC_Warning_Level_2, 5=PBDegradation_coding_Critical_Low_temperature_Level_2, phys=raw for raw 0..7
  compu method PBECUFlt_coding: 0=PBECUFlt_coding_No_Fault, 1=PBECUFlt_coding_ECU_Fault, phys=raw for raw 0..1
  compu method PBErsoStatus_coding: 0=ERSO_has_not_been_triggered, 1=ERSO_was_triggered_in_the_last_sleep_period, phys=raw for raw 0..1
  compu method PBPackVoltFlt_coding: 0=PBPackVoltFlt_coding_Sensor_OK, 1=PBPackVoltFlt_coding_Sensor_fault, phys=raw for raw 0..1
  compu method PBPos1TempFlt_coding: 0=PBPos1TempFlt_coding_Sensor_OK, 1=PBPos1TempFlt_coding_Sensor_fault, phys=raw for raw 0..1
  compu method PBPos2TempFlt_coding: 0=PBPos2TempFlt_coding_Sensor_OK, 1=PBPos2TempFlt_coding_Sensor_fault, phys=raw for raw 0..1
  compu method PBRelayOpenFlt_coding: 0=PBRelayOpenFlt_coding_Not_failed, 1=PBRelayOpenFlt_coding_Failed_open, phys=raw for raw 0..1
  compu method PBWURLowChargeLmt_coding: 0=PBWURLowChargeLmt_coding_FALSE, 1=PBWURLowChargeLmt_coding_TRUE, phys=raw for raw 0..1
  compu method PBWURMinChargeLmt_coding: 0=PBWURMinChargeLmt_coding_FALSE, 1=PBWURMinChargeLmt_coding_TRUE, phys=raw for raw 0..1
  compu method PBWakeUpToChgReq_coding: 0=PBWakeUpToChgReq_coding_FALSE, 1=PBWakeUpToChgReq_coding_TRUE, phys=raw for raw 0..1
  compu method PBWakeupStat_coding: 0=PBWakeupStat_coding_FALSE, 1=PBWakeupStat_coding_TRUE, phys=raw for raw 0..1
  compu method PowerMode_coding: 0=KeyOut, 1=KeyRecentlyOut, 2=KeyApproved_0, 3=PostAccessory_0, 4=Accessory_1, 5=PostIgnition_1, 6=IgnitionOn_2, 7=Running_2, 9=Crank_3, phys=raw for raw 0..31
  compu method PowerPackStatus_coding: 0=Init, 1=Awake, 2=Ready, 3=PreStarting, 4=StartingInProgress, 5=Running_Running, 6=Running_Standby, 7=Running_StartingInProgress, 8=Running_RemoteStarted, 9=AfterRun, phys=raw for raw 0..15
  compu method SOTAPrepRequest_coding: 0=Not_required___completed, 1=Request_for_SOTA_install, 2=SOTA_installation_in_progress, 3=SOTA_installation_in_progress__HV_system_active, phys=raw for raw 0..3
  compu method VehMovementDirection_coding: 0=Vehicle_moving_forwards, 1=Vehicle_moving_backwards, 2=Vehicle_Stationary_Undetermined_direction, 3=Reserved, phys=raw for raw 0..3
  compu method WheelDirectionFL_coding: 0=Forwards, 1=Backwards, 2=Undetermined_Direction, 3=Stationary, phys=raw for raw 0..3
  compu method WheelDirectionFR_coding: 0=WheelDirectionFR_coding_Forwards, 1=WheelDirectionFR_coding_Backwards, 2=WheelDirectionFR_coding_Undetermined_Direction, 3=WheelDirectionFR_coding_Stationary, phys=raw for raw 0..3
  compu method WheelDirectionRL_coding: 0=WheelDirectionRL_coding_Forwards, 1=WheelDirectionRL_coding_Backwards, 2=WheelDirectionRL_coding_Undetermined_Direction, 3=WheelDirectionRL_coding_Stationary, phys=raw for raw 0..3
  compu method WheelDirectionRR_coding: 0=WheelDirectionRR_coding_Forwards, 1=WheelDirectionRR_coding_Backwards, 2=WheelDirectionRR_coding_Undetermined_Direction, 3=WheelDirectionRR_coding_Stationary, phys=raw for raw 0..3
package /CanSystem/ECUINSTANCES
  ecu instance PBU
    can communication controller PBU
    can communication connector Conn_PBU: comm-controller=PBU
package /CanSystem/INITVALS
  constant specification SF_VEHCONFIG_400RIO_MUX_PDU_176_constSpec: value-spec=176
  constant specification SF_VEHCONFIG_400RIO_MUX_PDU_177_constSpec: value-spec=177
package /CanSystem/ISIGNALS
  i signal group PBCriticErrGp: i-signal=[PBCriticErrGpAC, PBCriticErrGpCS, PBCriticErrProtd], system-signal-group=PBCriticErrGp
  i signal group PBDegradationGp: i-signal=[PB1FETStatus, PB2Degradation, PB2FETStatus, PBDegradation, PBDegradationGpAC, PBDegradationGpCS], system-signal-group=PBDegradationGp
  i signal group VehMovement: i-signal=[VehMovementChecksum, VehMovementCounter, VehMovementDirection, VehMovementStatus, WheelDirectionFL, WheelDirectionFR, WheelDirectionRL, WheelDirectionRR], system-signal-group=VehMovement
package /CanSystem/PDUS
  pdu VEHCONFIG_400RIO_MUX_176: length=7, unused-bit-pattern=255
    signal CcfDD00GlobalRealTime: start 15, 32 bit, big-endian, base-type=uint32, compu {phys=raw for raw 0..4294967295}, implementation-data-type=CcfDD00GlobalRealTime_datatype, to PBU
    signal CcfDD02MainECUSupVolts: start 47, 8 bit, big-endian, base-type=uint8, compu {phys=raw*0.25 for raw 0..255; unit Volts}, implementation-data-type=CcfDD02MainECUSupVolts_datatype, to PBU
    signal CcfDD06PowerModePKT: start 52, 5 bit, big-endian, base-type=uint8, compu {phys=raw for raw 0..31}, implementation-data-type=CcfDD06PowerModePKT_datatype, to PBU
    signal SF_VEHCONFIG_400RIO_MUX_PDU_176: start 0, 8 bit, little-endian, init-value=176, base-type=uint8, compu {phys=raw for raw 0..255}, implementation-data-type=SF_VEHCONFIG_400RIO_MUX_PDU_176_datatype, to PBU
  pdu VEHCONFIG_400RIO_MUX_177: length=7, unused-bit-pattern=255
    signal CcfDD01TotalDistance: start 15, 24 bit, big-endian, base-type=uint32, compu {phys=raw for raw 0..16777215}, implementation-data-type=CcfDD01TotalDistance_datatype, to PBU
    signal CcfDD04InCarTemp: start 39, 8 bit, big-endian, base-type=uint8, compu {phys=raw-40 for raw 0..255; unit Deg C}, implementation-data-type=CcfDD04InCarTemp_datatype, to PBU
    signal CcfDD05OutdoorTemp: start 47, 8 bit, big-endian, base-type=uint8, compu {phys=raw-40 for raw 0..255; unit Deg C}, implementation-data-type=CcfDD05OutdoorTemp_datatype, to PBU
    signal SF_VEHCONFIG_400RIO_MUX_PDU_177: start 0, 8 bit, little-endian, init-value=177, base-type=uint8, compu {phys=raw for raw 0..255}, implementation-data-type=SF_VEHCONFIG_400RIO_MUX_PDU_177_datatype, to PBU
package /CanSystem/UNITS
  46 x unit:
    CcfDD02MainECUSupVolts_unit: display-name=Volts
    CcfDD04InCarTemp_unit: display-name=Deg C
    CcfDD05OutdoorTemp_unit: display-name=Deg C
    PBAhChange_unit: display-name=Ah
    PBAliveCounter_unit: display-name=sec
    PBBatCurr_unit: display-name=A
    PBBatVolt_unit: display-name=V
    PBBattQd_unit: display-name=uA
    PBCell{1..4}Volt_unit: display-name=V
    PBCpctyAbsolute_unit: display-name=Ah
    PBCpctyRelative_unit: display-name=Ah
    PBCriticErrGpAC_unit: display-name=Counter value
    PBCriticErrGpCS_unit: display-name=checksum
    PBDegradationGpAC_unit: display-name=Counter value
    PBDegradationGpCS_unit: display-name=checksum
    PBMaxChrgCurrLmt_unit: display-name=A
    PBMaxChrgVoltLmt_unit: display-name=V
    PBMaxDchgCurrLmt_unit: display-name=A
    PBMinBatCurr_unit: display-name=A
    PBMinBatVolt_unit: display-name=V
    PBMinCrnkSOCLmt_unit: display-name=%
    PBPackVolt_unit: display-name=V
    PBParkingTime_unit: display-name=days
    PBPos1Temp_unit: display-name=degC
    PBPos2Temp_unit: display-name=degC
    PBQChaRideCn_unit: display-name=Cn
    PBQChaRunCn_unit: display-name=Cn
    PBQDchActCn_unit: display-name=Cn
    PBQDchActHiCn_unit: display-name=Cn
    PBQDchEcoStpCn_unit: display-name=Cn
    PBQDchQdCn_unit: display-name=Cn
    PBQDchaRideCn_unit: display-name=Cn
    PBQDchaRunCn_unit: display-name=Cn
    PBSOHCapFade_unit: display-name=%
    PBSOHImpGrowth_unit: display-name=%
    PBSOHImpedanceAbs_unit: display-name=mOhm
    PBSoCAbsolute_unit: display-name=%
    PBSoCRelative_unit: display-name=%
    PBTIS_unit: display-name=days
    PBVehCount_unit: display-name=Battery Count
    PBVehQd_unit: display-name=mA
    VehMovementChecksum_unit: display-name=checksum
    VehMovementCounter_unit: display-name=Counter value
