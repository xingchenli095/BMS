AUTOSAR XML (schema 00047)
package /Diagnostics/Common
  diagnostic contribution set DcmContributionSet: category=DIAGNOSTICS_ECU_EXTRACT, ecu-instance=EcuTestNode, service-tables=DcmDsdServiceTable
    elements:
      AP_All
      AP_Comb_{0001..0009}
      ClearDiagnosticInformationClass
      FaultMem_ClearGroup
      ComControlClass
      EnableRxDisableTx
      EnableRxAndTx
      ControlDtcSettingClass
      DTC_Setting_Mode_Off_Control
      DTC_Setting_Mode_On_Control
      ActiveDiagnosticInformation
      NVM_TEST_BLOCK
      EcuResetClass
      Hard
      ReadDataByIdentifierClass
      ActiveDiagnosticInformation_Read
      NVM_TEST_BLOCK_Read
      ReadDtcInformationClass
      Development_Fault_Memory_ReportDTCByStatusMask
      Development_Fault_Memory_ReportDTCExtendedDataRecordByDtcNbr
      Development_Fault_Memory_ReportDTCSnapshotRecordByDtcNbr
      RDTCBSM
      RDTCEDRBDN
      RDTCFDC
      RDTCSSBDTC
      RNODTCBSM
      RSUPDTC
      RoutineControlClass
      SecurityAccessClass
      Level1_Seed
      Level3_Seed
      Level_1
      Level_3
      DcmDsdServiceTable
      SessionControlClass
      Default
      Extended
      Programming
      Default
      Extended
      Programming
      WriteDataByIdentifierClass
      NVM_TEST_BLOCK_Write
      DIAGNOSTIC_LOOPBACK
      DIAGNOSTIC_LOOPBACK
      DiagnosticServiceSwMapping
      DIAGNOSTIC_TRIGGER_DTC
      DIAGNOSTIC_TRIGGER_DTC
      DiagnosticServiceSwMapping1
      DisableRxAndEnableTx
      DisableRxAndTx
      VehicleIdentificationNumber_Block
      VehicleIdentificationNumber_Block_Read
      CPU_Load_Read
      CPU_Load
package /Diagnostics/Common/CompuMethods
  compu method Identical_008: identical
  compu method Unsigned_2Byte: identical
  compu method Unsigned_4Byte: identical
  compu method Unsigned_Hex_3_Byte: identical
  compu method Unsigned_Hex_4_Byte: identical
package /Diagnostics/Common/DataConstraints
  range HexDump_1Byte: raw 0..255
  range HexDump_2Byte: raw 0..65535
  range Unsigned_1Byte: raw 0..255
  range Unsigned_2Byte: raw 0..65535
  range Unsigned_4Byte: raw 0..4294967295
  range Unsigned_Hex_3_Byte: raw 0..16777215
  range Unsigned_Hex_4_Byte: raw 0..4294967295
package /Diagnostics/Common/BaseTypes
  6 x base type, all with category=FIXED_LENGTH:
    bcd8_opaq: base-type-size=8, base-type-encoding=BCD-P, byte-order=opaque
    uint16_mot: base-type-size=16, base-type-encoding=NONE, byte-order=big-endian
    uint24_mot: base-type-size=24, base-type-encoding=NONE, byte-order=big-endian
    uint32_mot: base-type-size=32, base-type-encoding=NONE, byte-order=big-endian
    uint8_ascii: base-type-size=8, base-type-encoding=WINDOWS-1252, byte-order=opaque
    uint8_opaq: base-type-size=8, base-type-encoding=NONE, byte-order=opaque
package /Diagnostics/Common/ImplementationDataTypes
  4 x impl type:
    Dcm_NegativeResponseCodeType:
      sw-calibration-access=READ-ONLY
      compu {0=DCM_E_POSITIVERESPONSE, 16=DCM_E_GENERALREJECT, 17=DCM_E_SERVICENOTSUPPORTED, 18=DCM_E_SUBFUNCTIONNOTSUPPORTED, 19=DCM_E_INCORRECTMESSAGELENGTHORINVALIDFORMAT, 20=DCM_E_RESPONSETOOLONG, 33=DCM_E_BUSYREPEATREQUEST, 34=DCM_E_CONDITIONSNOTCORRECT, 36=DCM_E_REQUESTSEQUENCEERROR, 37=DCM_E_NORESPONSEFROMSUBNETCOMPONENT, 38=DCM_E_FAILUREPREVENTSEXECUTIONOFREQUESTEDACTION, 49=DCM_E_REQUESTOUTOFRANGE, 51=DCM_E_SECURITYACCESSDENIED, 53=DCM_E_INVALIDKEY, 54=DCM_E_EXCEEDNUMBEROFATTEMPTS, 55=DCM_E_REQUIREDTIMEDELAYNOTEXPIRED, 112=DCM_E_UPLOADDOWNLOADNOTACCEPTED, 113=DCM_E_TRANSFERDATASUSPENDED, 114=DCM_E_GENERALPROGRAMMINGFAILURE, 115=DCM_E_WRONGBLOCKSEQUENCECOUNTER, 120=DCM_E_REQUESTCORRECTLYRECEIVEDRESPONSEPENDING, 126=DCM_E_SUBFUNCTIONNOTSUPPORTEDINACTIVESESSION, 127=DCM_E_SERVICENOTSUPPORTEDINACTIVESESSION, 129=DCM_E_RPMTOOHIGH, 130=DCM_E_RPMTOOLOW, 131=DCM_E_ENGINEISRUNNING, 132=DCM_E_ENGINEISNOTRUNNING, 133=DCM_E_ENGINERUNTIMETOOLOW, 134=DCM_E_TEMPERATURETOOHIGH, 135=DCM_E_TEMPERATURETOOLOW, 136=DCM_E_VEHICLESPEEDTOOHIGH, 137=DCM_E_VEHICLESPEEDTOOLOW, 138=DCM_E_THROTTLE_PEDALTOOHIGH, 139=DCM_E_THROTTLE_PEDALTOOLOW, 140=DCM_E_TRANSMISSIONRANGENOTINNEUTRAL, 141=DCM_E_TRANSMISSIONRANGENOTINGEAR, 143=DCM_E_BRAKESWITCH_NOTCLOSED, 144=DCM_E_SHIFTERLEVERNOTINPARK, 145=DCM_E_TORQUECONVERTERCLUTCHLOCKED, 146=DCM_E_VOLTAGETOOHIGH, 147=DCM_E_VOLTAGETOOLOW}
      implementation-data-type=uint8
    Dcm_OpStatusType: compu {0=DCM_INITIAL, 1=DCM_PENDING, 2=DCM_CANCEL, 3=DCM_FORCE_RCRRP_OK}, implementation-data-type=uint8
    DcmDspRoutineInfo_256_DcmDspStartRoutineInSignal_ArrayType: category=ARRAY
      element AuxU8_DcmDspRoutineInfo_256_DcmDspStartRoutineInSignal_ArrayType: array-size=1024, array-size-semantics=FIXED-SIZE, implementation-data-type=uint8
    DcmDspRoutineInfo_256_DcmDspStartRoutineOutSignal_ArrayType: category=ARRAY
      element AuxU8_DcmDspRoutineInfo_256_DcmDspStartRoutineOutSignal_ArrayType: array-size=1024, array-size-semantics=FIXED-SIZE, implementation-data-type=uint8
package /Diagnostics/Common/PortInterfaces
  client server interface RoutineServices_DIAGNOSTIC_LOOPBACK: is-service=true
    operation Start: possible-error=[E_NOT_OK, DCM_E_PENDING, DCM_E_FORCE_RCRRP]
      5 x arg:
        dataIn0: type=DcmDspRoutineInfo_256_DcmDspStartRoutineInSignal_ArrayType, direction=IN
        OpStatus: type=Dcm_OpStatusType, direction=IN
        dataOut0: type=DcmDspRoutineInfo_256_DcmDspStartRoutineOutSignal_ArrayType, direction=OUT
        currentDataLength: type=uint16, direction=INOUT
        ErrorCode: type=Dcm_NegativeResponseCodeType, direction=OUT
    error E_NOT_OK: error-code=1
    error DCM_E_PENDING: error-code=10
    error DCM_E_FORCE_RCRRP: error-code=12
package /Diagnostics/Dcm
  diagnostic connection CAN_DiagnosticConnection: functional-request=CAN_FunctionalRx, physical-request=CAN_PhysicalTx, response=CAN_PhysicalRes
  diagnostic service table DcmDsdServiceTable:
    diagnostic-connections=[CAN_FD_DiagnosticConnection, CAN_DiagnosticConnection, DiagnosticConnection]
    ecu-instance=EcuTestNode
    protocol-kind=UDS_ON_CAN
    service-instance=[RDTCBSM, RNODTCBSM, RDTCSSBDTC, RDTCEDRBDN, RSUPDTC, RDTCFDC, Development_Fault_Memory_ReportDTCByStatusMask, Development_Fault_Memory_ReportDTCSnapshotRecordByDtcNbr, Development_Fault_Memory_ReportDTCExtendedDataRecordByDtcNbr, Default, Programming, Extended, Hard, FaultMem_ClearGroup, ActiveDiagnosticInformation_Read, NVM_TEST_BLOCK_Read, VehicleIdentificationNumber_Block_Read, Level1_Seed, Level3_Seed, EnableRxAndTx, EnableRxDisableTx, DisableRxAndTx, DisableRxAndEnableTx, NVM_TEST_BLOCK_Write, DTC_Setting_Mode_On_Control, DTC_Setting_Mode_Off_Control, DIAGNOSTIC_LOOPBACK, DIAGNOSTIC_TRIGGER_DTC, CPU_Load_Read]
  diagnostic connection CAN_FD_DiagnosticConnection: functional-request=CAN_FD_FunctionalRx, physical-request=CAN_FD_PhysicalTx, response=CAN_FD_PhysicalRes
  diagnostic connection DiagnosticConnection: periodic-response-uudt=[PT_UUDT_CAN_Tx, PT_UUDT_CAN_FD_Tx]
package /Diagnostics/Dcm/DiagnosticSessions
  diagnostic session Default: id=1, jump-to-boot-loader=NO-BOOT, p-2-server-max=0.05, p-2-star-server-max=5.0
  diagnostic session Extended: id=3, jump-to-boot-loader=NO-BOOT, p-2-server-max=0.05, p-2-star-server-max=5.0
  diagnostic session Programming: id=2, jump-to-boot-loader=OEM-BOOT, p-2-server-max=0.05, p-2-star-server-max=5.0
package /Diagnostics/Dcm/SecurityLevels
  diagnostic security level Level_1: access-data-record-size=4, key-size=4, num-failed-security-access=1, security-delay-time=10.0, seed-size=8
  diagnostic security level Level_3: access-data-record-size=4, key-size=4, num-failed-security-access=1, security-delay-time=10.0, seed-size=8
package /Diagnostics/Dcm/ServiceClasses
  diagnostic clear diagnostic information class ClearDiagnosticInformationClass: access-permission-validity=ACCESS-PERMISSION-SERVICE-INSTANCE  # ;FaultMem_ClearGroup
  diagnostic com control class ComControlClass: access-permission=AP_Comb_0004, access-permission-validity=ACCESS-PERMISSION-SERVICE-INSTANCE  # ;EnableRxAndEnableTx_Control;EnableRxAndDisableTx_Control
  diagnostic control dtc setting class ControlDtcSettingClass: access-permission-validity=ACCESS-PERMISSION-SERVICE-INSTANCE, control-option-record-present=false  # ;DTC_Setting_Mode_On_Control;DTC_Setting_Mode_Off_Control
  diagnostic ecu reset class EcuResetClass: access-permission-validity=ACCESS-PERMISSION-SERVICE-INSTANCE  # ;Hard_Reset;
  diagnostic read data by identifier class ReadDataByIdentifierClass: access-permission-validity=ACCESS-PERMISSION-SERVICE-INSTANCE, max-did-to-read=1  # ActiveDiagnosticInformation_Read;NVM_TEST_BLOCK_Read;VehicleIdentificationNumber_Block_Read
  diagnostic read dtc information class ReadDtcInformationClass: access-permission-validity=ACCESS-PERMISSION-SERVICE-INSTANCE  # ;FaultMem_ReportDTCByStatusMask
  diagnostic routine control class RoutineControlClass: access-permission-validity=ACCESS-PERMISSION-SERVICE-INSTANCE  # DIAGNOSTIC_LOOPBACK_Start; DIAGNOSTIC_TRIGGER_DTC_Start
  diagnostic security access class SecurityAccessClass: access-permission-validity=ACCESS-PERMISSION-SERVICE-INSTANCE  # ;Level1_Seed_Request;Level2_Key_Send;Level3_Seed_Request;Level3_Key_Send;
  diagnostic session control class SessionControlClass: access-permission-validity=ACCESS-PERMISSION-SERVICE-INSTANCE  # ;Default_Start;Programming_Start;Extended_Start;
  diagnostic write data by identifier class WriteDataByIdentifierClass: access-permission-validity=ACCESS-PERMISSION-SERVICE-INSTANCE  # NVM_TEST_BLOCK_Write;
package /Diagnostics/Dcm/ServiceInstances/RDBI
  4 x diagnostic read data by identifier, all with access-permission=AP_All, read-class=ReadDataByIdentifierClass:
    ActiveDiagnosticInformation_Read: data-identifier=ActiveDiagnosticInformation
    NVM_TEST_BLOCK_Read: data-identifier=NVM_TEST_BLOCK
    VehicleIdentificationNumber_Block_Read: data-identifier=VehicleIdentificationNumber_Block
    CPU_Load_Read: data-identifier=CPU_Load
package /Diagnostics/Dcm/ServiceInstances/WDBI
  diagnostic write data by identifier NVM_TEST_BLOCK_Write: access-permission=AP_All, data-identifier=NVM_TEST_BLOCK, write-class=WriteDataByIdentifierClass
package /Diagnostics/Dcm/ServiceInstances/SessionControl
  diagnostic session control Default: access-permission=AP_All, diagnostic-session=Default, session-control-class=SessionControlClass
  diagnostic session control Extended: access-permission=AP_All, diagnostic-session=Extended, session-control-class=SessionControlClass
  diagnostic session control Programming: access-permission=AP_All, diagnostic-session=Programming, session-control-class=SessionControlClass
package /Diagnostics/Dcm/ServiceInstances/EcuReset
  diagnostic ecu reset Hard: category=HARD_RESET, access-permission=AP_All, ecu-reset-class=EcuResetClass
package /Diagnostics/Dcm/ServiceInstances/ClearDiagInfo
  diagnostic clear diagnostic information FaultMem_ClearGroup: access-permission=AP_Comb_0003, clear-diagnostic-information-class=ClearDiagnosticInformationClass
package /Diagnostics/Dcm/ServiceInstances/ControlDTC
  diagnostic control dtc setting DTC_Setting_Mode_Off_Control: access-permission=AP_Comb_0004, dtc-setting-class=ControlDtcSettingClass, dtc-setting-parameter=2
  diagnostic control dtc setting DTC_Setting_Mode_On_Control: access-permission=AP_Comb_0004, dtc-setting-class=ControlDtcSettingClass, dtc-setting-parameter=1
package /Diagnostics/Dcm/ServiceInstances/ComControl
  4 x diagnostic com control, all with access-permission=AP_Comb_0004, com-control-class=ComControlClass:
    EnableRxDisableTx: category=ENABLE_RX_AND_DISABLE_TX, custom-sub-function-number=1
    EnableRxAndTx: category=ENABLE_RX_AND_TX, custom-sub-function-number=0
    DisableRxAndTx: category=DISABLE_RX_AND_TX, custom-sub-function-number=3
    DisableRxAndEnableTx: category=DISABLE_RX_AND_ENABLE_TX, custom-sub-function-number=2
package /Diagnostics/Dcm/ServiceInstances/RoutineControl
  diagnostic routine control DIAGNOSTIC_LOOPBACK: access-permission=AP_Comb_0001, routine-control-class=RoutineControlClass, routine=DIAGNOSTIC_LOOPBACK
  diagnostic routine control DIAGNOSTIC_TRIGGER_DTC: access-permission=AP_Comb_0001, routine-control-class=RoutineControlClass, routine=DIAGNOSTIC_TRIGGER_DTC
package /Diagnostics/Dcm/ServiceInstances/ReadDTCInfo
  9 x diagnostic read dtc information, all with read-dtc-information-class=ReadDtcInformationClass:
    Development_Fault_Memory_ReportDTCByStatusMask: category=REPORT_USER_DEF_MEMORY_DTC_BY_STATUS_MASK, access-permission=AP_All
    Development_Fault_Memory_ReportDTCExtendedDataRecordByDtcNbr: category=REPORT_USER_DEF_MEMORY_DTC_EXT_DATA_RECORD_BY_DTC_NUMBER, access-permission=AP_All
    Development_Fault_Memory_ReportDTCSnapshotRecordByDtcNbr: category=REPORT_USER_DEF_MEMORY_DTC_SNAPSHOT_RECORD_BY_DTC_NUMBER, access-permission=AP_All
    RDTCBSM: category=REPORT_DTC_BY_STATUS_MASK, access-permission=AP_Comb_0003
    RDTCEDRBDN: category=REPORT_DTC_EXT_DATA_RECORD_BY_DTC_NUMBER, access-permission=AP_Comb_0003
    RDTCFDC: category=REPORT_DTC_FAULT_DETECTION_COUNTER, access-permission=AP_Comb_0003
    RDTCSSBDTC: category=REPORT_DTC_SNAPSHOT_RECORD_BY_DTC_NUMBER, access-permission=AP_Comb_0003
    RSUPDTC: category=REPORT_SUPPORTED_DTC, access-permission=AP_Comb_0003
    RNODTCBSM: category=REPORT_NUMBER_OF_DTC_BY_STATUS_MASK, access-permission=AP_Comb_0003
package /Diagnostics/Dcm/ServiceInstances/SecurityAccess
  diagnostic security access Level1_Seed: access-permission=AP_Comb_0007, request-seed-id=1, security-access-class=SecurityAccessClass, security-level=Level_1
  diagnostic security access Level3_Seed: access-permission=AP_Comb_0005, request-seed-id=3, security-access-class=SecurityAccessClass, security-level=Level_3
package /Diagnostics/Dcm/RID
  diagnostic routine DIAGNOSTIC_LOOPBACK: id=256
    start DIAGNOSTIC_LOOPBACK_Start
      diagnostic-parameter bit-offset=0:
        diagnostic data element DcmDspStartRoutineInSignal_dataIn: array-size-semantics=VARIABLE-SIZE, max-number-of-elements=1024, base-type=uint8, compu {identical}
      diagnostic-parameter bit-offset=0:
        diagnostic data element DcmDspStartRoutineOutSignal_dataOut: array-size-semantics=VARIABLE-SIZE, max-number-of-elements=1024, base-type=uint8, compu {identical}
  diagnostic routine DIAGNOSTIC_TRIGGER_DTC: id=257
    start DIAGNOSTIC_TRIGGER_DTC_Start
      diagnostic-parameter bit-offset=0:
        diagnostic data element routineInfo_In: base-type=uint8, compu {identical}
      diagnostic-parameter bit-offset=0:
        diagnostic data element routineInfo_Out: base-type=uint8, compu {identical}
package /Diagnostics/Dcm/DID
  diagnostic data identifier ActiveDiagnosticInformation: id=61830
    diagnostic-parameter bit-offset=0:
      diagnostic data element Session: array-size-semantics=FIXED-SIZE, max-number-of-elements=1, base-type=uint8, compu {identical}
  diagnostic data identifier NVM_TEST_BLOCK: id=61841
    diagnostic-parameter bit-offset=0:
      diagnostic data element NvM_Dummy: array-size-semantics=FIXED-SIZE, max-number-of-elements=17, base-type=uint8, compu {identical}
  diagnostic data identifier VehicleIdentificationNumber_Block: id=61840
    diagnostic-parameter bit-offset=0:
      diagnostic data element Vehicle_Identification_Number: array-size-semantics=FIXED-SIZE, max-number-of-elements=17, base-type=uint8, compu {identical}
package /Diagnostics/Dcm/DiagnosticAccessPermision
  10 x diagnostic access permission:
    AP_All
    AP_Comb_0001: diagnostic-session=Extended
    AP_Comb_0002: diagnostic-session=Programming
    AP_Comb_0003: diagnostic-session=[Default, Extended]
    AP_Comb_0004: diagnostic-session=[Extended, Programming]
    AP_Comb_0005: diagnostic-session=Extended
    AP_Comb_0006: diagnostic-session=[Default, Extended]
    AP_Comb_0007: diagnostic-session=[Extended, Programming]
    AP_Comb_0008: diagnostic-session=Extended, security-level=Level_1
    AP_Comb_0009: security-level=[Level_1, Level_3]
package /Diagnostics/Dcm/DiagnosticServiceSwMapping
  diagnostic service sw mapping DiagnosticServiceSwMapping: diagnostic-data-element=DcmDspStartRoutineInSignal_dataIn, mapped-flat-swc-service-dependency=ServiceDependency, mapped-swc-service-dependency=TopLevelComposition.ServiceDependency, service-instance=DIAGNOSTIC_LOOPBACK
  diagnostic service sw mapping DiagnosticServiceSwMapping1: diagnostic-data-element=routineInfo_In, mapped-flat-swc-service-dependency=ServiceDependency, mapped-swc-service-dependency=TopLevelComposition.ServiceDependency, service-instance=DIAGNOSTIC_TRIGGER_DTC
package /Diagnostics/Dem
  diagnostic contribution set DemContributionSet: category=DIAGNOSTICS_ECU_EXTRACT, ecu-instance=EcuTestNode
    common-properties dtc-status-availability-mask=57:
      diagnostic debounce algorithm props DTC_0x000001_DebounceAlgorithmProperties
        debounce-algorithm:
          diag event debounce counter based DTC_0x000001_CounterBasedAlgorithm: counter-decrement-step-size=1, counter-failed-threshold=127, counter-increment-step-size=1, counter-jump-down=true, counter-jump-up=false, counter-passed-threshold=-128
      diagnostic debounce algorithm props DTC_0x000002_DebounceAlgorithmProperties
        debounce-algorithm:
          diag event debounce counter based DTC_0x000002_CounterBasedAlgorithm: counter-decrement-step-size=1, counter-failed-threshold=127, counter-increment-step-size=1, counter-jump-down=true, counter-jump-up=false, counter-passed-threshold=-128
    elements:
      DTC_0x000001_Aging
      DTC_0x000001_DidSet
      ExtDataRec_0x01_Mapping
      DTC_0x000001_EnableConditionGroup
      DEM_SL_ECU_LEVEL
      DTC_0x000001_Event
      DTC_0x000001_Event_To_DebounceAlgorithmProperties_Mapping
      DTC_0x000001_Event_To_EnableConditionGroup_Mapping
      DTC_0x000001_Event_To_DEM_POWER_Mapping
      DTC_0x000001_Event_To_DTC_Mapping
      DTC_0x000001
      DTC_0x000001_Properties
      StandardEnvironmentData
      SnapshotRec_10
      SnapshotRec_20
      DEM_OPCYC_POWER
      DTC_Obd
      DTC_Uds_To_DTC_Obd_Mapping
      DEM_OPCYC_IGNITION
      DEM_OPCYC_OBD_DCY
      DTC_0x000002_Event
      DTC_0x000002_Event_To_DebounceAlgorithmProperties_Mapping
      DTC_0x000002_Event_To_EnableConditionGroup_Mapping
      DTC_0x000002_Event_To_DEM_POWER_Mapping
      DTC_0x000002_Event_To_DTC_Mapping
      DTC_0x000002
      DTC_0x000002_Properties
      DTC_0x000002_Aging
      USER_DEFINE_MEMORY_Event
      USER_DEFINE_MEMORY_Event_To_DebounceAlgorithmProperties_Mapping
      USER_DEFINE_MEMORY_Event_To_EnableConditionGroup_Mapping
      USER_DEFINE_MEMORY_Event_To_DEM_POWER_Mapping
      USER_DEFINE_MEMORY_Event_To_DTC_Mapping
      User_Memory
      User_Memory_Properties
      User_Memory_Aging
package /Diagnostics/Dem/Events
  diagnostic event DTC_0x000001_Event: aging-allowed=true, event-failure-cycle-counter-threshold=1
  diagnostic event DTC_0x000002_Event: aging-allowed=true, event-failure-cycle-counter-threshold=1
  diagnostic event USER_DEFINE_MEMORY_Event: aging-allowed=true, event-failure-cycle-counter-threshold=1
package /Diagnostics/Dem/Dtcs
  diagnostic trouble code uds DTC_0x000001: dtc-props=DTC_0x000001_Properties, uds-dtc-value=1
  diagnostic trouble code uds DTC_0x000002: dtc-props=DTC_0x000001_Properties, uds-dtc-value=5
  diagnostic trouble code uds User_Memory: dtc-props=User_Memory_Properties, uds-dtc-value=16
package /Diagnostics/Dem/Mappings
  diagnostic event to debounce algorithm mapping DTC_0x000001_Event_To_DebounceAlgorithmProperties_Mapping: debounce-algorithm=DTC_0x000001_DebounceAlgorithmProperties, diagnostic-event=DTC_0x000001_Event
  diagnostic event to enable condition group mapping DTC_0x000001_Event_To_EnableConditionGroup_Mapping: diagnostic-event=DTC_0x000001_Event, enable-condition-group=DTC_0x000001_EnableConditionGroup
  diagnostic event to operation cycle mapping DTC_0x000001_Event_To_DEM_POWER_Mapping: diagnostic-event=DTC_0x000001_Event, operation-cycle=DEM_OPCYC_POWER
  diagnostic event to trouble code uds mapping DTC_0x000001_Event_To_DTC_Mapping: diagnostic-event=DTC_0x000001_Event, trouble-code-uds=DTC_0x000001
  diagnostic dem provided data mapping ExtDataRec_0x01_Mapping: data-element=ExtDataRec_0x01
  diagnostic event to debounce algorithm mapping DTC_0x000002_Event_To_DebounceAlgorithmProperties_Mapping: debounce-algorithm=DTC_0x000002_DebounceAlgorithmProperties, diagnostic-event=DTC_0x000002_Event
  diagnostic event to enable condition group mapping DTC_0x000002_Event_To_EnableConditionGroup_Mapping: diagnostic-event=DTC_0x000002_Event, enable-condition-group=DTC_0x000001_EnableConditionGroup
  diagnostic event to operation cycle mapping DTC_0x000002_Event_To_DEM_POWER_Mapping: diagnostic-event=DTC_0x000002_Event, operation-cycle=DEM_OPCYC_POWER
  diagnostic event to trouble code uds mapping DTC_0x000002_Event_To_DTC_Mapping: diagnostic-event=DTC_0x000002_Event, trouble-code-uds=DTC_0x000002
  diagnostic event to debounce algorithm mapping USER_DEFINE_MEMORY_Event_To_DebounceAlgorithmProperties_Mapping: debounce-algorithm=DTC_0x000001_DebounceAlgorithmProperties, diagnostic-event=USER_DEFINE_MEMORY_Event
  diagnostic event to enable condition group mapping USER_DEFINE_MEMORY_Event_To_EnableConditionGroup_Mapping: diagnostic-event=USER_DEFINE_MEMORY_Event, enable-condition-group=DTC_0x000001_EnableConditionGroup
  diagnostic event to operation cycle mapping USER_DEFINE_MEMORY_Event_To_DEM_POWER_Mapping: diagnostic-event=USER_DEFINE_MEMORY_Event, operation-cycle=DEM_OPCYC_POWER
  diagnostic event to trouble code uds mapping USER_DEFINE_MEMORY_Event_To_DTC_Mapping: diagnostic-event=USER_DEFINE_MEMORY_Event, trouble-code-uds=User_Memory
package /Diagnostics/Dem/DtcProperties
  diagnostic trouble code props DTC_0x000001_Properties: aging=DTC_0x000001_Aging, extended-data-records=StandardEnvironmentData, freeze-frames=[SnapshotRec_10, SnapshotRec_20], freeze-frame-content=DTC_0x000001_DidSet, priority=2, significance=FAULT
  diagnostic trouble code props DTC_0x000002_Properties: aging=DTC_0x000002_Aging, extended-data-records=StandardEnvironmentData, freeze-frames=[SnapshotRec_10, SnapshotRec_20], freeze-frame-content=DTC_0x000001_DidSet, immediate-nv-data-storage=true, priority=2, significance=FAULT
  diagnostic trouble code props User_Memory_Properties: aging=User_Memory_Aging, extended-data-records=StandardEnvironmentData, freeze-frames=[SnapshotRec_10, SnapshotRec_20], freeze-frame-content=DTC_0x000001_DidSet, immediate-nv-data-storage=true, priority=2, significance=FAULT
package /Diagnostics/Dem/DtcProperties/Agings
  diagnostic aging DTC_0x000001_Aging: aging-cycles=DEM_OPCYC_POWER, threshold=100
  diagnostic aging DTC_0x000002_Aging: aging-cycles=DEM_OPCYC_POWER, threshold=100
  diagnostic aging User_Memory_Aging: aging-cycles=DEM_OPCYC_POWER, threshold=100
package /Diagnostics/Dem/ExtendedDataRecords
  diagnostic extended data record StandardEnvironmentData: record-number=1
    diagnostic-parameter bit-offset=0:
      diagnostic data element ExtDataRec_0x01: array-size-semantics=FIXED-SIZE, max-number-of-elements=7, base-type=uint8, compu {identical}
package /Diagnostics/Dem/FreezeFrames
  diagnostic freeze frame SnapshotRec_10: record-number=16
  diagnostic freeze frame SnapshotRec_20: record-number=32
package /Diagnostics/Dem/DidSets
  diagnostic data identifier set DTC_0x000001_DidSet: data-identifier=ActiveDiagnosticInformation
package /Diagnostics/Dem/OperationCycles
  diagnostic operation cycle DEM_OPCYC_POWER: type=POWER
package /Diagnostics/Dem/EnableConditions
  diagnostic enable condition group DTC_0x000001_EnableConditionGroup: enable-conditions=DEM_SL_ECU_LEVEL
  diagnostic enable condition DEM_SL_ECU_LEVEL
