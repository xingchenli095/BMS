VERSION "PBU"

NS_ :

BS_:

BU_: PBU

BO_ 172 EVC_PBU_PR1_Rio_40ms: 64 PBU
 SG_ PB1FETStatus : 31|3@0+ (1,0) [0|7] "" Vector__XXX
 SG_ PB2Degradation : 28|3@0+ (1,0) [0|7] "" Vector__XXX
 SG_ PB2FETStatus : 20|3@0+ (1,0) [0|7] "" Vector__XXX
 SG_ PBBatCurr : 71|14@0+ (0.0625,-511) [-511|512.9375] "A" Vector__XXX
 SG_ PBBatCurrFlt : 73|1@0+ (1,0) [0|1] "" Vector__XXX
 SG_ PBBatVolt : 87|8@0+ (0.1,0) [0|25.5] "V" Vector__XXX
 SG_ PBBatVoltFlt : 72|1@0+ (1,0) [0|1] "" Vector__XXX
 SG_ PBCriticErr : 63|8@0+ (1,0) [0|255] "" Vector__XXX
 SG_ PBCriticErrGpAC : 43|4@0+ (1,0) [0|15] "Counter value" Vector__XXX
 SG_ PBCriticErrGpCS : 39|8@0+ (1,0) [0|255] "checksum" Vector__XXX
 SG_ PBCriticErrProtd : 55|8@0+ (1,0) [0|255] "" Vector__XXX
 SG_ PBDegradation : 23|3@0+ (1,0) [0|7] "" Vector__XXX
 SG_ PBDegradationGpAC : 11|4@0+ (1,0) [0|15] "Counter value" Vector__XXX
 SG_ PBDegradationGpCS : 7|8@0+ (1,0) [0|255] "checksum" Vector__XXX
 SG_ PBMaxChrgCurrLmt : 103|9@0+ (1,0) [0|511] "A" Vector__XXX
 SG_ PBMaxChrgVoltLmt : 95|8@0+ (0.1,0) [0|25.5] "V" Vector__XXX
 SG_ PBMaxDchgCurrLmt : 110|9@0+ (1,0) [0|511] "A" Vector__XXX

BO_ 323 EVC_PBU_PR1_Rio_Pdu_100ms: 64 PBU
 SG_ PBAgeing : 8|1@0+ (1,0) [0|1] "" Vector__XXX
 SG_ PBAhChange : 7|15@0+ (0.01,-100) [-100|227.67] "Ah" Vector__XXX
 SG_ PBAliveCounter : 59|4@0+ (1,0) [0|15] "sec" Vector__XXX
 SG_ PBBalActvCell1 : 60|1@0+ (1,0) [0|1] "" Vector__XXX
 SG_ PBBalActvCell2 : 61|1@0+ (1,0) [0|1] "" Vector__XXX
 SG_ PBBalActvCell3 : 62|1@0+ (1,0) [0|1] "" Vector__XXX
 SG_ PBBalActvCell4 : 63|1@0+ (1,0) [0|1] "" Vector__XXX
 SG_ PBBattQd : 55|8@0+ (100,0) [0|25500] "uA" Vector__XXX
 SG_ PBCell1Volt : 22|7@0+ (0.05,0) [0|6.35] "V" Vector__XXX
 SG_ PBCell1VoltFlt : 23|1@0+ (1,0) [0|1] "" Vector__XXX
 SG_ PBCell2Volt : 30|7@0+ (0.05,0) [0|6.35] "V" Vector__XXX
 SG_ PBCell2VoltFlt : 31|1@0+ (1,0) [0|1] "" Vector__XXX
 SG_ PBCell3Volt : 38|7@0+ (0.05,0) [0|6.35] "V" Vector__XXX
 SG_ PBCell3VoltFlt : 39|1@0+ (1,0) [0|1] "" Vector__XXX
 SG_ PBCell4Volt : 46|7@0+ (0.05,0) [0|6.35] "V" Vector__XXX
 SG_ PBCell4VoltFlt : 47|1@0+ (1,0) [0|1] "" Vector__XXX
 SG_ PBCpctyAbsolute : 70|7@0+ (1,0) [0|127] "Ah" Vector__XXX
 SG_ PBCpctyRelative : 78|7@0+ (1,0) [0|127] "Ah" Vector__XXX
 SG_ PBECUFlt : 79|1@0+ (1,0) [0|1] "" Vector__XXX
 SG_ PBECUSerial : 336|40@1+ (1,0) [0|1099511627775] "" Vector__XXX
 SG_ PBErsoStatus : 71|1@0+ (1,0) [0|1] "" Vector__XXX
 SG_ PBMinBatCurr : 87|8@0+ (8,0) [0|2040] "A" Vector__XXX
 SG_ PBMinBatVolt : 95|8@0+ (0.1,0) [0|25.5] "V" Vector__XXX
 SG_ PBMinCrnkSOCLmt : 110|7@0+ (1,0) [0|100] "%" Vector__XXX
 SG_ PBPackVolt : 103|8@0+ (0.1,0) [0|25.5] "V" Vector__XXX
 SG_ PBPackVoltFlt : 111|1@0+ (1,0) [0|1] "" Vector__XXX
 SG_ PBParkingTime : 118|7@0+ (1,0) [0|127] "days" Vector__XXX
 SG_ PBPos1Temp : 127|8@0+ (1,-40) [-40|215] "degC" Vector__XXX
 SG_ PBPos1TempFlt : 119|1@0+ (1,0) [0|1] "" Vector__XXX
 SG_ PBPos2Temp : 135|8@0+ (1,-40) [-40|215] "degC" Vector__XXX
 SG_ PBPos2TempFlt : 143|1@0+ (1,0) [0|1] "" Vector__XXX
 SG_ PBQChaRideCn : 142|15@0+ (0.0625,0) [0|2047.9375] "Cn" Vector__XXX
 SG_ PBQChaRunCn : 159|15@0+ (0.0625,0) [0|2047.9375] "Cn" Vector__XXX
 SG_ PBQDchActCn : 160|15@0+ (0.0625,0) [0|2047.9375] "Cn" Vector__XXX
 SG_ PBQDchActHiCn : 177|15@0+ (0.0625,0) [0|2047.9375] "Cn" Vector__XXX
 SG_ PBQDchaRideCn : 194|15@0+ (0.0625,0) [0|2047.9375] "Cn" Vector__XXX
 SG_ PBQDchaRunCn : 211|15@0+ (0.0625,0) [0|2047.9375] "Cn" Vector__XXX
 SG_ PBQDchEcoStpCn : 228|15@0+ (0.0625,0) [0|2047.9375] "Cn" Vector__XXX
 SG_ PBQDchQdCn : 245|15@0+ (0.01,0) [0|327.67] "Cn" Vector__XXX
 SG_ PBRelayClsFlt : 279|1@0+ (1,0) [0|1] "" Vector__XXX
 SG_ PBRelayOpenFlt : 287|1@0+ (1,0) [0|1] "" Vector__XXX
 SG_ PBRelayStatus : 265|2@0+ (1,0) [0|3] "" Vector__XXX
 SG_ PBSoCAbsolute : 278|7@0+ (1,0) [0|100] "%" Vector__XXX
 SG_ PBSoCRelative : 286|7@0+ (1,0) [0|100] "%" Vector__XXX
 SG_ PBSOHCapFade : 294|7@0+ (1,0) [0|100] "%" Vector__XXX
 SG_ PBSOHImpedanceAbs : 325|6@0+ (1,0) [0|63] "mOhm" Vector__XXX
 SG_ PBSOHImpGrowth : 318|7@0+ (1,0) [0|100] "%" Vector__XXX
 SG_ PBSWVer : 303|8@0+ (1,0) [0|255] "" Vector__XXX
 SG_ PBTIS : 262|13@0+ (1,0) [0|8191] "days" Vector__XXX
 SG_ PBTOCReq : 295|1@0+ (1,0) [0|1] "" Vector__XXX
 SG_ PBVehCount : 332|5@0+ (1,0) [0|31] "Battery Count" Vector__XXX
 SG_ PBVehQd : 311|8@0+ (1,0) [0|255] "mA" Vector__XXX
 SG_ PBWakeupStat : 319|1@0+ (1,0) [0|1] "" Vector__XXX
 SG_ PBWakeUpToChgReq : 326|1@0+ (1,0) [0|1] "" Vector__XXX
 SG_ PBWURLowChargeLmt : 327|1@0+ (1,0) [0|1] "" Vector__XXX
 SG_ PBWURMinChargeLmt : 333|1@0+ (1,0) [0|1] "" Vector__XXX

BO_ 1919 TST_PhysicalRespPBU_RIO: 64 PBU
 SG_ TST_PhysicalRespPBU_RIO_PDU : 7|512@0+ (1,0) [0|0] "" Vector__XXX

BO_ 78 EVC_BCMA_PR1_Rio_10ms: 64 Vector__XXX
 SG_ VehMovementChecksum : 151|8@0+ (1,0) [0|255] "checksum"  PBU
 SG_ VehMovementCounter : 155|4@0+ (1,0) [0|15] "Counter value"  PBU
 SG_ VehMovementDirection : 157|2@0+ (1,0) [0|3] ""  PBU
 SG_ VehMovementStatus : 161|1@0+ (1,0) [0|1] ""  PBU
 SG_ WheelDirectionFL : 163|2@0+ (1,0) [0|3] ""  PBU
 SG_ WheelDirectionFR : 165|2@0+ (1,0) [0|3] ""  PBU
 SG_ WheelDirectionRL : 167|2@0+ (1,0) [0|3] ""  PBU
 SG_ WheelDirectionRR : 159|2@0+ (1,0) [0|3] ""  PBU

BO_ 122 EVC_BCMA_PR1_Rio_20ms: 64 Vector__XXX
 SG_ PowerPackStatus : 39|4@0+ (1,0) [0|15] ""  PBU
 SG_ PowerPackStatus_UB : 49|1@0+ (1,0) [0|1] ""  PBU

BO_ 165 EVC_BCMA_PR1_Rio_40ms: 64 Vector__XXX
 SG_ CarMode : 27|4@0+ (1,0) [0|15] ""  PBU
 SG_ PowerMode : 20|5@0+ (1,0) [0|31] ""  PBU

BO_ 262 EVC_BCMA_PR1_Rio_80ms: 64 Vector__XXX
 SG_ GWMEL2Threshold : 86|7@0+ (1,0) [0|127] ""  PBU
 SG_ GWMEL3Threshold : 94|7@0+ (1,0) [0|127] ""  PBU
 SG_ GWMWakeUpToChargeThr : 102|7@0+ (1,0) [0|127] ""  PBU
 SG_ OdometerMasterValue : 159|24@0+ (1,0) [0|16777215] ""  PBU
 SG_ OdometerMasterValue_UB : 151|1@0+ (1,0) [0|1] ""  PBU
 SG_ SBShortVehID : 32|48@1+ (1,0) [0|281474976710655] ""  PBU

BO_ 267 EVC_BCMA_PR2_Rio_80ms: 64 Vector__XXX
 SG_ SOTAPrepRequest : 81|2@0+ (1,0) [0|3] ""  PBU

BO_ 2015 TST_FunctionalReq_RIOBus: 8 Vector__XXX
 SG_ TST_FunctionalReq_RIO_PDU : 7|64@0+ (1,0) [0|0] ""  PBU

BO_ 1911 TST_PhysicalReqPBU_RIO: 64 Vector__XXX
 SG_ TST_PhysicalReqPBU_RIO_PDU : 7|512@0+ (1,0) [0|0] ""  PBU

BO_ 1024 VEHCONFIG_400RIO_MUX: 8 Vector__XXX
 SG_ SF_VEHCONFIG_400RIO_MUX_PDU M : 0|8@1+ (1,0) [0|255] ""  PBU
 SG_ CcfDD00GlobalRealTime m176 : 15|32@0+ (1,0) [0|4294967295] ""  PBU
 SG_ CcfDD02MainECUSupVolts m176 : 47|8@0+ (0.25,0) [0|63.75] "Volts"  PBU
 SG_ CcfDD06PowerModePKT m176 : 52|5@0+ (1,0) [0|31] ""  PBU
 SG_ CcfDD01TotalDistance m177 : 15|24@0+ (1,0) [0|16777215] ""  PBU
 SG_ CcfDD04InCarTemp m177 : 39|8@0+ (1,-40) [-40|215] "Deg C"  PBU
 SG_ CcfDD05OutdoorTemp m177 : 47|8@0+ (1,-40) [-40|215] "Deg C"  PBU

CM_ SG_ 172 PB1FETStatus "Signal published by batttery(12V Primary Battery) to inform the status of its contactor FET";
CM_ SG_ 172 PB2Degradation "ASIL rated signal published by the battery to declare battery state of health. L3 Only.";
CM_ SG_ 172 PB2FETStatus "Signal published by batttery(12V Secondary Battery) to inform the status of its contactor FET";
CM_ SG_ 172 PBBatCurr "The current measured flowing into and out of the battery pack.
-ve shall be defined as current flowing out of the battery pack.
+ve shall be defined as current flowing into the battery pack.";
CM_ SG_ 172 PBBatCurrFlt "Indicates if a fault has occurred with the current sensor which prevents the correct current being measured or transmitted.";
CM_ SG_ 172 PBBatVolt "This signal indicates the voltage as measured across the battery terminals.";
CM_ SG_ 172 PBBatVoltFlt "Indicates if a fault has occurred with the battery terminal voltage sensor which prevents the correct voltage being measured or transmitted.";
CM_ SG_ 172 PBCriticErr "Indicates if a critical error has occurred within the battery or BMS which prevents it from performing the safety functions.";
CM_ SG_ 172 PBCriticErrGpAC "This counter forms part of a safety-related signal group.
It is incremented by the task which generates the data set used in the CRC calculation, and may be used to determine the health of the data generation task.
Refer to STJLR 18.276 for more detail.";
CM_ SG_ 172 PBCriticErrGpCS "This CRC shall be calculated in compliance with latest STJLR 18.276. The Data Segment Polynomial shall be constructed from the details in the network configuration file.";
CM_ SG_ 172 PBCriticErrProtd "Indicates if a critical error has occurred within the battery or BMS which prevents it from performing the safety functions.";
CM_ SG_ 172 PBDegradation "ASIL rated signal published by the battery to declare battery state of health";
CM_ SG_ 172 PBDegradationGpAC "This counter forms part of a safety-related signal group.
It is incremented by the task which generates the data set used in the CRC calculation, and may be used to determine the health of the data generation task.
Refer to STJLR 18.276 for more detail.";
CM_ SG_ 172 PBDegradationGpCS "This CRC shall be calculated in compliance with latest STJLR 18.276. The Data Segment Polynomial shall be constructed from the details in the network configuration file.";
CM_ SG_ 172 PBMaxChrgCurrLmt "The maximum continuous current which the battery may accept for at least 10 seconds and which will not cause damage and/or degradation to the battery.";
CM_ SG_ 172 PBMaxChrgVoltLmt "The maximum voltage which may be applied at the battery terminal posts and which will not cause damage and/or degradation to the battery at present conditions.";
CM_ SG_ 172 PBMaxDchgCurrLmt "The maximum continuous current which the battery may accept for at least 10 seconds and which will not cause damage and/or degradation to the battery.";
CM_ SG_ 323 PBAgeing "Indicates whether the battery has reached any of 4 defined milestones whilst in service.";
CM_ SG_ 323 PBAhChange "The change in battery capacity, (obtained by integrating battery current with time), which has occurred during the present drive cycle, (as defined by a transition out of VEH_STATE_1).
Reset to zero when the BMS enters VEH_STATE_0.";
CM_ SG_ 323 PBBalActvCell1 "Indicates whether the cell balancer for cell combination 1 is operating.
TRUE = Balancer has operated.
FALSE = Balancer has NOT operated.";
CM_ SG_ 323 PBBalActvCell2 "Indicates whether the cell balancer for cell combination 2 is operating.
TRUE = Balancer has operated.
FALSE = Balancer has NOT operated.";
CM_ SG_ 323 PBBalActvCell3 "Indicates whether the cell balancer for cell combination 3 is operating.
TRUE = Balancer has operated.
FALSE = Balancer has NOT operated.";
CM_ SG_ 323 PBBalActvCell4 "Indicates whether the cell balancer for cell combination 4 is operating.
TRUE = Balancer has operated.
FALSE = Balancer has NOT operated.";
CM_ SG_ 323 PBBattQd "The current measured being drawn by the BMS and all of the internal battery components to provide the battery management and monitoring functions whilst the vehicle state is in VEH_STATE_1. It is assumed that current used by the cell balancing function is included in the BMS consumption.";
CM_ SG_ 323 PBCell1Volt "The voltage as measured across string 1.";
CM_ SG_ 323 PBCell1VoltFlt "Indicates if a fault has occurred with voltage sensor for string of parallel cells 1.";
CM_ SG_ 323 PBCell2Volt "The voltage as measured across string 2.";
CM_ SG_ 323 PBCell2VoltFlt "Indicates if a fault has occurred with voltage sensor for string of parallel cells 2.";
CM_ SG_ 323 PBCell3Volt "The voltage as measured across string 3.";
CM_ SG_ 323 PBCell3VoltFlt "Indicates if a fault has occurred with voltage sensor for string of parallel cells 3.";
CM_ SG_ 323 PBCell4Volt "The voltage as measured across string 4.";
CM_ SG_ 323 PBCell4VoltFlt "Indicates if a fault has occurred with voltage sensor for string of parallel cells 4.";
CM_ SG_ 323 PBCpctyAbsolute "The present value of capacity which would be obtained if fully charged and measured at the temperature and discharge current rate at which the battery capacity is rated. This does not include ageing effects. This value represents BOL.";
CM_ SG_ 323 PBCpctyRelative "The present value of capacity which would be obtained if the battery was fully charged and measured at the present battery pack temperature. This does not include ageing effects. This value relates to BOL battery capacity.";
CM_ SG_ 323 PBECUFlt "Indicates if a BMS ECU fault has occurred which does not affect the safe operation of the battery.";
CM_ SG_ 323 PBECUSerial "F18C ECU Serial Number";
CM_ SG_ 323 PBErsoStatus "Signal to indicate the battery Isolation Relay has been used in order to mitigate quiescent loading.";
CM_ SG_ 323 PBMinBatCurr "The battery discharge recorded following the BMS exiting VEH_STATE = 1. Reset to default value upon entering VEH_STATE = 1. This functionality is intended to capture vehicle crank.";
CM_ SG_ 323 PBMinBatVolt "The lowest battery terminal voltage recorded following the BMS exiting VEH_STATE = 1. Reset to default value upon entering VEH_STATE = 1. This functionality is intended to capture vehicle crank.";
CM_ SG_ 323 PBMinCrnkSOCLmt "Minimum SOC limit at which the LISB can support a pre-defined and agreed current profile and minimum voltage threshold intended to ensure the capability to restart the car and drive away.Defined at present battery temperature and SOH.";
CM_ SG_ 323 PBPackVolt "The voltage as measured across the internal combination of the battery cells but not including the isolation relay or other connections to the battery terminals.";
CM_ SG_ 323 PBPackVoltFlt "Indicates if a fault has occurred with the battery pack voltage sensor which prevents the correct voltage being measured or transmitted.";
CM_ SG_ 323 PBParkingTime "The total period of time, in days, for which the previously measured vehicle quiescent current,SBVehQd, may be supplied, whilst remaining able to support a predefined and agreed subsequent current profile and minimum voltage threshold intended to ensure the capability to restart the car and drive away, at a present battery pack temperature or at a temperature of 0 degC, whichever temperature is the lower.";
CM_ SG_ 323 PBPos1Temp "The temperature measured at Position 1 within the battery pack.";
CM_ SG_ 323 PBPos1TempFlt "Indicates if a fault has occurred with battery temperature sensor 1 which prevents the correct temperature being measured or transmitted.";
CM_ SG_ 323 PBPos2Temp "The temperature measured at Position 2 within the battery pack.";
CM_ SG_ 323 PBPos2TempFlt "Indicates if a fault has occurred with battery temperature sensor 2 which prevents the correct temperature being measured or transmitted.";
CM_ SG_ 323 PBQChaRideCn "The total battery input Ah, (I > 0), measured whilst the BMS is operating in VEH_STATE = 3.Normalised to battery rated capacity.";
CM_ SG_ 323 PBQChaRunCn "The total battery input Ah, (I > 0), measured whilst the vehicle is operating in PowerMode = 7.Normalised to battery rated capacity.";
CM_ SG_ 323 PBQDchActCn "The total battery output Ah, (I < 0), measured whilst the BMS is operating in VEH_STATE = 2.Normalised to battery rated capacity.";
CM_ SG_ 323 PBQDchActHiCn "The total battery output Ah, (I < 0), measured whilst the vehicle is operating in PowerMode = 4.Normalised to battery rated capacity.";
CM_ SG_ 323 PBQDchaRideCn "The total battery output Ah, (I < 0), measured whilst the BMS is operating in VEH_STATE = 3.Normalised to battery rated capacity.";
CM_ SG_ 323 PBQDchaRunCn "The total battery output Ah, (I < 0), measured whilst the vehicle is operating in PowerMode = 7.Normalised to battery rated capacity.";
CM_ SG_ 323 PBQDchEcoStpCn "The total battery output Ah, (I < 0), measured whilst the vehicle is operating in PowerMode = 7 and PowerPackStatus = 6. Normalised to battery rated capacity.";
CM_ SG_ 323 PBQDchQdCn "The total battery output Ah, (I < 0), measured whilst the BMS is operating in VEH_STATE = 1.Normalised to battery rated capacity.";
CM_ SG_ 323 PBRelayClsFlt "Indicates whether the isolation relay has failed such that it can no longer operate and is stuck in a closed position.";
CM_ SG_ 323 PBRelayOpenFlt "Indicates whether the isolation relay has failed such that it can no longer operate and is stuck in an open position";
CM_ SG_ 323 PBRelayStatus "Indicates the status of the isolation relay.";
CM_ SG_ 323 PBSoCAbsolute "This is determined by performing the capacity measurements at the temperature for which the battery nominal capacity is defined, typically this is +25degC.";
CM_ SG_ 323 PBSoCRelative "This is determined by performing the capacity measurements at the present battery pack temperature.";
CM_ SG_ 323 PBSOHCapFade "The reduction in capacity from the rated battery capacity which has occurred to date.";
CM_ SG_ 323 PBSOHImpedanceAbs "Battery BOL impedance at agreed nominal conditions. The nominal conditions include factors such as SOC, temperature, frequency and discharge current rate.";
CM_ SG_ 323 PBSOHImpGrowth "The % increase in discharge impedance from that expected for a new battery at agreed nominal conditions.";
CM_ SG_ 323 PBSWVer "Used to distinguish software versions and battery technology, i.e. lead-acid versus Lithium-ion technology.";
CM_ SG_ 323 PBTIS "Provides the total time for which the battery has been commissioned.The time count starts from the point at which the battery completed manufacture and was activated and will increment by 1 following each time period of 24 hours.";
CM_ SG_ 323 PBTOCReq "Request to charge the battery until a pre-defined condition, (to be determined by measured voltage, current and time in condition), agreed between JLR and the battery supplier is reached.Instigated by the battery to enable battery state estimations to continue to meet agreed accuracy.True = Battery has instigated wake-up to charge request.False = Battery has NOT instigated wake-up to charge request.";
CM_ SG_ 323 PBVehCount "Count of how many vehicles the Starter Battery Unit has been used in.";
CM_ SG_ 323 PBVehQd "The current measured flowing from the battery pack whilst the BMS is in VEH_STATE_1,including the total vehicle current draw and that consumed by the BMS. It is assumed that current used by the cell balancing function is included in the BMS consumption.";
CM_ SG_ 323 PBWakeupStat "Indicates if the battery has instigated a communications wake up.This shall be reset when vehicle power mode > 0 or when the communications system with the vehicle shuts down.TRUE = Battery has instigated a communications system wake up.FALSE = Battery has NOT instigated a communications system wake up.";
CM_ SG_ 323 PBWakeUpToChgReq "Battery master wake up request to charge the battery until a predefined battery SOC level is reached. The SOC threshold is provided by GWMWakeUpToChargeThr.True = Battery has instigated wake-up to charge request.";
CM_ SG_ 323 PBWURLowChargeLmt "Battery master wake up request to indicate that the SOC level has been reached which indicates that vehicle features have ignored the previous minimum charge wake up warning and that further vehicle action is required to protect the battery.TRUE = Battery has instigated a low charge limit wake up request.FALSE = Battery has NOT instigated a low charge limit wake up request.";
CM_ SG_ 323 PBWURMinChargeLmt "Battery master wake up request to indicate that the minimum SOC level which is allowed to support vehicle feature operation has been reached and that vehicle systems must shut down to maintain vehicle restart capability.True = Battery has instigated a min charge limit wake up request.False = Battery has NOT instigated a min charge limit wake up request.";
CM_ SG_ 78 VehMovementChecksum "This CRC shall be calculated in compliance with latest STJLR 18.276. The Data Segment Polynomial shall be constructed from the details in the network configuration file.";
CM_ SG_ 78 VehMovementCounter "This counter forms part of a safety-related signal group.
It is incremented by the task which generates the data set used in the CRC calculation, and may be used to determine the health of the data generation task.
Refer to STJLR 18.276 for more detail.";
CM_ SG_ 78 VehMovementDirection "This signal estimates whether the vehicle is moving forwards or backwards, and is a modelled aggregate of individual wheel directions where two or more directional sensors are fitted and working.
Shall always be set to 0 on vehicles with no directional wheel speed sensors.";
CM_ SG_ 78 VehMovementStatus "This flag indicates whether or not the vehicle is moving
";
CM_ SG_ 78 WheelDirectionFL "This signal denotes the rotational direction of the Front Left Wheel.
Always 0 on vehicles without directional wheelspeed sensors.";
CM_ SG_ 78 WheelDirectionFR "This signal denotes the rotational direction of the Front Right Wheel.
Always 0 on vehicles without directional wheelspeed sensors.";
CM_ SG_ 78 WheelDirectionRL "This signal denotes the rotational direction of the Rear Left Wheel.
Always 0 on vehicles without directional wheelspeed sensors.";
CM_ SG_ 78 WheelDirectionRR "This signal denotes the rotational direction of the Rear Right Wheel.
Always 0 on vehicles without directional wheelspeed sensors.";
CM_ SG_ 122 PowerPackStatus "Describes the state of the powerpack
";
CM_ SG_ 165 CarMode "Information about which Carmode the vehicle is in i.e. Normal, factory etc.
";
CM_ SG_ 165 PowerMode "Information of current PowerMode, reflects the current  state of the Power Mode Superviser

For L538:
The signals PowerModeHS, PowerModeHSQF & PowerModeComp are all with the group PowerModeGrpHS. This grouping is to ensure that the signals are packed within the same frame, they are not treated as a group within the BCM. ";
CM_ SG_ 262 GWMEL2Threshold "The value of SoC at which the low level warning, SBWURMinChargeLmt, will be transmitted to the vehicle power system controller.";
CM_ SG_ 262 GWMEL3Threshold "The value of SoC at which the low level warning, SBWURLowChargeLmt, will be transmitted to the vehicle power system controller.";
CM_ SG_ 262 GWMWakeUpToChargeThr "The value of SoC at which the battery wake up to charge request, SBWakeUpToChargeReq, will be transmitted to the vehicle power system controller.";
CM_ SG_ 262 OdometerMasterValue "EuCD Signal.
Range: 0 - 16777214 (0-FFFFFEh)
Resolution: 1 KM
FFFFFFh = Invalid Data

                                                                         
NB: Signals greater than 16bits have to be of Signal Type (Bytes) as VSX does not support Unsigned signals >16bits.

The MSB of the signal must be written to the COM layer first (with an offset of zero in wr_bytes() ) and therefore transmitted on the bus first.
Similarly, subscribing modules will receive the MSB of the signal when they call rd_bytes(0).

E.g. wr_bytes(0) = published_signal_MSB;

Subscribed_Signal_MSB = rd_bytes(0);



                             
";
CM_ SG_ 262 SBShortVehID "Car Configuration - VIN Part 3

VIN Character 12 (Serial Number 1)
VIN Character 13 (Serial Number 2)
VIN Character 14 (Serial Number 3)
VIN Character 15 (Serial Number 4)
VIN Character 16 (Serial NumbeAr 5)
VIN Character 17 (Serial Number 6)

Payload MDF = 0x5927, 0x5937, 0x5947, 0x5957, 0x5967, 0x5977";
CM_ SG_ 267 SOTAPrepRequest "Request to start preparing subscribing modules for a SOTA installation event";
CM_ SG_ 1024 CcfDD00GlobalRealTime "Global Identifier   DD00	
ID Name               Global Real Time
Size (Bytes)          4
Type                     Unsigned Numeric
Data Description   As defined in GMRDB

Resolution ref: 1/600  Resolution: 0.001666666667 
Numeric size (bits): 32 
Offset: 0.0 
Minimum value: 0.0  Maximum value: 7158278.825 
Unit: min

(from GMRDB)

MDF 0xB027";
CM_ SG_ 1024 CcfDD02MainECUSupVolts "Global Identifier   DD02
ID Name               Main ECU Supply Voltage
Size (Bytes)          1
Type                     Unsigned Numeric
Data Description   As defined in GMRDB

MDF 0xB067";
CM_ SG_ 1024 CcfDD06PowerModePKT "Global Identifier   DD06
ID Name               Power Mode (PKT1)
Size (Bytes)          1
Type                     Packeted
Data Description   As defined in GMRDB

Parameter Size (bits) Datatype Description   

1 3 State Encoded Power Mode Quality Factor   (NOT USED)
2 5 State Encoded Power Mode   

(from GMRDB)

MDF 0xB074";
CM_ SG_ 1024 CcfDD01TotalDistance "Global Identifier   DD01
ID Name               Total Distance
Size (Bytes)          3
Type                     Unsigned Numeric
Data Description   As defined in GMRDB

Resolution ref: 1  Resolution: 1.0 
Numeric size (bits): 24 
Offset: 0.0 
Minimum value: 0.0  Maximum value: 1.6777215E7 
Unit: km 

MDF 0xB127";
CM_ SG_ 1024 CcfDD04InCarTemp "Global Identifier   DD04
ID Name               In-Car Temperature
Size (Bytes)          1
Type                     Unsigned Numeric
Data Description   As defined in GMRDB

MDF 0xB157";
CM_ SG_ 1024 CcfDD05OutdoorTemp "Global Identifier   DD05
ID Name               Outdoor Temperature
Size (Bytes)          1
Type                     Unsigned Numeric
Data Description   As defined in GMRDB

MDF 0xB167";
BA_DEF_  "BaudRateCANFD" FLOAT 1000 10000000;
BA_DEF_  "Baudrate" FLOAT 1000 1000000;
BA_DEF_  "BusType" STRING ;
BA_DEF_  "DBName" STRING ;
BA_DEF_  "ProtocolType" STRING ;
BA_DEF_ BO_  "CANFD_BRS" ENUM  "0","1";
BA_DEF_ BO_  "GenMsgCycleTime" FLOAT 0 300000;
BA_DEF_ BO_  "GenMsgDelayTime" FLOAT 0 300000;
BA_DEF_ BO_  "GenMsgSendType" ENUM  "cyclic","spontaneous","cyclicIfActive","spontaneousWithDelay","cyclicAndSpontaneous","cyclicAndSpontaneousWithDelay","IfActive","NoMsgSendType";
BA_DEF_ BO_  "GenMsgStartDelayTime" FLOAT 0 300000;
BA_DEF_ BO_  "VFrameFormat" ENUM  "StandardCAN","ExtendedCAN","reserved","J1939PG","reserved","reserved","reserved","reserved","reserved","reserved","reserved","reserved","reserved","reserved","StandardCAN_FD","ExtendedCAN_FD";
BA_DEF_ SG_  "GenSigSendType" ENUM  "Cyclic","OnWrite","OnWriteWithRepetition","OnChange","OnChangeWithRepetition","IfActive","IfActiveWithRepetition","NoSigSendType";
BA_DEF_ SG_  "GenSigStartValue" FLOAT -1.79769313486232E+308 1.84467440737096E+019;
BA_DEF_DEF_  "BaudRateCANFD" 1000;
BA_DEF_DEF_  "Baudrate" 1000;
BA_DEF_DEF_  "BusType" "";
BA_DEF_DEF_  "DBName" "";
BA_DEF_DEF_  "ProtocolType" "";
BA_DEF_DEF_  "CANFD_BRS" "1";
BA_DEF_DEF_  "GenMsgCycleTime" 0;
BA_DEF_DEF_  "GenMsgDelayTime" 0;
BA_DEF_DEF_  "GenMsgSendType" "";
BA_DEF_DEF_  "GenMsgStartDelayTime" 0;
BA_DEF_DEF_  "VFrameFormat" "J1939PG";
BA_DEF_DEF_  "GenSigSendType" "Cyclic";
BA_DEF_DEF_  "GenSigStartValue" 0;
BA_ "BaudRateCANFD" 2000000;
BA_ "Baudrate" 500000;
BA_ "BusType" "CAN FD";
BA_ "ProtocolType" "CAN";
BA_ "DBName" "PBU_CANFD1_Ctrl";
BA_ "GenMsgCycleTime" BO_ 172 40;
BA_ "GenMsgSendType" BO_ 172 0;
BA_ "VFrameFormat" BO_ 172 14;
BA_ "GenMsgCycleTime" BO_ 323 100;
BA_ "GenMsgSendType" BO_ 323 0;
BA_ "VFrameFormat" BO_ 323 14;
BA_ "GenMsgSendType" BO_ 1919 1;
BA_ "VFrameFormat" BO_ 1919 14;
BA_ "GenMsgCycleTime" BO_ 78 10;
BA_ "GenMsgSendType" BO_ 78 0;
BA_ "VFrameFormat" BO_ 78 14;
BA_ "GenMsgCycleTime" BO_ 122 20;
BA_ "GenMsgSendType" BO_ 122 0;
BA_ "VFrameFormat" BO_ 122 14;
BA_ "GenMsgCycleTime" BO_ 165 40;
BA_ "GenMsgSendType" BO_ 165 0;
BA_ "VFrameFormat" BO_ 165 14;
BA_ "GenMsgCycleTime" BO_ 262 80;
BA_ "GenMsgSendType" BO_ 262 0;
BA_ "VFrameFormat" BO_ 262 14;
BA_ "GenMsgCycleTime" BO_ 267 80;
BA_ "GenMsgSendType" BO_ 267 0;
BA_ "VFrameFormat" BO_ 267 14;
BA_ "GenMsgSendType" BO_ 2015 1;
BA_ "VFrameFormat" BO_ 2015 0;
BA_ "GenMsgSendType" BO_ 1911 1;
BA_ "VFrameFormat" BO_ 1911 14;
BA_ "GenMsgDelayTime" BO_ 1024 5;
BA_ "GenMsgSendType" BO_ 1024 1;
BA_ "VFrameFormat" BO_ 1024 0;
BA_ "GenSigStartValue" SG_ 172 PBBatVolt 140;
BA_ "GenSigStartValue" SG_ 172 PBMaxChrgCurrLmt 511;
BA_ "GenSigStartValue" SG_ 172 PBMaxChrgVoltLmt 136;
BA_ "GenSigStartValue" SG_ 172 PBMaxDchgCurrLmt 511;
BA_ "GenSigStartValue" SG_ 323 PBAliveCounter 1;
BA_ "GenSigStartValue" SG_ 323 PBBattQd 1;
BA_ "GenSigStartValue" SG_ 323 PBCell1Volt 100;
BA_ "GenSigStartValue" SG_ 323 PBCell2Volt 100;
BA_ "GenSigStartValue" SG_ 323 PBCell3Volt 100;
BA_ "GenSigStartValue" SG_ 323 PBCell4Volt 100;
BA_ "GenSigStartValue" SG_ 323 PBCpctyAbsolute 100;
BA_ "GenSigStartValue" SG_ 323 PBCpctyRelative 100;
BA_ "GenSigStartValue" SG_ 323 PBMinBatVolt 160;
BA_ "GenSigStartValue" SG_ 323 PBPackVolt 140;
BA_ "GenSigStartValue" SG_ 323 PBParkingTime 127;
BA_ "GenSigStartValue" SG_ 323 PBPos1Temp 10;
BA_ "GenSigStartValue" SG_ 323 PBPos2Temp 10;
BA_ "GenSigStartValue" SG_ 323 PBRelayStatus 1;
BA_ "GenSigStartValue" SG_ 323 PBSoCAbsolute 90;
BA_ "GenSigStartValue" SG_ 323 PBSoCRelative 90;
BA_ "GenSigStartValue" SG_ 78 VehMovementDirection 2;
BA_ "GenSigStartValue" SG_ 78 VehMovementStatus 1;
BA_ "GenSigStartValue" SG_ 262 GWMEL2Threshold 50;
BA_ "GenSigStartValue" SG_ 262 GWMEL3Threshold 45;
BA_ "GenSigStartValue" SG_ 262 GWMWakeUpToChargeThr 50;
BA_ "GenSigSendType" SG_ 1024 CcfDD00GlobalRealTime 1;
BA_ "GenSigSendType" SG_ 1024 CcfDD02MainECUSupVolts 1;
BA_ "GenSigSendType" SG_ 1024 CcfDD06PowerModePKT 1;
BA_ "GenSigSendType" SG_ 1024 CcfDD01TotalDistance 1;
BA_ "GenSigSendType" SG_ 1024 CcfDD04InCarTemp 1;
BA_ "GenSigSendType" SG_ 1024 CcfDD05OutdoorTemp 1;
VAL_ 172 PB1FETStatus 0 "All gates closed" 1 "Discharge Gate Pre-Open" 2 "Discharge Gate Open" 3 "Charge Gate Pre-Open" 4 "Charge Gate Open" ;
VAL_ 172 PB2Degradation 0 "No Fault" 1 "Temporary battery Fault" 2 "Permanenet battery Fault" 3 "Low SOC Warning Level 1" 4 "Critical SOC Warning Level 2" 5 "Critical Low-temperature Level 2" ;
VAL_ 172 PB2FETStatus 0 "All gates closed" 1 "Discharge Gate Pre-Open" 2 "Discharge Gate Open" 3 "Charge Gate Pre-Open" 4 "Charge Gate Open" ;
VAL_ 172 PBBatCurrFlt 0 "Sensor OK" 1 "Sensor fault" ;
VAL_ 172 PBBatVoltFlt 0 "Sensor OK" 1 "Sensor fault" ;
VAL_ 172 PBCriticErr 0 "No Fault" 1 "Over Voltage Error Level 1" 2 "Over Voltage Error Level 2" 3 "Over Voltage Error Level 3" 4 "Low Voltage Error Level 1" 5 "Low Voltage Error Level 2" 6 "Low Voltage Error Level 3" 7 "High Temperature Error Level" 8 "Over Charge Current Error Level 2" 9 "Over Discharge Current Error Level 2" 10 "Over Discharge Current Error Level 3" 11 "Relay Open (External Short Circuit)" ;
VAL_ 172 PBCriticErrProtd 0 "No Fault" 1 "Over Voltage Error Level 1" 2 "Over Voltage Error Level 2" 3 "Over Voltage Error Level 3" 4 "Low Voltage Error Level 1" 5 "Low Voltage Error Level 2" 6 "Low Voltage Error Level 3" 7 "High Temperature Error Level" 8 "Over Charge Current Error Level 2" 9 "Over Discharge Current Error Level 2" 10 "Over Discharge Current Error Level 3" 11 "Relay Open (External Short Circuit)" ;
VAL_ 172 PBDegradation 0 "No Fault" 1 "Temporary battery Fault" 2 "Permanenet battery Fault" 3 "Low SOC Warning Level 1" 4 "Critical SOC Warning Level 2" 5 "Critical Low-temperature Level 2" ;
VAL_ 323 PBAgeing 0 "Battery has NOT reached any of the 4 defined milestones" 1 "Battery has reached the point where: (1) capacity fade is greater than 34%, it's been (2) 10 years or (3) 150,000 miles in service or (4) the relay counter damage has exceeded 60" ;
VAL_ 323 PBBalActvCell1 0 "FALSE" 1 "TRUE" ;
VAL_ 323 PBBalActvCell2 0 "FALSE" 1 "TRUE" ;
VAL_ 323 PBBalActvCell3 0 "FALSE" 1 "TRUE" ;
VAL_ 323 PBBalActvCell4 0 "FALSE" 1 "TRUE" ;
VAL_ 323 PBCell1VoltFlt 0 "Sensor OK" 1 "Sensor fault" ;
VAL_ 323 PBCell2VoltFlt 0 "Sensor OK" 1 "Sensor fault" ;
VAL_ 323 PBCell3VoltFlt 0 "Sensor OK" 1 "Sensor fault" ;
VAL_ 323 PBCell4VoltFlt 0 "Sensor OK" 1 "Sensor fault" ;
VAL_ 323 PBECUFlt 0 "No Fault" 1 "ECU Fault" ;
VAL_ 323 PBErsoStatus 0 "ERSO has not been triggered" 1 "ERSO was triggered in the last sleep period" ;
VAL_ 323 PBPackVoltFlt 0 "Sensor OK" 1 "Sensor fault" ;
VAL_ 323 PBPos1TempFlt 0 "Sensor OK" 1 "Sensor fault" ;
VAL_ 323 PBPos2TempFlt 0 "Sensor OK" 1 "Sensor fault" ;
VAL_ 323 PBRelayClsFlt 0 "Not failed" 1 "Failed closed" ;
VAL_ 323 PBRelayOpenFlt 0 "Not failed" 1 "Failed open" ;
VAL_ 323 PBRelayStatus 0 "INIT" 1 "CLOSE" 2 "PRE-OPEN" 3 "OPEN" ;
VAL_ 323 PBTOCReq 0 "FALSE" 1 "TRUE" ;
VAL_ 323 PBWakeupStat 0 "FALSE" 1 "TRUE" ;
VAL_ 323 PBWakeUpToChgReq 0 "FALSE" 1 "TRUE" ;
VAL_ 323 PBWURLowChargeLmt 0 "FALSE" 1 "TRUE" ;
VAL_ 323 PBWURMinChargeLmt 0 "FALSE" 1 "TRUE" ;
VAL_ 78 VehMovementDirection 0 "Vehicle moving forwards" 1 "Vehicle moving backwards" 2 "Vehicle Stationary/Undetermined direction" 3 "Reserved" ;
VAL_ 78 VehMovementStatus 0 "Vehicle stationary" 1 "Vehicle moving" ;
VAL_ 78 WheelDirectionFL 0 "Forwards" 1 "Backwards" 2 "Undetermined Direction" 3 "Stationary" ;
VAL_ 78 WheelDirectionFR 0 "Forwards" 1 "Backwards" 2 "Undetermined Direction" 3 "Stationary" ;
VAL_ 78 WheelDirectionRL 0 "Forwards" 1 "Backwards" 2 "Undetermined Direction" 3 "Stationary" ;
VAL_ 78 WheelDirectionRR 0 "Forwards" 1 "Backwards" 2 "Undetermined Direction" 3 "Stationary" ;
VAL_ 122 PowerPackStatus 0 "Init" 1 "Awake" 2 "Ready" 3 "PreStarting" 4 "StartingInProgress" 5 "Running_Running" 6 "Running_Standby" 7 "Running_StartingInProgress" 8 "Running_RemoteStarted" 9 "AfterRun" ;
VAL_ 165 CarMode 0 "Normal" 1 "Factory" 2 "Unused2" 3 "Transport" 4 "Unused4" ;
VAL_ 165 PowerMode 0 "KeyOut" 1 "KeyRecentlyOut" 2 "KeyApproved_0" 3 "PostAccessory_0" 4 "Accessory_1" 5 "PostIgnition_1" 6 "IgnitionOn_2" 7 "Running_2" 9 "Crank_3" ;
VAL_ 267 SOTAPrepRequest 0 "Not required / completed" 1 "Request for SOTA install" 2 "SOTA installation in progress" 3 "SOTA installation in progress- HV system active" ;
SIG_GROUP_ 172 PBCriticErrGp 1 : PBCriticErrGpAC PBCriticErrGpCS PBCriticErrProtd;
SIG_GROUP_ 172 PBDegradationGp 1 : PB1FETStatus PB2Degradation PB2FETStatus PBDegradation PBDegradationGpAC PBDegradationGpCS;
SIG_GROUP_ 78 VehMovement 1 : VehMovementChecksum VehMovementCounter VehMovementDirection VehMovementStatus WheelDirectionFL WheelDirectionFR WheelDirectionRL WheelDirectionRR;
