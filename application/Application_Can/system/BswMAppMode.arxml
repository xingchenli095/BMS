AUTOSAR XML (schema 00047)
package /AppMode/DataTypeMappingSets
  data type mapping set AppModeMapping: mode-request-type-map{implementation-data-type=uint8, mode-group=AppStateModeGroup}
package /AppMode/ImplementationDataTypes
  impl type AppStateModeRequestType: compu {1=EB_INTGR_APP_STARTUP, 2=EB_INTGR_APP_ACTIVE, 3=EB_INTGR_APP_INACTIVE, 4=EB_INTGR_APP_SLEEP, 5=EB_INTGR_APP_WAKEUP}, implementation-data-type=uint8
package /AppMode/ModeDeclarationGroups
  mode declaration group AppStateModeGroup: category=EXPLICIT_ORDER, initial-mode=EB_INTGR_APP_STARTUP, on-transition-value=9
    5 x mode:
      EB_INTGR_APP_ACTIVE: value=2
      EB_INTGR_APP_INACTIVE: value=3
      EB_INTGR_APP_SLEEP: value=4
      EB_INTGR_APP_STARTUP: value=1
      EB_INTGR_APP_WAKEUP: value=5
package /AppMode/PortInterfaces
  sender receiver interface IfCan
    data Can: type=uint8
  mode switch interface If_AppState: is-service=true
    mode group AppStateMode: type=AppStateModeGroup
  sender receiver interface If_AppStateRequest: is-service=true
    data If_AppStateRequestMode: type=AppStateModeRequestType
