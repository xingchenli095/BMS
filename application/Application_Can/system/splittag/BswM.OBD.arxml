AUTOSAR XML (schema 4-3-0)
package /BswM
  module config BswM
    BswMConfig
      BswMModeControl
        4 x BswMAction:
          BswM_Act_StartDemOpCycleState_IGNITION
            BswMAvailableActions
              BswMAvailableActions (BswMUserCallout): BswMUserCalloutFunction=Dem_SetOperationCycleState(DEM_OPCYC_IGNITION, DEM_CYCLE_STATE_START)
          BswM_Act_StartDemOpCycleState_OBD_DCY
            BswMAvailableActions
              BswMAvailableActions (BswMUserCallout): BswMUserCalloutFunction=Dem_SetOperationCycleState(DEM_OPCYC_OBD_DCY, DEM_CYCLE_STATE_START)
          BswM_Act_StopDemOpCycleState_IGNITION
            BswMAvailableActions
              BswMAvailableActions (BswMUserCallout): BswMUserCalloutFunction=Dem_SetOperationCycleState(DEM_OPCYC_IGNITION, DEM_CYCLE_STATE_END)
          BswM_Act_StopDemOpCycleState_OBD_DCY
            BswMAvailableActions
              BswMAvailableActions (BswMUserCallout): BswMUserCalloutFunction=Dem_SetOperationCycleState(DEM_OPCYC_OBD_DCY, DEM_CYCLE_STATE_END)
        BswM_ActLst_PrpShutdown (BswMActionList)
          BswMActionListItem_5 (BswMActionListItem): BswMActionListItemIndex=3, BswMActionListItemRef=BswM_Act_StopDemOpCycleState_IGNITION
          BswMActionListItem_6 (BswMActionListItem): BswMActionListItemIndex=4, BswMActionListItemRef=BswM_Act_StopDemOpCycleState_OBD_DCY
        BswM_ActLst_StartupTwoB (BswMActionList)
          BswMActionListItem_7 (BswMActionListItem): BswMActionListItemIndex=5, BswMActionListItemRef=BswM_Act_StartDemOpCycleState_IGNITION
          BswMActionListItem_8 (BswMActionListItem): BswMActionListItemIndex=6, BswMActionListItemRef=BswM_Act_StartDemOpCycleState_OBD_DCY
