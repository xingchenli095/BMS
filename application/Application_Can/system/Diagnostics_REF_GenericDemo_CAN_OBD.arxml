AUTOSAR XML (schema 00047)
package /Diagnostics/Common
  diagnostic contribution set DcmContributionSet: elements=[DiagnosticRequestVehicleInfo, DiagnosticRequestVehicleInfoClass], service-tables=DcmServiceTable_OBD
package /Diagnostics/Dcm
  diagnostic connection CAN_DiagnosticConnection_OBD: functional-request=CAN_FunctionalRx_OBD, physical-request=CAN_PhysicalTx_OBD, response=CAN_PhysicalRes_OBD
  diagnostic service table DcmServiceTable_OBD: diagnostic-connections=CAN_DiagnosticConnection_OBD, ecu-instance=EcuTestNode, protocol-kind=OBD_ON_CAN
package /Diagnostics/Dcm/ServiceClasses
  diagnostic request vehicle info class DiagnosticRequestVehicleInfoClass: access-permission-validity=ACCESS-PERMISSION-SERVICE-INSTANCE
package /Diagnostics/Dcm/ServiceInstances/OBD
  diagnostic request vehicle info DiagnosticRequestVehicleInfo: access-permission=AP_All, request-vehicle-information-class=DiagnosticRequestVehicleInfoClass
package /Diagnostics/Dem/Dtcs
  diagnostic trouble code obd DTC_Obd: consider-pto-status=True, obd-dtc-value=3
package /Diagnostics/Dem/Mappings
  diagnostic trouble code uds to trouble code obd mapping DTC_Uds_To_DTC_Obd_Mapping: trouble-code-obd=DTC_Obd, trouble-code-uds=DTC_0x000001
package /Diagnostics/Dem/OperationCycles
  diagnostic operation cycle DEM_OPCYC_IGNITION: type=IGNITION
  diagnostic operation cycle DEM_OPCYC_OBD_DCY: type=OBD-DRIVING-CYCLE
